AUTOSAR XML (schema 4-2-2)
package /AUTOSAR_Comtype/ImplementationDataTypes  # AUTOSAR Communication Stack Types
  13 x impl type, all with type-emitter=HEADER_FILE:
    PduIdType: implementation-data-type=uint16  # Type of PDU ID | Zero-based integer number: 0...PduIdmax. The size of this global type depends on the maximum number of PDUs used within one software module. This parameter shall be generated by the generator tool depending on the value configured in EcuC virtual layer. | This type is used within the entire AUTOSAR Com Stack except for bus drivers. Variables of this type serve as a unique identifier of a PDU within a software module or a set thereof, and also for interaction of two software modules where the PduId of the corresponding target module is being used for referencing. In order to be able to perform table-indexing within a software module, variables of this type shall be zero-based and consecutive. There might be several ranges of PduIds in a module, one for each type of operation performed within that module (e.g. sending and receiving). PduIdmax, the maximum number of a PduId range, is the number -1 of PDUs dealt with in the corresponding type of operation within that module.
    PduLengthType: implementation-data-type=uint16  # Type of PDU Length | Zero-based integer number: 0...PduLengthmax. The size of this global type depends on the maximum length of PDUs to be sent by an ECU. This parameter shall be generated by the generator tool depending on the value configured in EcuC virtual layer. This parameter shall be generated in ComStack_Cfg.h file. | This type shall be used within the entire AUTOSAR Com Stack of an ECU except for bus drivers. Variables of this type serve as length information of a PDU. The length information is provided in number of bytes. PduLengthmax, the maximum length of a Pdu, is the length of the largest (possibly segmented) PDU to be sent by the ECU.
    PduInfoType: category=STRUCTURE  # Information about Tp buffer handling | SWS_COMTYPE_00011 Variables of this type shall be used to store the basic information about a PDU of any type, namely a pointer variable pointing to its SDU (payload), and the corresponding length of the SDU in bytes.
      element SduDataPtr: category=DATA_REFERENCE, sw-pointer-target-props={target-category=TYPE_REFERENCE, implementation-data-type=uint8}  # Pointer to the SDU (i.e. payload data) of the PDU. Depending on the global parameter MetaDataLength, additional bytes containing MetaData (e.g. the CAN ID) are appended after the payload data. The type of this pointer depends on the memory model being used at compile time.
      element SduLength: implementation-data-type=PduLengthType  # Length of the SDU in bytes, including MetaData.
    NotifResultType: compu {0=NTFRSLT_OK (Action has been successfully finished), 1=NTFRSLT_E_NOT_OK (Error notification), 2=NTFRSLT_E_TIMEOUT_A (Error notification), 3=NTFRSLT_E_TIMEOUT_BS (Error notification), 4=NTFRSLT_E_TIMEOUT_CR (Error notification), 5=NTFRSLT_E_WRONG_SN (Error notification), 6=NTFRSLT_E_INVALID_FS (Error notification), 7=NTFRSLT_E_UNEXP_PDU (Error notification), 8=NTFRSLT_E_WFT_OVRN (Error notification), 9=NTFRSLT_E_ABORT (Error notification), 10=NTFRSLT_E_NO_BUFFER (Error notification), 11=NTFRSLT_E_CANCELATION_OK (Action has been successfully finished), 12=NTFRSLT_E_CANCELATION_NOT_OK (Error notification), 13=NTFRSLT_PARAMETER_OK (The parameter change request has been successfully executed), 14=NTFRSLT_E_PARAMETER_NOT_OK (The request for the change of the parameter did not complete successfully), 15=NTFRSLT_E_RX_ON (The parameter change request not executed successfully due to an ongoing reception), 16=NTFRSLT_E_VALUE_NOT_OK (The parameter change request not executed successfully due to a wrong value)} "General Codes for NotifResultType.", implementation-data-type=uint8  # Result status of a notification | Variables of this type shall be used to store the result status of a notification (confirmation or indication). Currently this type is only used for communication between DCM and TP to enable the notification that an error has occurred and a dedicated buffer can be unlocked
    PNCHandleType: implementation-data-type=uint8  # Used to store the identifier of a partial network cluster | Variables of the type PNCHandleType shall be used to store the identifier of a partial network cluster.
    TPParameterType: compu {0=TP_STMIN (Separation Time), 1=TP_BS (Block Size), 2=TP_BC (The Band width control parameter used in FlexRay transport protocol module), 3=TP_BFS (Buffer Size Paramater)} "Specify the parameter to which the value has to be changed (TP_STMIN or TP_BS or TP_BC or BS or TP_BFS).", implementation-data-type=uint8  # Specify the parameter to which the value has to be changed (TP_STMIN or TP_BS or TP_BC or BS or TP_BFS).
    BufReq_ReturnType: compu {0=BUFREQ_OK (Buffer request accomplished successful.), 1=BUFREQ_E_NOT_OK (Buffer request not successful. Buffer cannot be accessed.), 2=BUFREQ_E_BUSY (Temporarily no buffer available. It's up the requestor to retry request for a certain time.), 3=BUFREQ_E_OVFL (No Buffer of the required length can be provided.)} "Variables of this type shall be used to store the result of a buffer request.", implementation-data-type=uint8  # Result of a buffer request | Variables of this type shall be used to store the result of a buffer request.
    BusTrcvErrorType: compu {0=BUSTRCV_OK (There is no bus transceiver error seen by the driver or transceiver does not support the detection of bus errors.), 1=BUSTRCV_E_ERROR (Bus transceiver detected an unclassified error.)} "General Codes for BusTrcvErrorType.", implementation-data-type=uint8  # Bus status evaluated by a transceiver | Variables of this type shall be used to return the bus status evaluated by a transceiver.
    TpDataStateType: compu {0=TP_DATACONF (TP_DATACONF indicates that all data, that have been copied so far, are confirmed and can be removed from the TP buffer. Data copied by this API call are excluded and will be confirmed later.), 1=TP_DATARETRY (TP_DATARETRY indicates that this API call shall copy already copied data in order to recover from an error. In this case TxTpDataCnt specifies the offset of the first byte to be copied by the API call.), 2=TP_CONFPENDING (TP_CONFPENDING indicates that the previously copied data must remain in the TP.)} "Variables of this type shall be used to store the state of TP buffer.", implementation-data-type=uint8  # State of TP buffer | Variables of this type shall be used to store the state of TP buffer.
    RetryInfoType: category=STRUCTURE  # Information about Tp buffer handling | Variables of this type shall be used to store the information about Tp buffer handling.
      element TpDataState: implementation-data-type=TpDataStateType  # The enum type to be used to store the state of Tp buffer.
      element TxTpDataCnt: implementation-data-type=PduLengthType  # Offset from the current position which identifies the number of bytes to be retransmitted.
    NetworkHandleType: implementation-data-type=uint8  # Identifier of a communication channel | Variables of the type NetworkHandleType shall be used to store the identifier of a communication channel.
    IcomConfigIdType: implementation-data-type=uint8  # IcomConfigIdType defines the configuration ID. | IcomConfigIdType defines the configuration ID. An ID of 0 is the default configuration. An ID greater than 0 shall identify a configuration for Pretended Networking. There is more than 1 configuration possible.
    IcomSwitch_ErrorType: compu {0=ICOM_SWITCH_E_OK (The activation of Pretended Networking was successful.), 1=ICOM_SWITCH_E_FAILED (The activation of Pretended Networking was not successful.)} "IcomSwitch_ErrorType defines the errors which can occur when activating or deactivating Pretended Networking.", implementation-data-type=uint8  # Error Type based on state of Pretended Networking. | IcomSwitch_ErrorType defines the errors which can occur when activating or deactivating Pretended Networking.
