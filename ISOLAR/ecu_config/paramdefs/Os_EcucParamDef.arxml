AUTOSAR XML (schema 4-2-2)
package /AUTOSAR_Os/EcucModuleDefs
  module definition Os [0..1]: category=VENDOR_SPECIFIC_MODULE_DEFINITION, refined-module-def=Os, variants pre-compile  # Configuration of the Os (Operating System) module.
    container OsAlarm [0..*]  # An OsAlarm may be used to asynchronously inform or activate a specific task. It is possible to start alarms automatically at system start-up depending on the application mode.
      reference OsAlarmAccessingApplication [0..*]: multiplicity set at pre-compile, set at pre-compile, destination=OsApplication  # Reference to applications which have an access to this object.
      reference OsAlarmCounterRef: set at pre-compile, destination=OsCounter  # Reference to the assigned counter for that alarm
      choice container OsAlarmAction  # This container defines which type of notification is used when the alarm expires.
        container OsAlarmActivateTask [0..1]  # This container specifies the parameters to activate a task.
          reference OsAlarmActivateTaskRef: set at pre-compile, destination=OsTask  # Reference to the task that will be activated by that alarm action
        container OsAlarmCallback [0..1]  # This container specifies the parameters to call a callback OS alarm action.
          function name OsAlarmCallbackName: set at pre-compile  # Name of the function that is called when this alarm callback is triggered.
        container OsAlarmIncrementCounter [0..1]  # This container specifies the parameters to increment a counter.
          reference OsAlarmIncrementCounterRef: scope=ECU, set at pre-compile, destination=OsCounter  # Reference to the counter that will be incremented by that alarm action
        container OsAlarmSetEvent [0..1]  # This container specifies the parameters to set an event
          reference OsAlarmSetEventRef: set at pre-compile, destination=OsEvent  # Reference to the event that will be set by that alarm action
          reference OsAlarmSetEventTaskRef: set at pre-compile, destination=OsTask  # Reference to the task that will be activated by that event
      container OsAlarmAutostart [0..1]  # If present this container defines if an alarm is started automatically at system start-up depending on the application mode.
        integer OsAlarmAlarmTime: 0..18446744073709551615, set at pre-compile  # The relative or absolute tick value when the alarm expires for the first time. Note that for an alarm which is RELATIVE the value must be at bigger than 0.
        enumeration OsAlarmAutostartType: {ABSOLUTE, RELATIVE}, set at pre-compile  # This specifies the type of autostart for the alarm..
        integer OsAlarmCycleTime: 0..18446744073709551615, set at pre-compile  # Cycle time of a cyclic alarm in ticks. If the value is 0 than the alarm is not cyclic.
        reference OsAlarmAppModeRef [1..*]: multiplicity set at pre-compile, set at pre-compile, destination=OsAppMode  # Reference to the application modes for which the AUTOSTART shall be performed
    container OsAppMode [1..*]  # OsAppMode is the object used to define OSEK OS properties for an OSEK OS application mode. | No standard attributes are defined for AppMode. In a CPU, at least one AppMode object has to be defined. [source: OSEK OIL Spec. 2.5] An OsAppMode called OSDEFAULTAPPMODE must always be there for OSEK compatibility.
    container OsApplication [0..*]  # An AUTOSAR OS must be capable of supporting a collection of OS objects (tasks, interrupts, alarms, hooks etc.) that form a cohesive functional unit. This collection of objects is termed an OS-Application. | All objects which belong to the same OS-Application have access to each other. Access means to allow to use these objects within API services. Access by other applications can be granted separately.
      boolean OsTrusted: scope=ECU, set at pre-compile, default-value=false  # Parameter to specify if an OS-Application is trusted or not. | true: OS-Application is trusted false: OS-Application is not trusted (default)
      boolean OsTrustedApplicationDelayTimingViolationCall: scope=ECU, set at pre-compile, default-value=true  # Parameter to specify if a timing violation which occurs within an trusted OS-Application is raised immediately of if it is delayed until the current task returns to the calling OS-Application (return of CallTrustedFunction) | true: violation / call to ProtectionHook() is delayed false: timing violation cause an immediate call to the ProtectionHook().
      boolean OsTrustedApplicationWithProtection: scope=ECU, set at pre-compile, default-value=false  # Parameter to specify if a trusted OS-Application is executed with memory protection or not. | true: OS-Application runs within a protected environment. This means that write access is limited. false: OS-Application has full write access (default)
      reference OsAppAlarmRef [0..*]: scope=ECU, multiplicity set at pre-compile, set at pre-compile, destination=OsAlarm  # Specifies the OsAlarms that belong to the OsApplication.
      reference OsAppCounterRef [0..*]: scope=ECU, multiplicity set at pre-compile, set at pre-compile, destination=OsCounter  # References the OsCounters that belong to the OsApplication.
      reference OsAppEcucPartitionRef [0..1]: multiplicity set at pre-compile, set at pre-compile, destination=EcucPartition  # Denotes which "EcucPartition" is implemented by this "OSApplication".
      reference OsAppIsrRef [0..*]: scope=ECU, multiplicity set at pre-compile, set at pre-compile, destination=OsIsr  # references which OsIsrs belong to the OsApplication
      reference OsAppScheduleTableRef [0..*]: scope=ECU, multiplicity set at pre-compile, set at pre-compile, destination=OsScheduleTable  # References the OsScheduleTables that belong to the OsApplication.
      reference OsAppTaskRef [0..*]: scope=ECU, multiplicity set at pre-compile, set at pre-compile, destination=OsTask  # references which OsTasks belong to the OsApplication
      symbolic name reference OsApplicationCoreRef [0..1]: multiplicity set at pre-compile, set at pre-compile, destination=EcucCoreDefinition  # Reference to the Core Definition in the Ecuc Module where the CoreId is defined. This reference is used to describe to which Core the OsApplication is bound.
      reference OsRestartTask [0..1]: scope=ECU, multiplicity set at pre-compile, set at pre-compile, destination=OsTask  # Optionally one task of an OS-Application may be defined as Restart Task. | Multiplicity = 1: Restart Task is activated by the Operating System if the protection hook requests it. Multiplicity = 0: No task is automatically started after a protection error happened.
      container OsApplicationHooks  # Container to structure the OS-Application-specific hooks
        boolean OsAppErrorHook: scope=ECU, set at pre-compile  # Select the OS-Application error hook. | true: Hook is called false: Hook is not called
        boolean OsAppShutdownHook: scope=ECU, set at pre-compile  # Select the OS-Application specific shutdown hook for the OS-Application. | true: Hook is called false: Hook is not called
        boolean OsAppStartupHook: scope=ECU, set at pre-compile  # Select the OS-Application specific startup hook for the OS-Application. | true: Hook is called false: Hook is not called
      container OsApplicationTrustedFunction [0..*]  # Container to structure the configuration parameters of trusted functions
        function name OsTrustedFunctionName: scope=ECU, set at pre-compile  # Trusted function (as part of a trusted OS-Application) available to other OS-Applications. This also supersedes the OSEK OIL attribute TRUSTED in APPLICATION because the optionality of this parameter is describing that already.
    container OsCounter [0..*]  # Configuration information for the counters that belong to the OsApplication.
      integer OsCounterMaxAllowedValue: 1..18446744073709551615, set at pre-compile  # Maximum possible allowed value of the system counter in ticks.
      integer OsCounterMinCycle: 1..18446744073709551615, set at pre-compile  # The MINCYCLE attribute specifies the minimum allowed number of counter ticks for a cyclic alarm linked to the counter.
      integer OsCounterTicksPerBase: 1..4294967295, set at pre-compile  # The TICKSPERBASE attribute specifies the number of ticks required to reach a counterspecific unit. The interpretation is implementation-specific.
      enumeration OsCounterType: {HARDWARE, SOFTWARE}, scope=ECU, set at pre-compile  # This parameter contains the natural type or unit of the counter.
      string OsFormat [0..1]: origin=ETAS-RTA-OS_v5.7.0, set at pre-compile  # A string that specifies a format for each tracepoint.
      float OsSecondsPerTick [0..1]: 0..Inf, scope=ECU, multiplicity set at pre-compile, set at pre-compile  # Time of one counter tick in seconds.
      reference OsCounterAccessingApplication [0..*]: multiplicity set at pre-compile, set at pre-compile, destination=OsApplication  # Reference to applications which have an access to this object.
      container OsDriver [0..1]  # This Container contains the information who will drive the counter. | This configuration is only valid if the counter has OsCounterType set to HARDWARE. If the container does not exist (multiplicity=0) the timer is managed by the OS internally (OSINTERNAL). If the container exists the OS can use the GPT interface to manage the timer. The user have to supply the GPT channel. If the counter is driven by some other (external to the OS) source (like a TPU for example) this must be described as a vendor specific extension.
        reference OsGptChannelRef [0..1]: scope=ECU, multiplicity set at pre-compile, set at pre-compile, destination=GptChannelConfiguration  # Reference to the GPT channel.
      container OsTimeConstant [0..*]  # Allows the user to define constants which can be e.g. used to compare time values with timer tick values. | A time value will be converted to a timer tick value during generation and can later on accessed via the OsConstName. The conversation is done by rounding time values to the nearest fitting tick value.
        float OsTimeValue: 0..Inf, scope=ECU, set at pre-compile  # This parameter contains the value of the constant in seconds.
    container OsEvent [0..*]  # Representation of OS events in the configuration context. Adopted from the OSEK OIL specification.
      integer OsEventMask [0..1]: 0..18446744073709551615, multiplicity set at pre-compile, set at pre-compile  # If event mask would be set to AUTO in OIL, this parameter should be omitted here.
    container OsIoc [0..1]  # Configuration of the IOC (Inter OS Application Communicator).
      container OsIocCommunication [0..*]  # Representation of a 1:1 or N:1 or N:M (unqueued only) communication between software parts located in different OS-Applications that are bound to the same or to different cores. | The name shall begin with the name of the sending software service and be followed by a unique identifier delivered by the sending software service. In the case of RTE as user attention shall be paid on the fact that uniqueness for identifier names has to be reached over ports, data elements, object instances and maybe additional identification properties (E.g. Case 1:N mapping to 1:1). Example: - <NameSpace>_UniqueID
        integer OsIocBufferLength [0..1]: 0..4294967295, multiplicity set at pre-compile, set at pre-compile  # This attribute defines the size of the IOC internal queue to be allocated for a queued communication. | This configuration information shall allow the optimization of the needed memory for communications requiring buffers within the RTE and within the IOC.
        container OsIocDataProperties [1..*]  # Data properties of the data to be transferred on the IOC communication channel.
          integer OsIocDataPropertyIndex [0..1]: 0..255, multiplicity set at pre-compile, set at pre-compile  # This parameter is used to define in which order the data is send, e.g. whether IocSendGroup(A,B) or IocSendGroup(B,A) shall be used.
          string OsIocInitValue [0..1]: multiplicity set at pre-compile, set at pre-compile  # Initial Value for the data to be transferred on the IOC communication channel.
          foreign reference OsIocDataTypeRef: set at pre-compile, destination-type=IMPLEMENTATION-DATA-TYPE  # This is the type of the data to be transferred on the IOC communication channel. This attribute is necessary to generate the parameter type of the Ioc functions. Additionally this information should be used to compute the data size for necessary data copy operations within the Ioc module. | If more than one attribute is defined, the IOC generator should generate an IocXxxGroup function (Xxx= CHOICE [Send, Receive, Write, Read]). N:1 or N:M communication (Multiplicity of OsIocSenderProperties > 1) is only allowed for multiplicity of OsIocDataTypeRef = 1
          foreign reference OsIocMeasurementFlatInstanceDescriptorRef [0..*]: origin=ETAS-RTA-OS_v5.7.0, set at pre-compile, destination-type=FLAT-INSTANCE-DESCRIPTOR  # A reference to a Flatmap indicating that the communication is measurable.
        container OsIocReceiverProperties [1..*]  # Representation of receiver properties for one communication. For each OsIocCommunication one (1:1) or many receivers (N:M) have to be defined. This container should be instantiated within an OsIocCommunication.
          enumeration OsIocFunctionImplementationKind [0..1]: {DO_NOT_CARE, FUNCTION, MACRO}, multiplicity set at pre-compile, set at pre-compile, default-value=DO_NOT_CARE  # This parameter is used to select whether this communication is implemented as a macro or as a function.
          function name OsIocReceiverPullCB [0..1]: multiplicity set at pre-compile, set at pre-compile  # This attribute defines the name of a callback function that the IOC shall call on the receiving core for each data reception. | In case of non existence of this attribute no ReceiverPullCB notification shall be applied by the IOC. The name of the function shall begin with the name of the receiving module, followed with a callback name and followed by the IocId. Example: void RTE_ReceiverPullCB_RTE25 (void). If this attribute does not exist, it means that no ReceiverPullCB shall be called (No notification from IOC is required). If this attribute exists the IOC shall call the callback function on the receiving core.
          reference OsIocReceivingOsApplicationRef: set at pre-compile, destination=OsApplication  # This attribute is a reference to the receiving OsApplication instance defined in the configuration file of the OS. | This information allows for the generator to get additional information necessary for the code generation like: * The protection properties of the communicating OsApplications to find out which protections have to be crossed * The core identifiers to find out if an intra or an inter core communication has to be realized * Interrupt details in case of cross core notification to realize over IRQs
        container OsIocSenderProperties [1..*]  # Representation of sender properties for one communication. For each OsIocCommunication one (1:1) or many senders (N:1 or N:M) have to be defined. Multiplicity > 1 (N:1 or N:M communication) is only allowed for Multiplicity of OsIocDataTypeRef = 1. | This container should be instantiated within an OsIocCommunication.
          enumeration OsIocFunctionImplementationKind [0..1]: {DO_NOT_CARE, FUNCTION, MACRO}, multiplicity set at pre-compile, set at pre-compile, default-value=DO_NOT_CARE  # This parameter is used to select whether this communication is implemented as a macro or as a function.
          integer OsIocSenderId [0..1]: 0..255, scope=ECU, multiplicity set at pre-compile, set at pre-compile  # Representation of a sender in a N:1 or N:M communication to distinguish between senders. | This parameter does not exist in 1:1 communication.
          reference OsIocSendingOsApplicationRef: set at pre-compile, destination=OsApplication  # This attribute is a reference to the sending OS-Application instance defined in the configuration file of the OS. | This information shall allows the generator to get additional information necessary for the code generation like: * The protection properties of the communicating OS-Applications to find out which protection boundaries have to be crossed. * The core identifiers to find out if an intra or an inter core communication has to be realized * Interrupt details in case of cross core notification to realize over IRQs
      container OsIocReadGroup [0..*]  # Grouping of IOC communications for reading.
        reference OsIocReadingIsrRef [0..*]: origin=ETAS-RTA-OS_v5.7.0, set at pre-compile, destination=OsIsr  # A reference to an ISR reading the group.
        reference OsIocReadingTaskRef [0..*]: origin=ETAS-RTA-OS_v5.7.0, set at pre-compile, destination=OsTask  # A reference to a task reading the group.
        reference OsIocReceiverRef [0..*]: origin=ETAS-RTA-OS_v5.7.0, set at pre-compile, destination=OsIocReceiverProperties  # A reference to an IOC receive property.
      container OsIocWriteGroup [0..*]  # Grouping of IOC communications for writing.
        reference OsIocWritingIsrRef [0..*]: origin=ETAS-RTA-OS_v5.7.0, set at pre-compile, destination=OsIsr  # A reference to an ISR writing the group.
        reference OsIocWritingTaskRef [0..*]: origin=ETAS-RTA-OS_v5.7.0, set at pre-compile, destination=OsTask  # A reference to a task writing the group.
        container OsIocWriteGroupParam [0..*]  # Subgrouping of senders.
          reference OsIocSenderRef [0..*]: origin=ETAS-RTA-OS_v5.7.0, set at pre-compile, destination=OsIocSenderProperties  # A reference to an IOC sender property.
    container OsIsr [0..*]  # The OsIsr container represents an OSEK interrupt service routine.
      string OsIsrBudget [0..1]: origin=ETAS-RTA-OS_v5.7.0, set at pre-compile  # Execution budget expressed as a float, then timebase name, then units.
      enumeration OsIsrCategory: {CATEGORY_1, CATEGORY_2}, set at pre-compile  # This attribute specifies the category of this ISR.
      string OsIsrStackAllocation [0..1]: origin=ETAS-RTA-OS_v5.7.0, set at pre-compile  # ISR manual stack allocation in bytes.
      enumeration OsIsrAddress: origin=ETAS-RTA-TriCoreHighTec_TC26xB_v5.0.14  # ISR Address
        Interrupt_Trap0  # Virtual Address Trap
        Interrupt_Trap1  # Internal Protection Trap
        Interrupt_Trap2  # Instruction Errors Trap
        Interrupt_Trap3  # Context Management Trap
        Interrupt_Trap4  # Bus and Peripheral Trap
        Interrupt_Trap5  # Assertion
        Interrupt_Trap6  # System Call
        Interrupt_Trap7  # Non-Maskable Interrupt
        Interrupt_SRC_AGBT  # AGBT
        Interrupt_SRC_ASCLIN0ERR  # ASCLIN 0 Error
        Interrupt_SRC_ASCLIN0RX  # ASCLIN 0 Receive
        Interrupt_SRC_ASCLIN0TX  # ASCLIN 0 Transmit
        Interrupt_SRC_ASCLIN1ERR  # ASCLIN 1 Error
        Interrupt_SRC_ASCLIN1RX  # ASCLIN 1 Receive
        Interrupt_SRC_ASCLIN1TX  # ASCLIN 1 Transmit
        Interrupt_SRC_ASCLIN2ERR  # ASCLIN 2 Error
        Interrupt_SRC_ASCLIN2RX  # ASCLIN 2 Receive
        Interrupt_SRC_ASCLIN2TX  # ASCLIN 2 Transmit
        Interrupt_SRC_ASCLIN3ERR  # ASCLIN 3 Error
        Interrupt_SRC_ASCLIN3RX  # ASCLIN 3 Receive
        Interrupt_SRC_ASCLIN3TX  # ASCLIN 3 Transmit
        Interrupt_SRC_BCUSPBSBSRC  # Bus Control Unit SPB
        Interrupt_SRC_CANINT0  # MULTICAN+ SR0
        Interrupt_SRC_CANINT1  # MULTICAN+ SR1
        Interrupt_SRC_CANINT{10..15}  # MULTICAN+ SR{10..15}
        Interrupt_SRC_CANINT{2..9}  # MULTICAN+ SR{2..9}
        Interrupt_SRC_CCU60SR{0..3}  # CCU6 0 SR{0..3}
        Interrupt_SRC_CCU61SR{0..3}  # CCU6 1 SR{0..3}
        Interrupt_SRC_CERBERUS0  # Cerberus SR0
        Interrupt_SRC_CERBERUS1  # Cerberus SR1
        Interrupt_SRC_CIFISP  # CIF ISP
        Interrupt_SRC_CIFMI  # CIF MI
        Interrupt_SRC_CIFMIEP  # CIF MI EP
        Interrupt_SRC_CIFMJPEG  # CIF MJPEG
        Interrupt_SRC_CPU0SBSRC  # CPU 0 Software Breakpoint
        Interrupt_SRC_CPU1SBSRC  # CPU 1 Software Breakpoint
        Interrupt_SRC_DMACH0  # DMA Channel 0
        Interrupt_SRC_DMACH1  # DMA Channel 1
        Interrupt_SRC_DMACH{10..19}  # DMA Channel {10..19}
        Interrupt_SRC_DMACH2  # DMA Channel 2
        Interrupt_SRC_DMACH{20..29}  # DMA Channel {20..29}
        Interrupt_SRC_DMACH3  # DMA Channel 3
        Interrupt_SRC_DMACH{30..39}  # DMA Channel {30..39}
        Interrupt_SRC_DMACH4  # DMA Channel 4
        Interrupt_SRC_DMACH{40..47}  # DMA Channel {40..47}
        Interrupt_SRC_DMACH{5..9}  # DMA Channel {5..9}
        Interrupt_SRC_DMAERR  # DMA Error
        Interrupt_SRC_DSADCSRA0  # DSADC SRA0
        Interrupt_SRC_DSADCSRA2  # DSADC SRA2
        Interrupt_SRC_DSADCSRA3  # DSADC SRA3
        Interrupt_SRC_DSADCSRM0  # DSADC SRM0
        Interrupt_SRC_DSADCSRM2  # DSADC SRM2
        Interrupt_SRC_DSADCSRM3  # DSADC SRM3
        Interrupt_SRC_EMEM  # Emulation Memory
        Interrupt_SRC_ERAYIBUSY  # E-RAY Input Buffer Busy
        Interrupt_SRC_ERAYINT0  # E-RAY SR0
        Interrupt_SRC_ERAYINT1  # E-RAY SR1
        Interrupt_SRC_ERAYMBSC0  # E-RAY Message Buffer Status Changed 0
        Interrupt_SRC_ERAYMBSC1  # E-RAY Message Buffer Status Changed 1
        Interrupt_SRC_ERAYNDAT0  # E-RAY New Data 0
        Interrupt_SRC_ERAYNDAT1  # E-RAY New Data 1
        Interrupt_SRC_ERAYOBUSY  # E-RAY Output Buffer Busy
        Interrupt_SRC_ERAYTINT0  # E-RAY Timer Interrupt 0
        Interrupt_SRC_ERAYTINT1  # E-RAY Timer Interrupt 1
        Interrupt_SRC_ETH  # Ethernet
        Interrupt_SRC_FCE  # FCE Error
        Interrupt_SRC_FFTDONE  # FFT Done
        Interrupt_SRC_FFTERR  # FFT Error
        Interrupt_SRC_FFTRFS  # FFT Ready For Start
        Interrupt_SRC_GPSR{00..03}  # General Purpose SR{00..03}
        Interrupt_SRC_GPSR{10..13}  # General Purpose SR{10..13}
        Interrupt_SRC_GPT120CIRQ  # GPT120 CAPREL
        Interrupt_SRC_GPT120T{2..6}  # GPT120 T{2..6} Overflow/Underflow
        Interrupt_SRC_GTMAEIIRQ  # GTM AEI Shared
        Interrupt_SRC_GTMARUIRQ{0..2}  # GTM ARU Shared SR{0..2}
        Interrupt_SRC_GTMATOM00  # GTM ATOM0 Shared SR0
        Interrupt_SRC_GTMATOM01  # GTM ATOM0 Shared SR1
        Interrupt_SRC_GTMATOM02  # GTM ATOM0 Shared SR2
        Interrupt_SRC_GTMATOM03  # GTM ATOM0 Shared SR3
        Interrupt_SRC_GTMATOM10  # GTM ATOM1 Shared SR0
        Interrupt_SRC_GTMATOM11  # GTM ATOM1 Shared SR1
        Interrupt_SRC_GTMATOM12  # GTM ATOM1 Shared SR2
        Interrupt_SRC_GTMATOM13  # GTM ATOM1 Shared SR3
        Interrupt_SRC_GTMATOM20  # GTM ATOM2 Shared SR0
        Interrupt_SRC_GTMATOM21  # GTM ATOM2 Shared SR1
        Interrupt_SRC_GTMATOM22  # GTM ATOM2 Shared SR2
        Interrupt_SRC_GTMATOM23  # GTM ATOM2 Shared SR3
        Interrupt_SRC_GTMATOM30  # GTM ATOM3 Shared SR0
        Interrupt_SRC_GTMATOM31  # GTM ATOM3 Shared SR1
        Interrupt_SRC_GTMATOM32  # GTM ATOM3 Shared SR2
        Interrupt_SRC_GTMATOM33  # GTM ATOM3 Shared SR3
        Interrupt_SRC_GTMBRCIRQ  # GTM BRC Shared
        Interrupt_SRC_GTMCMPIRQ  # GTM CMP Shared
        Interrupt_SRC_GTMDPLL0  # GTM DPLL SR0
        Interrupt_SRC_GTMDPLL1  # GTM DPLL SR1
        Interrupt_SRC_GTMDPLL{10..19}  # GTM DPLL SR{10..19}
        Interrupt_SRC_GTMDPLL2  # GTM DPLL SR2
        Interrupt_SRC_GTMDPLL{20..26}  # GTM DPLL SR{20..26}
        Interrupt_SRC_GTMDPLL{3..9}  # GTM DPLL SR{3..9}
        Interrupt_SRC_GTMERR  # GTM Error
        Interrupt_SRC_GTMMCS00  # GTM MCS0 Shared SR0
        Interrupt_SRC_GTMMCS01  # GTM MCS0 Shared SR1
        Interrupt_SRC_GTMMCS02  # GTM MCS0 Shared SR2
        Interrupt_SRC_GTMMCS03  # GTM MCS0 Shared SR3
        Interrupt_SRC_GTMMCS04  # GTM MCS0 Shared SR4
        Interrupt_SRC_GTMMCS05  # GTM MCS0 Shared SR5
        Interrupt_SRC_GTMMCS06  # GTM MCS0 Shared SR6
        Interrupt_SRC_GTMMCS07  # GTM MCS0 Shared SR7
        Interrupt_SRC_GTMMCS10  # GTM MCS1 Shared SR0
        Interrupt_SRC_GTMMCS11  # GTM MCS1 Shared SR1
        Interrupt_SRC_GTMMCS12  # GTM MCS1 Shared SR2
        Interrupt_SRC_GTMMCS13  # GTM MCS1 Shared SR3
        Interrupt_SRC_GTMMCS14  # GTM MCS1 Shared SR4
        Interrupt_SRC_GTMMCS15  # GTM MCS1 Shared SR5
        Interrupt_SRC_GTMMCS16  # GTM MCS1 Shared SR6
        Interrupt_SRC_GTMMCS17  # GTM MCS1 Shared SR7
        Interrupt_SRC_GTMMCS20  # GTM MCS2 Shared SR0
        Interrupt_SRC_GTMMCS21  # GTM MCS2 Shared SR1
        Interrupt_SRC_GTMMCS22  # GTM MCS2 Shared SR2
        Interrupt_SRC_GTMMCS23  # GTM MCS2 Shared SR3
        Interrupt_SRC_GTMMCS24  # GTM MCS2 Shared SR4
        Interrupt_SRC_GTMMCS25  # GTM MCS2 Shared SR5
        Interrupt_SRC_GTMMCS26  # GTM MCS2 Shared SR6
        Interrupt_SRC_GTMMCS27  # GTM MCS2 Shared SR7
        Interrupt_SRC_GTMMCSW00  # GTM Multi Channel Sequencer 0 SR0
        Interrupt_SRC_GTMMCSW01  # GTM Multi Channel Sequencer 0 SR1
        Interrupt_SRC_GTMMCSW02  # GTM Multi Channel Sequencer 0 SR2
        Interrupt_SRC_GTMMCSW10  # GTM Multi Channel Sequencer 1 SR0
        Interrupt_SRC_GTMMCSW11  # GTM Multi Channel Sequencer 1 SR1
        Interrupt_SRC_GTMMCSW12  # GTM Multi Channel Sequencer 1 SR2
        Interrupt_SRC_GTMPSM00  # GTM PSM0 Shared SR0
        Interrupt_SRC_GTMPSM01  # GTM PSM0 Shared SR1
        Interrupt_SRC_GTMPSM02  # GTM PSM0 Shared SR2
        Interrupt_SRC_GTMPSM03  # GTM PSM0 Shared SR3
        Interrupt_SRC_GTMPSM04  # GTM PSM0 Shared SR4
        Interrupt_SRC_GTMPSM05  # GTM PSM0 Shared SR5
        Interrupt_SRC_GTMPSM06  # GTM PSM0 Shared SR6
        Interrupt_SRC_GTMPSM07  # GTM PSM0 Shared SR7
        Interrupt_SRC_GTMSPE0IRQ  # GTM SPE0 Shared
        Interrupt_SRC_GTMSPE1IRQ  # GTM SPE1 Shared
        Interrupt_SRC_GTMTIM00  # GTM TIM0 Shared SR0
        Interrupt_SRC_GTMTIM01  # GTM TIM0 Shared SR1
        Interrupt_SRC_GTMTIM02  # GTM TIM0 Shared SR2
        Interrupt_SRC_GTMTIM03  # GTM TIM0 Shared SR3
        Interrupt_SRC_GTMTIM04  # GTM TIM0 Shared SR4
        Interrupt_SRC_GTMTIM05  # GTM TIM0 Shared SR5
        Interrupt_SRC_GTMTIM06  # GTM TIM0 Shared SR6
        Interrupt_SRC_GTMTIM07  # GTM TIM0 Shared SR7
        Interrupt_SRC_GTMTIM10  # GTM TIM1 Shared SR0
        Interrupt_SRC_GTMTIM11  # GTM TIM1 Shared SR1
        Interrupt_SRC_GTMTIM12  # GTM TIM1 Shared SR2
        Interrupt_SRC_GTMTIM13  # GTM TIM1 Shared SR3
        Interrupt_SRC_GTMTIM14  # GTM TIM1 Shared SR4
        Interrupt_SRC_GTMTIM15  # GTM TIM1 Shared SR5
        Interrupt_SRC_GTMTIM16  # GTM TIM1 Shared SR6
        Interrupt_SRC_GTMTIM17  # GTM TIM1 Shared SR7
        Interrupt_SRC_GTMTIM20  # GTM TIM2 Shared SR0
        Interrupt_SRC_GTMTIM21  # GTM TIM2 Shared SR1
        Interrupt_SRC_GTMTIM22  # GTM TIM2 Shared SR2
        Interrupt_SRC_GTMTIM23  # GTM TIM2 Shared SR3
        Interrupt_SRC_GTMTIM24  # GTM TIM2 Shared SR4
        Interrupt_SRC_GTMTIM25  # GTM TIM2 Shared SR5
        Interrupt_SRC_GTMTIM26  # GTM TIM2 Shared SR6
        Interrupt_SRC_GTMTIM27  # GTM TIM2 Shared SR7
        Interrupt_SRC_GTMTOM00  # GTM TOM0 Shared SR0
        Interrupt_SRC_GTMTOM01  # GTM TOM0 Shared SR1
        Interrupt_SRC_GTMTOM02  # GTM TOM0 Shared SR2
        Interrupt_SRC_GTMTOM03  # GTM TOM0 Shared SR3
        Interrupt_SRC_GTMTOM04  # GTM TOM0 Shared SR4
        Interrupt_SRC_GTMTOM05  # GTM TOM0 Shared SR5
        Interrupt_SRC_GTMTOM06  # GTM TOM0 Shared SR6
        Interrupt_SRC_GTMTOM07  # GTM TOM0 Shared SR7
        Interrupt_SRC_GTMTOM10  # GTM TOM1 Shared SR0
        Interrupt_SRC_GTMTOM11  # GTM TOM1 Shared SR1
        Interrupt_SRC_GTMTOM12  # GTM TOM1 Shared SR2
        Interrupt_SRC_GTMTOM13  # GTM TOM1 Shared SR3
        Interrupt_SRC_GTMTOM14  # GTM TOM1 Shared SR4
        Interrupt_SRC_GTMTOM15  # GTM TOM1 Shared SR5
        Interrupt_SRC_GTMTOM16  # GTM TOM1 Shared SR6
        Interrupt_SRC_GTMTOM17  # GTM TOM1 Shared SR7
        Interrupt_SRC_HSCT  # HSCT
        Interrupt_SRC_HSSLCOK{0..3}  # Channel {0..3} OK m
        Interrupt_SRC_HSSLERR{0..3}  # Channel {0..3} Error m
        Interrupt_SRC_HSSLEXI  # Exception
        Interrupt_SRC_HSSLRDI{0..3}  # Channel {0..3} Read Data m
        Interrupt_SRC_HSSLTRG{0..3}  # Channel {0..3} Trigger m
        Interrupt_SRC_I2C0BREQ  # I2C 0 Burst Data Transfer Request
        Interrupt_SRC_I2C0ERR  # I2C 0 Error
        Interrupt_SRC_I2C0LBREQ  # I2C 0 Last Burst Data Transfer
        Interrupt_SRC_I2C0LSREQ  # I2C 0 Last Single Data Transfer
        Interrupt_SRC_I2C0P  # I2C 0 Kernel
        Interrupt_SRC_I2C0SREQ  # I2C 0 Single Data Transfer
        Interrupt_SRC_LMU  # LMU
        Interrupt_SRC_MSC0SR{0..4}  # MSC 0 SR{0..4}
        Interrupt_SRC_MSC1SR{0..4}  # MSC 1 SR{0..4}
        Interrupt_SRC_PMU00  # PMU 0 SR0
        Interrupt_SRC_PMU01  # PMU 0 SR1
        Interrupt_SRC_PSI50  # PSI5 SR0
        Interrupt_SRC_PSI51  # PSI5 SR1
        Interrupt_SRC_PSI52  # PSI5 SR2
        Interrupt_SRC_PSI53  # PSI5 SR3
        Interrupt_SRC_PSI54  # PSI5 SR4
        Interrupt_SRC_PSI55  # PSI5 SR5
        Interrupt_SRC_PSI56  # PSI5 SR6
        Interrupt_SRC_PSI57  # PSI5 SR7
        Interrupt_SRC_PSI5S{0..7}  # PSI5-S SR{0..7}
        Interrupt_SRC_QSPI0ERR  # QSPI 0 Error
        Interrupt_SRC_QSPI0PT  # QSPI 0 Phase Transition
        Interrupt_SRC_QSPI0RX  # QSPI 0 Receive
        Interrupt_SRC_QSPI0TX  # QSPI 0 Transmit
        Interrupt_SRC_QSPI0U  # QSPI 0 User Defined
        Interrupt_SRC_QSPI1ERR  # QSPI 1 Error
        Interrupt_SRC_QSPI1PT  # QSPI 1 Phase Transition
        Interrupt_SRC_QSPI1RX  # QSPI 1 Receive
        Interrupt_SRC_QSPI1TX  # QSPI 1 Transmit
        Interrupt_SRC_QSPI1U  # QSPI 1 User Defined
        Interrupt_SRC_QSPI2ERR  # QSPI 2 Error
        Interrupt_SRC_QSPI2HC  # QSPI 2 High Speed Capture
        Interrupt_SRC_QSPI2PT  # QSPI 2 Phase Transition
        Interrupt_SRC_QSPI2RX  # QSPI 2 Receive
        Interrupt_SRC_QSPI2TX  # QSPI 2 Transmit
        Interrupt_SRC_QSPI2U  # QSPI 2 User Defined
        Interrupt_SRC_QSPI3ERR  # QSPI 3 Error
        Interrupt_SRC_QSPI3HC  # QSPI 3 High Speed Capture
        Interrupt_SRC_QSPI3PT  # QSPI 3 Phase Transition
        Interrupt_SRC_QSPI3RX  # QSPI 3 Receive
        Interrupt_SRC_QSPI3TX  # QSPI 3 Transmit
        Interrupt_SRC_QSPI3U  # QSPI 3 User Defined
        Interrupt_SRC_RESERVED10  # Reserved SR10
        Interrupt_SRC_RESERVED11  # Reserved SR11
        Interrupt_SRC_SCR  # Stand By Controller
        Interrupt_SRC_SCUDTS  # SCU DTS Busy
        Interrupt_SRC_SCUERU{0..3}  # SCU ERU SR{0..3}
        Interrupt_SRC_SENT{0..5}  # SENT TRIG{0..5}
        Interrupt_SRC_SMU{0..2}  # SMU SR{0..2}
        Interrupt_SRC_STM0SR0  # System Timer 0 SR0
        Interrupt_SRC_STM0SR1  # System Timer 0 SR1
        Interrupt_SRC_STM1SR0  # System Timer 1 SR0
        Interrupt_SRC_STM1SR1  # System Timer 1 SR1
        Interrupt_SRC_VADCCG0SR{0..3}  # VADC Common Group 0 SR{0..3}
        Interrupt_SRC_VADCCG1SR{0..3}  # VADC Common Group 1 SR{0..3}
        Interrupt_SRC_VADCG0SR{0..3}  # VADC Group 0 SR{0..3}
        Interrupt_SRC_VADCG1SR{0..3}  # VADC Group 1 SR{0..3}
        Interrupt_SRC_VADCG2SR{0..3}  # VADC Group 2 SR{0..3}
        Interrupt_SRC_VADCG3SR{0..3}  # VADC Group 3 SR{0..3}
        Interrupt_SRC_XBARSRC  # XBAR_SRI
      enumeration OsIsrPriority: origin=ETAS-RTA-TriCoreHighTec_TC26xB_v5.0.14  # ISR Priority
        IPL_{1..256}  # Prio_{1..256}
      reference OsIsrResourceRef [0..*]: multiplicity set at pre-compile, set at pre-compile, destination=OsResource  # This reference defines the resources accessed by this ISR.
      reference OsRegSetRef [0..*]: origin=ETAS-RTA-OS_v5.7.0, set at pre-compile, destination=OsRegSet  # A reference to the register sets that are used by this ISR.
      container OsIsrTimingProtection [0..1]  # This container contains all parameters which are related to timing protection | If the container exists, the timing protection is used for this interrupt. If the container does not exist, the interrupt is not supervised regarding timing violations.
        float OsIsrAllInterruptLockBudget [0..1]: 0..Inf, scope=ECU, multiplicity set at pre-compile, set at pre-compile  # This parameter contains the maximum time for which the ISR is allowed to lock all interrupts (via SuspendAllInterrupts() or DisableAllInterrupts()) (in seconds).
        float OsIsrExecutionBudget [0..1]: 0..Inf, scope=ECU, multiplicity set at pre-compile, set at pre-compile  # The parameter contains the maximum allowed execution time of the interrupt (in seconds).
        float OsIsrOsInterruptLockBudget [0..1]: 0..Inf, scope=ECU, multiplicity set at pre-compile, set at pre-compile  # This parameter contains the maximum time for which the ISR is allowed to lock all Category 2 interrupts (via SuspendOSInterrupts()) (in seconds).
        float OsIsrTimeFrame [0..1]: 0..Inf, scope=ECU, multiplicity set at pre-compile, set at pre-compile  # This parameter contains the minimum inter-arrival time between successive interrupts (in seconds).
        container OsIsrResourceLock [0..*]  # This container contains a list of times the interrupt uses resources.
          float OsIsrResourceLockBudget: 0..Inf, scope=ECU, set at pre-compile  # This parameter contains the maximum time the interrupt is allowed to hold the given resource (in seconds).
          reference OsIsrResourceLockResourceRef: scope=ECU, set at pre-compile, destination=OsResource  # Reference to the resource the locking time is depending on
    container OsOS  # OS is the object used to define OSEK OS properties for an OSEK application. | Per CPU exactly one OS object has to be defined.
      integer OsCyclesPerSecond [0..1]: 0.., origin=ETAS-RTA-OS_v5.7.0, set at pre-compile  # Defines the clock speed of the target.
      string OsDefCat1Stack [0..1]: origin=ETAS-RTA-OS_v5.7.0, set at pre-compile  # Default category 1 stack values. Multiple parameters indicate the target supports multiple stacks.
      string OsDefCat2Stack [0..1]: origin=ETAS-RTA-OS_v5.7.0, set at pre-compile  # Default category 2 stack values. Multiple parameters indicate the target supports multiple stacks.
      string OsDefTaskStack [0..1]: origin=ETAS-RTA-OS_v5.7.0, set at pre-compile  # Default task stack values. Multiple parameters indicate the target supports multiple stacks.
      function name OsDefaultInterrupt [0..1]: origin=ETAS-RTA-OS_v5.7.0, set at pre-compile  # The name of a handler that catches any unhandled interrupt.
      integer OsNumberOfCores [0..1]: 1..65535, multiplicity set at pre-compile, set at pre-compile  # Maximum number of cores that are controlled by the OS. | The OS uses the value internally. It depends on the ECU HW.
      enumeration OsScalabilityClass [0..1]: {SC1, SC2, SC3, SC4}, scope=ECU, set at pre-compile  # A scalability class for each System Object "OS" has to be selected. In order to customize the operating system to the needs of the user and to take full advantage of the processor features the operating system can be scaled according to the scalability classes. | If the scalability class is omitted this translates to the OIL AUTO mechanism.
      boolean OsStackMonitoring: scope=ECU, set at pre-compile  # Select stack monitoring of Tasks/Category 2 ISRs | true: Stacks are monitored false: Stacks are not monitored
      enumeration OsStatus: {EXTENDED, STANDARD}, set at pre-compile  # The Status attribute specifies whether a system with standard or extended status has to be used. Automatic assignment is not supported for this attribute.
      boolean OsSuppressVectorGen [0..1]: origin=ETAS-RTA-OS_v5.7.0, set at pre-compile, default-value=false  # Suppresses generation of the vector table. Default if absent is false.
      integer OsTicksPerSecond [0..1]: 0.., origin=ETAS-RTA-OS_v5.7.0, set at pre-compile  # Defines the stopwatch speed of the target.
      boolean OsUseGetServiceId: set at pre-compile  # As defined by OSEK
      boolean OsUseParameterAccess: set at pre-compile  # As defined by OSEK
      boolean OsUseResScheduler: set at pre-compile, default-value=true  # The OsUseResScheduler attribute defines whether the resource RES_SCHEDULER is used within the application.
      container OsHooks  # Container to structure all hooks belonging to the OS
        boolean OsErrorHook: set at pre-compile  # Error hook as defined by OSEK | true: Hook is called false: Hook is not called
        boolean OsPostTaskHook: set at pre-compile  # Post-task hook as defined by OSEK | true: Hook is called false: Hook is not called
        boolean OsPreTaskHook: set at pre-compile  # Pre-task hook as defined by OSEK | true: Hook is called false: Hook is not called
        boolean OsProtectionHook [0..1]: scope=ECU, multiplicity set at pre-compile, set at pre-compile  # Switch to enable/disable the call to the (user supplied) protection hook. | true: Protection hook is called on protection error false: Protection hook is not called
        boolean OsShutdownHook: set at pre-compile  # Shutdown hook as defined by OSEK | true: Hook is called false: Hook is not called
        boolean OsStackFaultHook [0..1]: origin=ETAS-RTA-OS_v5.7.0, set at pre-compile, default-value=false  # Use stack fault hook. Default if absent is false.
        boolean OsStartupHook: set at pre-compile  # Startup hook as defined by OSEK | true: Hook is called false: Hook is not called
      container Param [0..*]  # OS-specific parameter representation.
        container core_local [0..1]  # If true, multicore applications will have their core-local data put into separate MemMap sections so that they can be located locally to each appropriate processor core. Defaults to FALSE.
          boolean VALUE: origin=ETAS-RTA-OS, set at pre-compile  # Value for Optimize for core-local memory
        container lightweight [0..1]  # Declare that ChainTask() and TerminateTask() are only used in the Task entry function and their return value is not checked. This allows the OS to optimize task termination. Defaults to FALSE.
          boolean VALUE: origin=ETAS-RTA-OS, set at pre-compile  # Value for Fast Terminate
        container no_upward_activation [0..1]  # Declare that no task activates a higher priority task using ActivateTask or SetEvent. This allows the OS to optimize the time taken to activate tasks. Defaults to FALSE.
          boolean VALUE: origin=ETAS-RTA-OS, set at pre-compile  # Value for Disallow upwards activation
        container no_chain [0..1]  # Declare that ChainTask will not be used. This allows the OS to optimize task switching time. Defaults to FALSE.
          boolean VALUE: origin=ETAS-RTA-OS, set at pre-compile  # Value for Disallow ChainTask()
        container no_schedule [0..1]  # Declare that Schedule() will not be used. This can reduce the worst-case stack size of a system. Defaults to FALSE.
          boolean VALUE: origin=ETAS-RTA-OS, set at pre-compile  # Value for Disallow Schedule()
        container optimize_schedule [0..1]  # Changes the implementation of the Schedule() macro in order to avoid the run-time overhead of making a full OS call in cases where the OS can quickly determine that the OS call would have no effect. The return type of Schedule() should be assumed to be void when this is selected. Defaults to FALSE.
          boolean VALUE: origin=ETAS-RTA-OS, set at pre-compile  # Value for Optimize Schedule()
        container std_sc34_checks [0..1]  # Allow STANDARD Status to be selected in Scalability Class 3 or 4 to reduce error checking overheads. AUTOSAR does not normally allow this. Defaults to FALSE.
          boolean VALUE: origin=ETAS-RTA-OS, set at pre-compile  # Value for Allow STANDARD Status in SC3/SC4
        container sc234_alarmcallbacks [0..1]  # Allow Alarm Callbacks in any Scalability Class. AUTOSAR normally only allows these in SC1. Defaults to FALSE.
          boolean VALUE: origin=ETAS-RTA-OS, set at pre-compile  # Value for Allow Alarm Callbacks in SC2/SC3/SC4
        container no_ecc_activate_in_wait [0..1]  # ECC Tasks are normally activated once and do not terminate. When this is the case, RTA-OS can optimize task activation code by omitting the extra run-time checks to see if a task is WAITING. Defaults to TRUE.
          boolean VALUE: origin=ETAS-RTA-OS, set at pre-compile  # Value for Omit activation checks for WAITING state
        container async_tasks [0..1]  # The ActivateTask and SetEvent APIs change so that cross-core invocations no longer use an internal spinlock to coordinate between cores. Instead a message is sent to a queue on the core that owns the Task, and that core performs the required operation. When this option is in effect, the E_OS_LIMIT error can not be detected for cross-core activations. A different error E_OS_SYS_XCORE_QFULL may be seen if the queue on the receiving core is full. See the option 'AsyncQ' for how to avoid this. Defaults to FALSE.
          boolean VALUE: origin=ETAS-RTA-OS, set at pre-compile  # Value for Asynchronous TASK activation
        container asyn_apis [0..1]  # These APIs were added in AUTOSAR V4.4.0. RTA-OS allows them to be used in any AUTOSAR version. This option has to be used to cause them to be generated because they add a small amount of extra run-time overhead. These APIs use the same mechanism that is used for the 'Asynchronous TASK activation' option, but allow you to have both synchronous and asynchronous versions at the same time. Defaults to FALSE.
          boolean VALUE: origin=ETAS-RTA-OS, set at pre-compile  # Value for Support ActivateTaskAsyn and SetEventAsyn
        container async_qlen [0..1]  # This option can be used to specify the size of the queue used when the 'Asynchronous TASK activation' or 'Support ActivateTaskAsyn and SetEventAsyn' options are in effect. The default queue size is 10 for each core. Specify one decimal number per core, using comma separators. A value 0 may only be used for cores that have no cross-core activation.
          string VALUE: origin=ETAS-RTA-OS, set at pre-compile  # Value for AsyncQ
        container timing_interrupt [0..1]  # TRUE to use a Category 1 Interrupt to enforce Timing Protection. When this is TRUE and timing protection is configured, you must respond to the Os_Cbk_SetTimeLimit and Os_Cbk_SuspendTimeLimit callbacks and call Os_TimingFaultDetected if the interrupt fires without being suspended. You must create and configure the interrupt. Each OS core should have its own Category 1 Timing Protection Interrupt. Defaults to FALSE.
          boolean VALUE: origin=ETAS-RTA-OS, set at pre-compile  # Value for Timing Protection Interrupt
        container no_timing_protection [0..1]  # Timing protection features are included in the OS if any Task or ISR is configured with Timing Protection values. This option allows you to omit all timing protection checks. Defaults to FALSE.
          boolean VALUE: origin=ETAS-RTA-OS, set at pre-compile  # Value for Omit Timing Protection
        container function_protection [0..1]  # Adds the ability to police execution limits and recover from memory protection exceptions in OS Application functions. The API CallAndProtectFunction extends CallTrustedFunction by adding an execution time limit, and the ability to terminate a function. Defaults to FALSE.
          boolean VALUE: origin=ETAS-RTA-OS, set at pre-compile  # Value for Add Function Protection
        container no_memory_protection [0..1]  # Memory protection features are included in the OS if there are any OS applications that are Untrusted or have TrustedApplicationWithProtection set true. This option allows you to omit all memory protection features. Defaults to FALSE.
          boolean VALUE: origin=ETAS-RTA-OS, set at pre-compile  # Value for Omit Memory Protection
        container protection_allows_os_reads [0..1]  # When memory protection is enabled, it is assumed that untrusted code may not read OS variables. All OS service calls therefore switch the processor into protected mode. If, however, your memory protection strategy allows read-access to OS data then certain APIs can be optimized to avoid this mode switch because they only read OS data. (Also applies to OS Application that have TrustedApplicationWithProtection set to true. Defaults to FALSE.)
          boolean VALUE: origin=ETAS-RTA-OS, set at pre-compile  # Value for Untrusted code can read OS data
        container single_zone_protection [0..1]  # If all code that is subject to memory protection can run with a single set of MPU values, then the MPU can be set up before starting the OS and there is no need to call Os_Cbk_SetMemoryAccess. This option allows you to omit the Os_Cbk_SetMemoryAccess call. Defaults to FALSE.
          boolean VALUE: origin=ETAS-RTA-OS, set at pre-compile  # Value for Single Memory Protection Zone
        container stack_only_protection [0..1]  # If you want to run all untrusted code with the same basic memory protection settings but apply protection to the stack, then the OS only has to pass the stack-related fields (Address and Size) plus Application to Os_Cbk_SetMemoryAccess. This option removes the Task, ISR and Function values from the callback. (Also applies to OS Application that have TrustedApplicationWithProtection set to true.) Defaults to FALSE.
          boolean VALUE: origin=ETAS-RTA-OS, set at pre-compile  # Value for Stack Only Memory Protection
        container no_service_protection [0..1]  # AUTOSAR expects extra service protection checks to be applied in SC3 and SC4. This option allows you to omit these checks. Defaults to FALSE.
          boolean VALUE: origin=ETAS-RTA-OS, set at pre-compile  # Value for Omit Service Protection in SC3/SC4
        container no_terminate_application [0..1]  # The TerminateApplication API is normally supported in the OS if there are any OS applications. This option allows you to omit support for TerminateApplication() and reduce system overheads. Defaults to FALSE.
          boolean VALUE: origin=ETAS-RTA-OS, set at pre-compile  # Value for Omit TerminateApplication
        container only_terminate_untrusted [0..1]  # By default, Trusted OS Applications can be terminated if there is a Timing Protection violation or TerminateApplication() is called. Setting this option tells the OS not to terminate trusted code. This can result in run-time savings. Defaults to FALSE.
          boolean VALUE: origin=ETAS-RTA-OS, set at pre-compile  # Value for Only Terminate Untrusted Applications
        container meter_execution [0..1]  # Record the execution times for Tasks and Category 2 ISRs. Defaults to FALSE.
          boolean VALUE: origin=ETAS-RTA-OS, set at pre-compile  # Value for Enable Time Monitoring
        container meter_elapsed_time [0..1]  # Accumulate the total execution time for Tasks, Category 2 ISRs and Idle. Defaults to FALSE. (Requires Time Recording to be enabled)
          boolean VALUE: origin=ETAS-RTA-OS, set at pre-compile  # Value for Enable Elapsed Time Recording
        container monitor_activations [0..1]  # Record the activation times for Tasks. Defaults to FALSE.
          boolean VALUE: origin=ETAS-RTA-OS, set at pre-compile  # Value for Enable Activation Monitoring
        container delayed_tasks [0..1]  # Adds support for the APIs Os_SetDelayedTasks, Os_AddDelayedTasks and Os_RemoveDelayedTasks. Defaults to FALSE.
          boolean VALUE: origin=ETAS-RTA-OS, set at pre-compile  # Value for Support Delayed Task Execution
        container metrics [0..1]  # Collects run-time information about how often OS features get used. Refer to Os_Metrics.h to see what data gets collected. Defaults to FALSE.
          boolean VALUE: origin=ETAS-RTA-OS, set at pre-compile  # Value for Collect OS usage metrics
        container task_lifetime_hooks [0..1]  # Adds support for Os_Cbk_TaskStart and Os_Cbk_TaskEnd hooks. These act like Pre/Post Task hooks but don't get called when the task is pre-empted. Defaults to FALSE.
          boolean VALUE: origin=ETAS-RTA-OS, set at pre-compile  # Value for Additional Task Hooks
        container task_activation_hooks [0..1]  # Adds support for Os_Cbk_TaskActivated hook. This gets called each time a Task is successfully activated. Defaults to FALSE.
          boolean VALUE: origin=ETAS-RTA-OS, set at pre-compile  # Value for Task Activation Hook
        container isr_lifetime_hooks [0..1]  # Adds support for Os_Cbk_ISRStart, Os_Cbk_ISREnd, Os_Cbk_CrosscoreISRStart and Os_Cbk_CrosscoreISREnd hooks. These get called when an Category 2 or Crosscore ISR starts/ends. They don't get called again if the ISR is pre-empted. Defaults to FALSE.
          boolean VALUE: origin=ETAS-RTA-OS, set at pre-compile  # Value for Additional ISR Hooks
        container spinlock_info [0..1]  # Adds support for the GetSpinlockInfo API. Additional run-time statistics are recorded for spinlocks and the GetSpinlockInfo is supported to provide access to them. Defaults to FALSE.
          boolean VALUE: origin=ETAS-RTA-OS, set at pre-compile  # Value for Provide spinlock statistics
        container spinlock_std_check [0..1]  # The spinlock APIs do not check for errors in STANDARD status builds. This option can be used to force the spinlock checks in both EXTENDED and STANDARD status builds. Defaults to FALSE.
          boolean VALUE: origin=ETAS-RTA-OS, set at pre-compile  # Value for Force spinlock error checks
        container unchecked_spinlocks [0..1]  # The AUTOSAR spinlock APIs may only be called from TASKs or Category 2 ISRs. This option can be used to cause 3 new APIs UncheckedGetSpinlock, UncheckedTryToGetSpinlock and UncheckedReleaseSpinlock to be generated. These can be called from Category 1 ISRs, but the error checking that can be applied is much restricted so they should be used with care. Defaults to FALSE.
          boolean VALUE: origin=ETAS-RTA-OS, set at pre-compile  # Value for Add Spinlock APIs for CAT1 ISRs
        container stack_sampling [0..1]  # Adds support for Os_Cbk_CheckStackDepth hook. It gets called when a TASK or Category 2 ISR starts. It also gets called from within the Os_GetStackUsage API. Defaults to FALSE.
          boolean VALUE: origin=ETAS-RTA-OS, set at pre-compile  # Value for Stack Sampling
        container memmap_level [0..1]  # Select how the AUTOSAR MemMap inclusion mechanism applied to OS code.
          enumeration VALUE: origin=ETAS-RTA-OS, set at pre-compile  # Value for MemMap level
            NONE  # Omit MemMap includes
            DECLARATION  # MemMap inclusions are used around declarations
            FULL  # MemMap inclusions are used for declarations and definitions/externs (default)
        container ioc_data [0..1]  # Allows control over the MemMap sections used for some internal IOC data buffers.
          enumeration VALUE: origin=ETAS-RTA-OS, set at pre-compile  # Value for IOC Data
            Global  # Use OS VAR section
            Core  # Use VAR_CORE{n} section for communications that run on a single core (default)
            Writer  # Use _SEC_{app}_VAR section, where {app} is the OS Application of the sender so that writes do not need to change the processor protection mode
        container ioc_code [0..1]  # Allows control over the MemMap sections used for IOC API code.
          enumeration VALUE: origin=ETAS-RTA-OS, set at pre-compile  # Value for IOC Code
            OS  # Use standard OS code section (default)
            Caller  # Use ..._SEC_{app}_LIB section, where {app} is the OS Application of the API caller
        container no_ioc_optimization [0..1]  # RTA-RTE is able to provide RTA-OS with additional call-pattern information so that the IOC code can be better optimized. Set this option to TRUE to disable these optimizations. Defaults to FALSE.
          boolean VALUE: origin=ETAS-RTA-OS, set at pre-compile  # Value for Disable IOC optimizations
        container ioc_blocking_threshold [0..1]  # IOC code optimizations for RTA-RTE can result in data transfers for many IOC communications being performed in a single batch operation. Interrupts may be disabled during this transfer, which may block higher priority code from running. Setting a non-zero value here controls the number of bytes that will be transferred in a batch. Note that because transfers for each communication must not be split, a batch might be slightly bigger than the value specified.
          string VALUE: origin=ETAS-RTA-OS, set at pre-compile  # Value for IOC blocking threshold
        container omit_default_implementations [0..1]  # RTA-OS normally provides default implementations for Os_Cbk_Idle, Os_Cbk_InShutdown and Os_Cbk_StackOverrunHook in the generated library. Set this option to TRUE to omit these functions from the library. Defaults to FALSE.
          boolean VALUE: origin=ETAS-RTA-OS, set at pre-compile  # Value for Omit Default Implementations
        container allow_rte_task_terminations [0..1]  # RTA-RTE does not support termination of its tasks part way through execution. If the configuration contains RTE-related information, the OS will remove the ability to terminate tasks from the OS library unless this option is set to TRUE. This means that errors such as timing budget overruns must result in shutdown or reset of the ECU. Defaults to FALSE when RTA-RTE is detected in the configuration.
          boolean VALUE: origin=ETAS-RTA-OS, set at pre-compile  # Value for Allow RTE TASK terminations
    container OsRTATarget [0..1]  # Parameters to represent a specific piece of target hardware.
      string OsRTATargetName: origin=ETAS-RTA-OS_v5.7.0, set at pre-compile  # The name of the target system.
      string OsRTATargetVersion [0..1]: origin=ETAS-RTA-OS_v5.7.0, set at pre-compile  # The version number of the target.
      enumeration OsRTATargetVariant: {TC26xB}, origin=ETAS-RTA-OS_v6.0.0  # Target Variant
      container Param [0..*]  # Target-specific parameter representation.
        container SpPreStartOS [0..1]  # The amount of stack already in use at the point that StartOS() is called. This value is simply added to the total stack size that the OS needs to support all tasks and interrupts at run-time. Typically you use this to obtain the amount of stack that the linker must allocate. The value does not normally change if the OS configuration changes.
          string VALUE: origin=ETAS-RTA-OS, set at pre-compile  # Value for Stack used for C-startup
        container SpStartOS [0..1]  # The amount of stack used when the OS is in the idle state (typically inside Os_Cbk_Idle()). This is just the difference between the stack used at the point that Os_StartOS() is called and the stack used when no task or interrupt is running. This can be zero if Os_Cbk_Idle() is not used. It must include the stack used by any function called while in the idle state. The value does not normally change if the OS configuration changes.
          string VALUE: origin=ETAS-RTA-OS, set at pre-compile  # Value for Stack used when idle
        container SpIDisp [0..1]  # The extra amount of stack needed to activate a task from within an ISR. If a task is activated within a Category 2 ISR, and that task has a higher priority than any currently running task, then for some targets the OS may need to use marginally more stack than if it activates a task that is of lower priority. This value accounts for that. On most targets this value is zero. This value is used in worst-case stack size calculations. The value may change if significant changes are made to the OS configuration. e.g. STANDARD/EXTENDED, SC1/2/3/4.
          string VALUE: origin=ETAS-RTA-OS, set at pre-compile  # Value for Stack overheads for ISR activation
        container SpECC [0..1]  # The extra amount of stack needed to start an ECC task. ECC tasks need to save slightly more state on the stack when they are started than BCC tasks. This value contains the difference. The value may change if significant changes are made to the OS configuration. e.g. STANDARD/EXTENDED, SC1/2/3/4.
          string VALUE: origin=ETAS-RTA-OS, set at pre-compile  # Value for Stack overheads for ECC tasks
        container SpPreemption [0..1]  # The amount of stack used to service a Category 2 ISR. When a Category 2 ISR interrupts a task, it usually places some data on the stack. If the ISR measures the stack to determine if the preempted task has exceeded its stack budget, then it will overestimate the stack usage unless this value is subtracted from the measured size. The value is also used when calculating the worst-case stack usage of the system. Be careful to set this value accurately. If its value is too high then when the subtraction occurs, 32-bit underflow can occur and cause the OS to think that a budget overrun has been detected. The value may change if significant changes are made to the OS configuration. e.g. STANDARD/EXTENDED, SC1/2/3/4.
          string VALUE: origin=ETAS-RTA-OS, set at pre-compile  # Value for Stack overheads for ISR
        container Orti22Lauterbach [0..1]  # Select ORTI generation for the Lauterbach debugger.
          boolean VALUE: origin=ETAS-RTA-OS, set at pre-compile  # Value for ORTI/Lauterbach
        container Orti21winIDEA [0..1]  # Select ORTI generation for winIDEA debugger.
          boolean VALUE: origin=ETAS-RTA-OS, set at pre-compile  # Value for ORTI/winIDEA
        container OrtiStackFill [0..1]  # Expands ORTI information to cover stack address, size and fill pattern details to support debugger stack usage monitoring.
          boolean VALUE: origin=ETAS-RTA-OS, set at pre-compile  # Value for ORTI Stack Fill
        container winIDEAAnalyzer [0..1]  # Adds support for the winIDEA profiler to track ORTI items.
          boolean VALUE: origin=ETAS-RTA-OS, set at pre-compile  # Value for Support winIDEA Analyzer
        container OrtiSMPProposal [0..1]  # Emit ORTI according to the ORTI_SMP_Proposal_v4.pdf (multicore only).
          boolean VALUE: origin=ETAS-RTA-OS, set at pre-compile  # Value for ORTI/SMP
        container CrossCoreSRC0 [0..1]  # Optionally specify the SRC assigned to the cross-core interrupt for core 0. A free register will be selected automatically if one is not specified. Multicore only.
          enumeration VALUE: {SRC_AGBT, SRC_ASCLIN0ERR, SRC_ASCLIN0RX, SRC_ASCLIN0TX, SRC_ASCLIN1ERR, SRC_ASCLIN1RX, SRC_ASCLIN1TX, SRC_ASCLIN2ERR, SRC_ASCLIN2RX, SRC_ASCLIN2TX, SRC_ASCLIN3ERR, SRC_ASCLIN3RX, SRC_ASCLIN3TX, SRC_BCUSPBSBSRC, SRC_CANINT0, SRC_CANINT1, SRC_CANINT10, SRC_CANINT11, SRC_CANINT12, SRC_CANINT13, SRC_CANINT14, SRC_CANINT15, SRC_CANINT2, SRC_CANINT3, SRC_CANINT4, SRC_CANINT5, SRC_CANINT6, SRC_CANINT7, SRC_CANINT8, SRC_CANINT9, SRC_CCU60SR0, SRC_CCU60SR1, SRC_CCU60SR2, SRC_CCU60SR3, SRC_CCU61SR0, SRC_CCU61SR1, SRC_CCU61SR2, SRC_CCU61SR3, SRC_CERBERUS0, SRC_CERBERUS1, SRC_CIFISP, SRC_CIFMI, SRC_CIFMIEP, SRC_CIFMJPEG, SRC_CPU0SBSRC, SRC_CPU1SBSRC, SRC_DMACH0, SRC_DMACH1, SRC_DMACH10, SRC_DMACH11, SRC_DMACH12, SRC_DMACH13, SRC_DMACH14, SRC_DMACH15, SRC_DMACH16, SRC_DMACH17, SRC_DMACH18, SRC_DMACH19, SRC_DMACH2, SRC_DMACH20, SRC_DMACH21, SRC_DMACH22, SRC_DMACH23, SRC_DMACH24, SRC_DMACH25, SRC_DMACH26, SRC_DMACH27, SRC_DMACH28, SRC_DMACH29, SRC_DMACH3, SRC_DMACH30, SRC_DMACH31, SRC_DMACH32, SRC_DMACH33, SRC_DMACH34, SRC_DMACH35, SRC_DMACH36, SRC_DMACH37, SRC_DMACH38, SRC_DMACH39, SRC_DMACH4, SRC_DMACH40, SRC_DMACH41, SRC_DMACH42, SRC_DMACH43, SRC_DMACH44, SRC_DMACH45, SRC_DMACH46, SRC_DMACH47, SRC_DMACH5, SRC_DMACH6, SRC_DMACH7, SRC_DMACH8, SRC_DMACH9, SRC_DMAERR, SRC_DSADCSRA0, SRC_DSADCSRA2, SRC_DSADCSRA3, SRC_DSADCSRM0, SRC_DSADCSRM2, SRC_DSADCSRM3, SRC_EMEM, SRC_ERAYIBUSY, SRC_ERAYINT0, SRC_ERAYINT1, SRC_ERAYMBSC0, SRC_ERAYMBSC1, SRC_ERAYNDAT0, SRC_ERAYNDAT1, SRC_ERAYOBUSY, SRC_ERAYTINT0, SRC_ERAYTINT1, SRC_ETH, SRC_FCE, SRC_FFTDONE, SRC_FFTERR, SRC_FFTRFS, SRC_GPSR00, SRC_GPSR01, SRC_GPSR02, SRC_GPSR03, SRC_GPSR10, SRC_GPSR11, SRC_GPSR12, SRC_GPSR13, SRC_GPT120CIRQ, SRC_GPT120T2, SRC_GPT120T3, SRC_GPT120T4, SRC_GPT120T5, SRC_GPT120T6, SRC_GTMAEIIRQ, SRC_GTMARUIRQ0, SRC_GTMARUIRQ1, SRC_GTMARUIRQ2, SRC_GTMATOM00, SRC_GTMATOM01, SRC_GTMATOM02, SRC_GTMATOM03, SRC_GTMATOM10, SRC_GTMATOM11, SRC_GTMATOM12, SRC_GTMATOM13, SRC_GTMATOM20, SRC_GTMATOM21, SRC_GTMATOM22, SRC_GTMATOM23, SRC_GTMATOM30, SRC_GTMATOM31, SRC_GTMATOM32, SRC_GTMATOM33, SRC_GTMBRCIRQ, SRC_GTMCMPIRQ, SRC_GTMDPLL0, SRC_GTMDPLL1, SRC_GTMDPLL10, SRC_GTMDPLL11, SRC_GTMDPLL12, SRC_GTMDPLL13, SRC_GTMDPLL14, SRC_GTMDPLL15, SRC_GTMDPLL16, SRC_GTMDPLL17, SRC_GTMDPLL18, SRC_GTMDPLL19, SRC_GTMDPLL2, SRC_GTMDPLL20, SRC_GTMDPLL21, SRC_GTMDPLL22, SRC_GTMDPLL23, SRC_GTMDPLL24, SRC_GTMDPLL25, SRC_GTMDPLL26, SRC_GTMDPLL3, SRC_GTMDPLL4, SRC_GTMDPLL5, SRC_GTMDPLL6, SRC_GTMDPLL7, SRC_GTMDPLL8, SRC_GTMDPLL9, SRC_GTMERR, SRC_GTMMCS00, SRC_GTMMCS01, SRC_GTMMCS02, SRC_GTMMCS03, SRC_GTMMCS04, SRC_GTMMCS05, SRC_GTMMCS06, SRC_GTMMCS07, SRC_GTMMCS10, SRC_GTMMCS11, SRC_GTMMCS12, SRC_GTMMCS13, SRC_GTMMCS14, SRC_GTMMCS15, SRC_GTMMCS16, SRC_GTMMCS17, SRC_GTMMCS20, SRC_GTMMCS21, SRC_GTMMCS22, SRC_GTMMCS23, SRC_GTMMCS24, SRC_GTMMCS25, SRC_GTMMCS26, SRC_GTMMCS27, SRC_GTMMCSW00, SRC_GTMMCSW01, SRC_GTMMCSW02, SRC_GTMMCSW10, SRC_GTMMCSW11, SRC_GTMMCSW12, SRC_GTMPSM00, SRC_GTMPSM01, SRC_GTMPSM02, SRC_GTMPSM03, SRC_GTMPSM04, SRC_GTMPSM05, SRC_GTMPSM06, SRC_GTMPSM07, SRC_GTMSPE0IRQ, SRC_GTMSPE1IRQ, SRC_GTMTIM00, SRC_GTMTIM01, SRC_GTMTIM02, SRC_GTMTIM03, SRC_GTMTIM04, SRC_GTMTIM05, SRC_GTMTIM06, SRC_GTMTIM07, SRC_GTMTIM10, SRC_GTMTIM11, SRC_GTMTIM12, SRC_GTMTIM13, SRC_GTMTIM14, SRC_GTMTIM15, SRC_GTMTIM16, SRC_GTMTIM17, SRC_GTMTIM20, SRC_GTMTIM21, SRC_GTMTIM22, SRC_GTMTIM23, SRC_GTMTIM24, SRC_GTMTIM25, SRC_GTMTIM26, SRC_GTMTIM27, SRC_GTMTOM00, SRC_GTMTOM01, SRC_GTMTOM02, SRC_GTMTOM03, SRC_GTMTOM04, SRC_GTMTOM05, SRC_GTMTOM06, SRC_GTMTOM07, SRC_GTMTOM10, SRC_GTMTOM11, SRC_GTMTOM12, SRC_GTMTOM13, SRC_GTMTOM14, SRC_GTMTOM15, SRC_GTMTOM16, SRC_GTMTOM17, SRC_HSCT, SRC_HSSLCOK0, SRC_HSSLCOK1, SRC_HSSLCOK2, SRC_HSSLCOK3, SRC_HSSLERR0, SRC_HSSLERR1, SRC_HSSLERR2, SRC_HSSLERR3, SRC_HSSLEXI, SRC_HSSLRDI0, SRC_HSSLRDI1, SRC_HSSLRDI2, SRC_HSSLRDI3, SRC_HSSLTRG0, SRC_HSSLTRG1, SRC_HSSLTRG2, SRC_HSSLTRG3, SRC_I2C0BREQ, SRC_I2C0ERR, SRC_I2C0LBREQ, SRC_I2C0LSREQ, SRC_I2C0P, SRC_I2C0SREQ, SRC_LMU, SRC_MSC0SR0, SRC_MSC0SR1, SRC_MSC0SR2, SRC_MSC0SR3, SRC_MSC0SR4, SRC_MSC1SR0, SRC_MSC1SR1, SRC_MSC1SR2, SRC_MSC1SR3, SRC_MSC1SR4, SRC_PMU00, SRC_PMU01, SRC_PSI50, SRC_PSI51, SRC_PSI52, SRC_PSI53, SRC_PSI54, SRC_PSI55, SRC_PSI56, SRC_PSI57, SRC_PSI5S0, SRC_PSI5S1, SRC_PSI5S2, SRC_PSI5S3, SRC_PSI5S4, SRC_PSI5S5, SRC_PSI5S6, SRC_PSI5S7, SRC_QSPI0ERR, SRC_QSPI0PT, SRC_QSPI0RX, SRC_QSPI0TX, SRC_QSPI0U, SRC_QSPI1ERR, SRC_QSPI1PT, SRC_QSPI1RX, SRC_QSPI1TX, SRC_QSPI1U, SRC_QSPI2ERR, SRC_QSPI2HC, SRC_QSPI2PT, SRC_QSPI2RX, SRC_QSPI2TX, SRC_QSPI2U, SRC_QSPI3ERR, SRC_QSPI3HC, SRC_QSPI3PT, SRC_QSPI3RX, SRC_QSPI3TX, SRC_QSPI3U, SRC_RESERVED10, SRC_RESERVED11, SRC_SCR, SRC_SCUDTS, SRC_SCUERU0, SRC_SCUERU1, SRC_SCUERU2, SRC_SCUERU3, SRC_SENT0, SRC_SENT1, SRC_SENT2, SRC_SENT3, SRC_SENT4, SRC_SENT5, SRC_SMU0, SRC_SMU1, SRC_SMU2, SRC_STM0SR0, SRC_STM0SR1, SRC_STM1SR0, SRC_STM1SR1, SRC_VADCCG0SR0, SRC_VADCCG0SR1, SRC_VADCCG0SR2, SRC_VADCCG0SR3, SRC_VADCCG1SR0, SRC_VADCCG1SR1, SRC_VADCCG1SR2, SRC_VADCCG1SR3, SRC_VADCG0SR0, SRC_VADCG0SR1, SRC_VADCG0SR2, SRC_VADCG0SR3, SRC_VADCG1SR0, SRC_VADCG1SR1, SRC_VADCG1SR2, SRC_VADCG1SR3, SRC_VADCG2SR0, SRC_VADCG2SR1, SRC_VADCG2SR2, SRC_VADCG2SR3, SRC_VADCG3SR0, SRC_VADCG3SR1, SRC_VADCG3SR2, SRC_VADCG3SR3, SRC_XBARSRC}, origin=ETAS-RTA-OS, set at pre-compile  # Value for CrossCore SRC0
        container CrossCoreSRC1 [0..1]  # Optionally specify the SRC assigned to the cross-core interrupt for core 1. A free register will be selected automatically if one is not specified. Multicore only.
          enumeration VALUE: {SRC_AGBT, SRC_ASCLIN0ERR, SRC_ASCLIN0RX, SRC_ASCLIN0TX, SRC_ASCLIN1ERR, SRC_ASCLIN1RX, SRC_ASCLIN1TX, SRC_ASCLIN2ERR, SRC_ASCLIN2RX, SRC_ASCLIN2TX, SRC_ASCLIN3ERR, SRC_ASCLIN3RX, SRC_ASCLIN3TX, SRC_BCUSPBSBSRC, SRC_CANINT0, SRC_CANINT1, SRC_CANINT10, SRC_CANINT11, SRC_CANINT12, SRC_CANINT13, SRC_CANINT14, SRC_CANINT15, SRC_CANINT2, SRC_CANINT3, SRC_CANINT4, SRC_CANINT5, SRC_CANINT6, SRC_CANINT7, SRC_CANINT8, SRC_CANINT9, SRC_CCU60SR0, SRC_CCU60SR1, SRC_CCU60SR2, SRC_CCU60SR3, SRC_CCU61SR0, SRC_CCU61SR1, SRC_CCU61SR2, SRC_CCU61SR3, SRC_CERBERUS0, SRC_CERBERUS1, SRC_CIFISP, SRC_CIFMI, SRC_CIFMIEP, SRC_CIFMJPEG, SRC_CPU0SBSRC, SRC_CPU1SBSRC, SRC_DMACH0, SRC_DMACH1, SRC_DMACH10, SRC_DMACH11, SRC_DMACH12, SRC_DMACH13, SRC_DMACH14, SRC_DMACH15, SRC_DMACH16, SRC_DMACH17, SRC_DMACH18, SRC_DMACH19, SRC_DMACH2, SRC_DMACH20, SRC_DMACH21, SRC_DMACH22, SRC_DMACH23, SRC_DMACH24, SRC_DMACH25, SRC_DMACH26, SRC_DMACH27, SRC_DMACH28, SRC_DMACH29, SRC_DMACH3, SRC_DMACH30, SRC_DMACH31, SRC_DMACH32, SRC_DMACH33, SRC_DMACH34, SRC_DMACH35, SRC_DMACH36, SRC_DMACH37, SRC_DMACH38, SRC_DMACH39, SRC_DMACH4, SRC_DMACH40, SRC_DMACH41, SRC_DMACH42, SRC_DMACH43, SRC_DMACH44, SRC_DMACH45, SRC_DMACH46, SRC_DMACH47, SRC_DMACH5, SRC_DMACH6, SRC_DMACH7, SRC_DMACH8, SRC_DMACH9, SRC_DMAERR, SRC_DSADCSRA0, SRC_DSADCSRA2, SRC_DSADCSRA3, SRC_DSADCSRM0, SRC_DSADCSRM2, SRC_DSADCSRM3, SRC_EMEM, SRC_ERAYIBUSY, SRC_ERAYINT0, SRC_ERAYINT1, SRC_ERAYMBSC0, SRC_ERAYMBSC1, SRC_ERAYNDAT0, SRC_ERAYNDAT1, SRC_ERAYOBUSY, SRC_ERAYTINT0, SRC_ERAYTINT1, SRC_ETH, SRC_FCE, SRC_FFTDONE, SRC_FFTERR, SRC_FFTRFS, SRC_GPSR00, SRC_GPSR01, SRC_GPSR02, SRC_GPSR03, SRC_GPSR10, SRC_GPSR11, SRC_GPSR12, SRC_GPSR13, SRC_GPT120CIRQ, SRC_GPT120T2, SRC_GPT120T3, SRC_GPT120T4, SRC_GPT120T5, SRC_GPT120T6, SRC_GTMAEIIRQ, SRC_GTMARUIRQ0, SRC_GTMARUIRQ1, SRC_GTMARUIRQ2, SRC_GTMATOM00, SRC_GTMATOM01, SRC_GTMATOM02, SRC_GTMATOM03, SRC_GTMATOM10, SRC_GTMATOM11, SRC_GTMATOM12, SRC_GTMATOM13, SRC_GTMATOM20, SRC_GTMATOM21, SRC_GTMATOM22, SRC_GTMATOM23, SRC_GTMATOM30, SRC_GTMATOM31, SRC_GTMATOM32, SRC_GTMATOM33, SRC_GTMBRCIRQ, SRC_GTMCMPIRQ, SRC_GTMDPLL0, SRC_GTMDPLL1, SRC_GTMDPLL10, SRC_GTMDPLL11, SRC_GTMDPLL12, SRC_GTMDPLL13, SRC_GTMDPLL14, SRC_GTMDPLL15, SRC_GTMDPLL16, SRC_GTMDPLL17, SRC_GTMDPLL18, SRC_GTMDPLL19, SRC_GTMDPLL2, SRC_GTMDPLL20, SRC_GTMDPLL21, SRC_GTMDPLL22, SRC_GTMDPLL23, SRC_GTMDPLL24, SRC_GTMDPLL25, SRC_GTMDPLL26, SRC_GTMDPLL3, SRC_GTMDPLL4, SRC_GTMDPLL5, SRC_GTMDPLL6, SRC_GTMDPLL7, SRC_GTMDPLL8, SRC_GTMDPLL9, SRC_GTMERR, SRC_GTMMCS00, SRC_GTMMCS01, SRC_GTMMCS02, SRC_GTMMCS03, SRC_GTMMCS04, SRC_GTMMCS05, SRC_GTMMCS06, SRC_GTMMCS07, SRC_GTMMCS10, SRC_GTMMCS11, SRC_GTMMCS12, SRC_GTMMCS13, SRC_GTMMCS14, SRC_GTMMCS15, SRC_GTMMCS16, SRC_GTMMCS17, SRC_GTMMCS20, SRC_GTMMCS21, SRC_GTMMCS22, SRC_GTMMCS23, SRC_GTMMCS24, SRC_GTMMCS25, SRC_GTMMCS26, SRC_GTMMCS27, SRC_GTMMCSW00, SRC_GTMMCSW01, SRC_GTMMCSW02, SRC_GTMMCSW10, SRC_GTMMCSW11, SRC_GTMMCSW12, SRC_GTMPSM00, SRC_GTMPSM01, SRC_GTMPSM02, SRC_GTMPSM03, SRC_GTMPSM04, SRC_GTMPSM05, SRC_GTMPSM06, SRC_GTMPSM07, SRC_GTMSPE0IRQ, SRC_GTMSPE1IRQ, SRC_GTMTIM00, SRC_GTMTIM01, SRC_GTMTIM02, SRC_GTMTIM03, SRC_GTMTIM04, SRC_GTMTIM05, SRC_GTMTIM06, SRC_GTMTIM07, SRC_GTMTIM10, SRC_GTMTIM11, SRC_GTMTIM12, SRC_GTMTIM13, SRC_GTMTIM14, SRC_GTMTIM15, SRC_GTMTIM16, SRC_GTMTIM17, SRC_GTMTIM20, SRC_GTMTIM21, SRC_GTMTIM22, SRC_GTMTIM23, SRC_GTMTIM24, SRC_GTMTIM25, SRC_GTMTIM26, SRC_GTMTIM27, SRC_GTMTOM00, SRC_GTMTOM01, SRC_GTMTOM02, SRC_GTMTOM03, SRC_GTMTOM04, SRC_GTMTOM05, SRC_GTMTOM06, SRC_GTMTOM07, SRC_GTMTOM10, SRC_GTMTOM11, SRC_GTMTOM12, SRC_GTMTOM13, SRC_GTMTOM14, SRC_GTMTOM15, SRC_GTMTOM16, SRC_GTMTOM17, SRC_HSCT, SRC_HSSLCOK0, SRC_HSSLCOK1, SRC_HSSLCOK2, SRC_HSSLCOK3, SRC_HSSLERR0, SRC_HSSLERR1, SRC_HSSLERR2, SRC_HSSLERR3, SRC_HSSLEXI, SRC_HSSLRDI0, SRC_HSSLRDI1, SRC_HSSLRDI2, SRC_HSSLRDI3, SRC_HSSLTRG0, SRC_HSSLTRG1, SRC_HSSLTRG2, SRC_HSSLTRG3, SRC_I2C0BREQ, SRC_I2C0ERR, SRC_I2C0LBREQ, SRC_I2C0LSREQ, SRC_I2C0P, SRC_I2C0SREQ, SRC_LMU, SRC_MSC0SR0, SRC_MSC0SR1, SRC_MSC0SR2, SRC_MSC0SR3, SRC_MSC0SR4, SRC_MSC1SR0, SRC_MSC1SR1, SRC_MSC1SR2, SRC_MSC1SR3, SRC_MSC1SR4, SRC_PMU00, SRC_PMU01, SRC_PSI50, SRC_PSI51, SRC_PSI52, SRC_PSI53, SRC_PSI54, SRC_PSI55, SRC_PSI56, SRC_PSI57, SRC_PSI5S0, SRC_PSI5S1, SRC_PSI5S2, SRC_PSI5S3, SRC_PSI5S4, SRC_PSI5S5, SRC_PSI5S6, SRC_PSI5S7, SRC_QSPI0ERR, SRC_QSPI0PT, SRC_QSPI0RX, SRC_QSPI0TX, SRC_QSPI0U, SRC_QSPI1ERR, SRC_QSPI1PT, SRC_QSPI1RX, SRC_QSPI1TX, SRC_QSPI1U, SRC_QSPI2ERR, SRC_QSPI2HC, SRC_QSPI2PT, SRC_QSPI2RX, SRC_QSPI2TX, SRC_QSPI2U, SRC_QSPI3ERR, SRC_QSPI3HC, SRC_QSPI3PT, SRC_QSPI3RX, SRC_QSPI3TX, SRC_QSPI3U, SRC_RESERVED10, SRC_RESERVED11, SRC_SCR, SRC_SCUDTS, SRC_SCUERU0, SRC_SCUERU1, SRC_SCUERU2, SRC_SCUERU3, SRC_SENT0, SRC_SENT1, SRC_SENT2, SRC_SENT3, SRC_SENT4, SRC_SENT5, SRC_SMU0, SRC_SMU1, SRC_SMU2, SRC_STM0SR0, SRC_STM0SR1, SRC_STM1SR0, SRC_STM1SR1, SRC_VADCCG0SR0, SRC_VADCCG0SR1, SRC_VADCCG0SR2, SRC_VADCCG0SR3, SRC_VADCCG1SR0, SRC_VADCCG1SR1, SRC_VADCCG1SR2, SRC_VADCCG1SR3, SRC_VADCG0SR0, SRC_VADCG0SR1, SRC_VADCG0SR2, SRC_VADCG0SR3, SRC_VADCG1SR0, SRC_VADCG1SR1, SRC_VADCG1SR2, SRC_VADCG1SR3, SRC_VADCG2SR0, SRC_VADCG2SR1, SRC_VADCG2SR2, SRC_VADCG2SR3, SRC_VADCG3SR0, SRC_VADCG3SR1, SRC_VADCG3SR2, SRC_VADCG3SR3, SRC_XBARSRC}, origin=ETAS-RTA-OS, set at pre-compile  # Value for CrossCore SRC1
        container CrossCoreSRC2 [0..1]  # Optionally specify the SRC assigned to the cross-core interrupt for core 2. A free register will be selected automatically if one is not specified. Multicore only.
          enumeration VALUE: {SRC_AGBT, SRC_ASCLIN0ERR, SRC_ASCLIN0RX, SRC_ASCLIN0TX, SRC_ASCLIN1ERR, SRC_ASCLIN1RX, SRC_ASCLIN1TX, SRC_ASCLIN2ERR, SRC_ASCLIN2RX, SRC_ASCLIN2TX, SRC_ASCLIN3ERR, SRC_ASCLIN3RX, SRC_ASCLIN3TX, SRC_BCUSPBSBSRC, SRC_CANINT0, SRC_CANINT1, SRC_CANINT10, SRC_CANINT11, SRC_CANINT12, SRC_CANINT13, SRC_CANINT14, SRC_CANINT15, SRC_CANINT2, SRC_CANINT3, SRC_CANINT4, SRC_CANINT5, SRC_CANINT6, SRC_CANINT7, SRC_CANINT8, SRC_CANINT9, SRC_CCU60SR0, SRC_CCU60SR1, SRC_CCU60SR2, SRC_CCU60SR3, SRC_CCU61SR0, SRC_CCU61SR1, SRC_CCU61SR2, SRC_CCU61SR3, SRC_CERBERUS0, SRC_CERBERUS1, SRC_CIFISP, SRC_CIFMI, SRC_CIFMIEP, SRC_CIFMJPEG, SRC_CPU0SBSRC, SRC_CPU1SBSRC, SRC_DMACH0, SRC_DMACH1, SRC_DMACH10, SRC_DMACH11, SRC_DMACH12, SRC_DMACH13, SRC_DMACH14, SRC_DMACH15, SRC_DMACH16, SRC_DMACH17, SRC_DMACH18, SRC_DMACH19, SRC_DMACH2, SRC_DMACH20, SRC_DMACH21, SRC_DMACH22, SRC_DMACH23, SRC_DMACH24, SRC_DMACH25, SRC_DMACH26, SRC_DMACH27, SRC_DMACH28, SRC_DMACH29, SRC_DMACH3, SRC_DMACH30, SRC_DMACH31, SRC_DMACH32, SRC_DMACH33, SRC_DMACH34, SRC_DMACH35, SRC_DMACH36, SRC_DMACH37, SRC_DMACH38, SRC_DMACH39, SRC_DMACH4, SRC_DMACH40, SRC_DMACH41, SRC_DMACH42, SRC_DMACH43, SRC_DMACH44, SRC_DMACH45, SRC_DMACH46, SRC_DMACH47, SRC_DMACH5, SRC_DMACH6, SRC_DMACH7, SRC_DMACH8, SRC_DMACH9, SRC_DMAERR, SRC_DSADCSRA0, SRC_DSADCSRA2, SRC_DSADCSRA3, SRC_DSADCSRM0, SRC_DSADCSRM2, SRC_DSADCSRM3, SRC_EMEM, SRC_ERAYIBUSY, SRC_ERAYINT0, SRC_ERAYINT1, SRC_ERAYMBSC0, SRC_ERAYMBSC1, SRC_ERAYNDAT0, SRC_ERAYNDAT1, SRC_ERAYOBUSY, SRC_ERAYTINT0, SRC_ERAYTINT1, SRC_ETH, SRC_FCE, SRC_FFTDONE, SRC_FFTERR, SRC_FFTRFS, SRC_GPSR00, SRC_GPSR01, SRC_GPSR02, SRC_GPSR03, SRC_GPSR10, SRC_GPSR11, SRC_GPSR12, SRC_GPSR13, SRC_GPT120CIRQ, SRC_GPT120T2, SRC_GPT120T3, SRC_GPT120T4, SRC_GPT120T5, SRC_GPT120T6, SRC_GTMAEIIRQ, SRC_GTMARUIRQ0, SRC_GTMARUIRQ1, SRC_GTMARUIRQ2, SRC_GTMATOM00, SRC_GTMATOM01, SRC_GTMATOM02, SRC_GTMATOM03, SRC_GTMATOM10, SRC_GTMATOM11, SRC_GTMATOM12, SRC_GTMATOM13, SRC_GTMATOM20, SRC_GTMATOM21, SRC_GTMATOM22, SRC_GTMATOM23, SRC_GTMATOM30, SRC_GTMATOM31, SRC_GTMATOM32, SRC_GTMATOM33, SRC_GTMBRCIRQ, SRC_GTMCMPIRQ, SRC_GTMDPLL0, SRC_GTMDPLL1, SRC_GTMDPLL10, SRC_GTMDPLL11, SRC_GTMDPLL12, SRC_GTMDPLL13, SRC_GTMDPLL14, SRC_GTMDPLL15, SRC_GTMDPLL16, SRC_GTMDPLL17, SRC_GTMDPLL18, SRC_GTMDPLL19, SRC_GTMDPLL2, SRC_GTMDPLL20, SRC_GTMDPLL21, SRC_GTMDPLL22, SRC_GTMDPLL23, SRC_GTMDPLL24, SRC_GTMDPLL25, SRC_GTMDPLL26, SRC_GTMDPLL3, SRC_GTMDPLL4, SRC_GTMDPLL5, SRC_GTMDPLL6, SRC_GTMDPLL7, SRC_GTMDPLL8, SRC_GTMDPLL9, SRC_GTMERR, SRC_GTMMCS00, SRC_GTMMCS01, SRC_GTMMCS02, SRC_GTMMCS03, SRC_GTMMCS04, SRC_GTMMCS05, SRC_GTMMCS06, SRC_GTMMCS07, SRC_GTMMCS10, SRC_GTMMCS11, SRC_GTMMCS12, SRC_GTMMCS13, SRC_GTMMCS14, SRC_GTMMCS15, SRC_GTMMCS16, SRC_GTMMCS17, SRC_GTMMCS20, SRC_GTMMCS21, SRC_GTMMCS22, SRC_GTMMCS23, SRC_GTMMCS24, SRC_GTMMCS25, SRC_GTMMCS26, SRC_GTMMCS27, SRC_GTMMCSW00, SRC_GTMMCSW01, SRC_GTMMCSW02, SRC_GTMMCSW10, SRC_GTMMCSW11, SRC_GTMMCSW12, SRC_GTMPSM00, SRC_GTMPSM01, SRC_GTMPSM02, SRC_GTMPSM03, SRC_GTMPSM04, SRC_GTMPSM05, SRC_GTMPSM06, SRC_GTMPSM07, SRC_GTMSPE0IRQ, SRC_GTMSPE1IRQ, SRC_GTMTIM00, SRC_GTMTIM01, SRC_GTMTIM02, SRC_GTMTIM03, SRC_GTMTIM04, SRC_GTMTIM05, SRC_GTMTIM06, SRC_GTMTIM07, SRC_GTMTIM10, SRC_GTMTIM11, SRC_GTMTIM12, SRC_GTMTIM13, SRC_GTMTIM14, SRC_GTMTIM15, SRC_GTMTIM16, SRC_GTMTIM17, SRC_GTMTIM20, SRC_GTMTIM21, SRC_GTMTIM22, SRC_GTMTIM23, SRC_GTMTIM24, SRC_GTMTIM25, SRC_GTMTIM26, SRC_GTMTIM27, SRC_GTMTOM00, SRC_GTMTOM01, SRC_GTMTOM02, SRC_GTMTOM03, SRC_GTMTOM04, SRC_GTMTOM05, SRC_GTMTOM06, SRC_GTMTOM07, SRC_GTMTOM10, SRC_GTMTOM11, SRC_GTMTOM12, SRC_GTMTOM13, SRC_GTMTOM14, SRC_GTMTOM15, SRC_GTMTOM16, SRC_GTMTOM17, SRC_HSCT, SRC_HSSLCOK0, SRC_HSSLCOK1, SRC_HSSLCOK2, SRC_HSSLCOK3, SRC_HSSLERR0, SRC_HSSLERR1, SRC_HSSLERR2, SRC_HSSLERR3, SRC_HSSLEXI, SRC_HSSLRDI0, SRC_HSSLRDI1, SRC_HSSLRDI2, SRC_HSSLRDI3, SRC_HSSLTRG0, SRC_HSSLTRG1, SRC_HSSLTRG2, SRC_HSSLTRG3, SRC_I2C0BREQ, SRC_I2C0ERR, SRC_I2C0LBREQ, SRC_I2C0LSREQ, SRC_I2C0P, SRC_I2C0SREQ, SRC_LMU, SRC_MSC0SR0, SRC_MSC0SR1, SRC_MSC0SR2, SRC_MSC0SR3, SRC_MSC0SR4, SRC_MSC1SR0, SRC_MSC1SR1, SRC_MSC1SR2, SRC_MSC1SR3, SRC_MSC1SR4, SRC_PMU00, SRC_PMU01, SRC_PSI50, SRC_PSI51, SRC_PSI52, SRC_PSI53, SRC_PSI54, SRC_PSI55, SRC_PSI56, SRC_PSI57, SRC_PSI5S0, SRC_PSI5S1, SRC_PSI5S2, SRC_PSI5S3, SRC_PSI5S4, SRC_PSI5S5, SRC_PSI5S6, SRC_PSI5S7, SRC_QSPI0ERR, SRC_QSPI0PT, SRC_QSPI0RX, SRC_QSPI0TX, SRC_QSPI0U, SRC_QSPI1ERR, SRC_QSPI1PT, SRC_QSPI1RX, SRC_QSPI1TX, SRC_QSPI1U, SRC_QSPI2ERR, SRC_QSPI2HC, SRC_QSPI2PT, SRC_QSPI2RX, SRC_QSPI2TX, SRC_QSPI2U, SRC_QSPI3ERR, SRC_QSPI3HC, SRC_QSPI3PT, SRC_QSPI3RX, SRC_QSPI3TX, SRC_QSPI3U, SRC_RESERVED10, SRC_RESERVED11, SRC_SCR, SRC_SCUDTS, SRC_SCUERU0, SRC_SCUERU1, SRC_SCUERU2, SRC_SCUERU3, SRC_SENT0, SRC_SENT1, SRC_SENT2, SRC_SENT3, SRC_SENT4, SRC_SENT5, SRC_SMU0, SRC_SMU1, SRC_SMU2, SRC_STM0SR0, SRC_STM0SR1, SRC_STM1SR0, SRC_STM1SR1, SRC_VADCCG0SR0, SRC_VADCCG0SR1, SRC_VADCCG0SR2, SRC_VADCCG0SR3, SRC_VADCCG1SR0, SRC_VADCCG1SR1, SRC_VADCCG1SR2, SRC_VADCCG1SR3, SRC_VADCG0SR0, SRC_VADCG0SR1, SRC_VADCG0SR2, SRC_VADCG0SR3, SRC_VADCG1SR0, SRC_VADCG1SR1, SRC_VADCG1SR2, SRC_VADCG1SR3, SRC_VADCG2SR0, SRC_VADCG2SR1, SRC_VADCG2SR2, SRC_VADCG2SR3, SRC_VADCG3SR0, SRC_VADCG3SR1, SRC_VADCG3SR2, SRC_VADCG3SR3, SRC_XBARSRC}, origin=ETAS-RTA-OS, set at pre-compile  # Value for CrossCore SRC2
        container CrossCoreSRC3 [0..1]  # Optionally specify the SRC assigned to the cross-core interrupt for core 3. A free register will be selected automatically if one is not specified. Multicore only.
          enumeration VALUE: {SRC_AGBT, SRC_ASCLIN0ERR, SRC_ASCLIN0RX, SRC_ASCLIN0TX, SRC_ASCLIN1ERR, SRC_ASCLIN1RX, SRC_ASCLIN1TX, SRC_ASCLIN2ERR, SRC_ASCLIN2RX, SRC_ASCLIN2TX, SRC_ASCLIN3ERR, SRC_ASCLIN3RX, SRC_ASCLIN3TX, SRC_BCUSPBSBSRC, SRC_CANINT0, SRC_CANINT1, SRC_CANINT10, SRC_CANINT11, SRC_CANINT12, SRC_CANINT13, SRC_CANINT14, SRC_CANINT15, SRC_CANINT2, SRC_CANINT3, SRC_CANINT4, SRC_CANINT5, SRC_CANINT6, SRC_CANINT7, SRC_CANINT8, SRC_CANINT9, SRC_CCU60SR0, SRC_CCU60SR1, SRC_CCU60SR2, SRC_CCU60SR3, SRC_CCU61SR0, SRC_CCU61SR1, SRC_CCU61SR2, SRC_CCU61SR3, SRC_CERBERUS0, SRC_CERBERUS1, SRC_CIFISP, SRC_CIFMI, SRC_CIFMIEP, SRC_CIFMJPEG, SRC_CPU0SBSRC, SRC_CPU1SBSRC, SRC_DMACH0, SRC_DMACH1, SRC_DMACH10, SRC_DMACH11, SRC_DMACH12, SRC_DMACH13, SRC_DMACH14, SRC_DMACH15, SRC_DMACH16, SRC_DMACH17, SRC_DMACH18, SRC_DMACH19, SRC_DMACH2, SRC_DMACH20, SRC_DMACH21, SRC_DMACH22, SRC_DMACH23, SRC_DMACH24, SRC_DMACH25, SRC_DMACH26, SRC_DMACH27, SRC_DMACH28, SRC_DMACH29, SRC_DMACH3, SRC_DMACH30, SRC_DMACH31, SRC_DMACH32, SRC_DMACH33, SRC_DMACH34, SRC_DMACH35, SRC_DMACH36, SRC_DMACH37, SRC_DMACH38, SRC_DMACH39, SRC_DMACH4, SRC_DMACH40, SRC_DMACH41, SRC_DMACH42, SRC_DMACH43, SRC_DMACH44, SRC_DMACH45, SRC_DMACH46, SRC_DMACH47, SRC_DMACH5, SRC_DMACH6, SRC_DMACH7, SRC_DMACH8, SRC_DMACH9, SRC_DMAERR, SRC_DSADCSRA0, SRC_DSADCSRA2, SRC_DSADCSRA3, SRC_DSADCSRM0, SRC_DSADCSRM2, SRC_DSADCSRM3, SRC_EMEM, SRC_ERAYIBUSY, SRC_ERAYINT0, SRC_ERAYINT1, SRC_ERAYMBSC0, SRC_ERAYMBSC1, SRC_ERAYNDAT0, SRC_ERAYNDAT1, SRC_ERAYOBUSY, SRC_ERAYTINT0, SRC_ERAYTINT1, SRC_ETH, SRC_FCE, SRC_FFTDONE, SRC_FFTERR, SRC_FFTRFS, SRC_GPSR00, SRC_GPSR01, SRC_GPSR02, SRC_GPSR03, SRC_GPSR10, SRC_GPSR11, SRC_GPSR12, SRC_GPSR13, SRC_GPT120CIRQ, SRC_GPT120T2, SRC_GPT120T3, SRC_GPT120T4, SRC_GPT120T5, SRC_GPT120T6, SRC_GTMAEIIRQ, SRC_GTMARUIRQ0, SRC_GTMARUIRQ1, SRC_GTMARUIRQ2, SRC_GTMATOM00, SRC_GTMATOM01, SRC_GTMATOM02, SRC_GTMATOM03, SRC_GTMATOM10, SRC_GTMATOM11, SRC_GTMATOM12, SRC_GTMATOM13, SRC_GTMATOM20, SRC_GTMATOM21, SRC_GTMATOM22, SRC_GTMATOM23, SRC_GTMATOM30, SRC_GTMATOM31, SRC_GTMATOM32, SRC_GTMATOM33, SRC_GTMBRCIRQ, SRC_GTMCMPIRQ, SRC_GTMDPLL0, SRC_GTMDPLL1, SRC_GTMDPLL10, SRC_GTMDPLL11, SRC_GTMDPLL12, SRC_GTMDPLL13, SRC_GTMDPLL14, SRC_GTMDPLL15, SRC_GTMDPLL16, SRC_GTMDPLL17, SRC_GTMDPLL18, SRC_GTMDPLL19, SRC_GTMDPLL2, SRC_GTMDPLL20, SRC_GTMDPLL21, SRC_GTMDPLL22, SRC_GTMDPLL23, SRC_GTMDPLL24, SRC_GTMDPLL25, SRC_GTMDPLL26, SRC_GTMDPLL3, SRC_GTMDPLL4, SRC_GTMDPLL5, SRC_GTMDPLL6, SRC_GTMDPLL7, SRC_GTMDPLL8, SRC_GTMDPLL9, SRC_GTMERR, SRC_GTMMCS00, SRC_GTMMCS01, SRC_GTMMCS02, SRC_GTMMCS03, SRC_GTMMCS04, SRC_GTMMCS05, SRC_GTMMCS06, SRC_GTMMCS07, SRC_GTMMCS10, SRC_GTMMCS11, SRC_GTMMCS12, SRC_GTMMCS13, SRC_GTMMCS14, SRC_GTMMCS15, SRC_GTMMCS16, SRC_GTMMCS17, SRC_GTMMCS20, SRC_GTMMCS21, SRC_GTMMCS22, SRC_GTMMCS23, SRC_GTMMCS24, SRC_GTMMCS25, SRC_GTMMCS26, SRC_GTMMCS27, SRC_GTMMCSW00, SRC_GTMMCSW01, SRC_GTMMCSW02, SRC_GTMMCSW10, SRC_GTMMCSW11, SRC_GTMMCSW12, SRC_GTMPSM00, SRC_GTMPSM01, SRC_GTMPSM02, SRC_GTMPSM03, SRC_GTMPSM04, SRC_GTMPSM05, SRC_GTMPSM06, SRC_GTMPSM07, SRC_GTMSPE0IRQ, SRC_GTMSPE1IRQ, SRC_GTMTIM00, SRC_GTMTIM01, SRC_GTMTIM02, SRC_GTMTIM03, SRC_GTMTIM04, SRC_GTMTIM05, SRC_GTMTIM06, SRC_GTMTIM07, SRC_GTMTIM10, SRC_GTMTIM11, SRC_GTMTIM12, SRC_GTMTIM13, SRC_GTMTIM14, SRC_GTMTIM15, SRC_GTMTIM16, SRC_GTMTIM17, SRC_GTMTIM20, SRC_GTMTIM21, SRC_GTMTIM22, SRC_GTMTIM23, SRC_GTMTIM24, SRC_GTMTIM25, SRC_GTMTIM26, SRC_GTMTIM27, SRC_GTMTOM00, SRC_GTMTOM01, SRC_GTMTOM02, SRC_GTMTOM03, SRC_GTMTOM04, SRC_GTMTOM05, SRC_GTMTOM06, SRC_GTMTOM07, SRC_GTMTOM10, SRC_GTMTOM11, SRC_GTMTOM12, SRC_GTMTOM13, SRC_GTMTOM14, SRC_GTMTOM15, SRC_GTMTOM16, SRC_GTMTOM17, SRC_HSCT, SRC_HSSLCOK0, SRC_HSSLCOK1, SRC_HSSLCOK2, SRC_HSSLCOK3, SRC_HSSLERR0, SRC_HSSLERR1, SRC_HSSLERR2, SRC_HSSLERR3, SRC_HSSLEXI, SRC_HSSLRDI0, SRC_HSSLRDI1, SRC_HSSLRDI2, SRC_HSSLRDI3, SRC_HSSLTRG0, SRC_HSSLTRG1, SRC_HSSLTRG2, SRC_HSSLTRG3, SRC_I2C0BREQ, SRC_I2C0ERR, SRC_I2C0LBREQ, SRC_I2C0LSREQ, SRC_I2C0P, SRC_I2C0SREQ, SRC_LMU, SRC_MSC0SR0, SRC_MSC0SR1, SRC_MSC0SR2, SRC_MSC0SR3, SRC_MSC0SR4, SRC_MSC1SR0, SRC_MSC1SR1, SRC_MSC1SR2, SRC_MSC1SR3, SRC_MSC1SR4, SRC_PMU00, SRC_PMU01, SRC_PSI50, SRC_PSI51, SRC_PSI52, SRC_PSI53, SRC_PSI54, SRC_PSI55, SRC_PSI56, SRC_PSI57, SRC_PSI5S0, SRC_PSI5S1, SRC_PSI5S2, SRC_PSI5S3, SRC_PSI5S4, SRC_PSI5S5, SRC_PSI5S6, SRC_PSI5S7, SRC_QSPI0ERR, SRC_QSPI0PT, SRC_QSPI0RX, SRC_QSPI0TX, SRC_QSPI0U, SRC_QSPI1ERR, SRC_QSPI1PT, SRC_QSPI1RX, SRC_QSPI1TX, SRC_QSPI1U, SRC_QSPI2ERR, SRC_QSPI2HC, SRC_QSPI2PT, SRC_QSPI2RX, SRC_QSPI2TX, SRC_QSPI2U, SRC_QSPI3ERR, SRC_QSPI3HC, SRC_QSPI3PT, SRC_QSPI3RX, SRC_QSPI3TX, SRC_QSPI3U, SRC_RESERVED10, SRC_RESERVED11, SRC_SCR, SRC_SCUDTS, SRC_SCUERU0, SRC_SCUERU1, SRC_SCUERU2, SRC_SCUERU3, SRC_SENT0, SRC_SENT1, SRC_SENT2, SRC_SENT3, SRC_SENT4, SRC_SENT5, SRC_SMU0, SRC_SMU1, SRC_SMU2, SRC_STM0SR0, SRC_STM0SR1, SRC_STM1SR0, SRC_STM1SR1, SRC_VADCCG0SR0, SRC_VADCCG0SR1, SRC_VADCCG0SR2, SRC_VADCCG0SR3, SRC_VADCCG1SR0, SRC_VADCCG1SR1, SRC_VADCCG1SR2, SRC_VADCCG1SR3, SRC_VADCG0SR0, SRC_VADCG0SR1, SRC_VADCG0SR2, SRC_VADCG0SR3, SRC_VADCG1SR0, SRC_VADCG1SR1, SRC_VADCG1SR2, SRC_VADCG1SR3, SRC_VADCG2SR0, SRC_VADCG2SR1, SRC_VADCG2SR2, SRC_VADCG2SR3, SRC_VADCG3SR0, SRC_VADCG3SR1, SRC_VADCG3SR2, SRC_VADCG3SR3, SRC_XBARSRC}, origin=ETAS-RTA-OS, set at pre-compile  # Value for CrossCore SRC3
        container CrossCoreSRC4 [0..1]  # Optionally specify the SRC assigned to the cross-core interrupt for core 4. A free register will be selected automatically if one is not specified. Multicore only.
          enumeration VALUE: {SRC_AGBT, SRC_ASCLIN0ERR, SRC_ASCLIN0RX, SRC_ASCLIN0TX, SRC_ASCLIN1ERR, SRC_ASCLIN1RX, SRC_ASCLIN1TX, SRC_ASCLIN2ERR, SRC_ASCLIN2RX, SRC_ASCLIN2TX, SRC_ASCLIN3ERR, SRC_ASCLIN3RX, SRC_ASCLIN3TX, SRC_BCUSPBSBSRC, SRC_CANINT0, SRC_CANINT1, SRC_CANINT10, SRC_CANINT11, SRC_CANINT12, SRC_CANINT13, SRC_CANINT14, SRC_CANINT15, SRC_CANINT2, SRC_CANINT3, SRC_CANINT4, SRC_CANINT5, SRC_CANINT6, SRC_CANINT7, SRC_CANINT8, SRC_CANINT9, SRC_CCU60SR0, SRC_CCU60SR1, SRC_CCU60SR2, SRC_CCU60SR3, SRC_CCU61SR0, SRC_CCU61SR1, SRC_CCU61SR2, SRC_CCU61SR3, SRC_CERBERUS0, SRC_CERBERUS1, SRC_CIFISP, SRC_CIFMI, SRC_CIFMIEP, SRC_CIFMJPEG, SRC_CPU0SBSRC, SRC_CPU1SBSRC, SRC_DMACH0, SRC_DMACH1, SRC_DMACH10, SRC_DMACH11, SRC_DMACH12, SRC_DMACH13, SRC_DMACH14, SRC_DMACH15, SRC_DMACH16, SRC_DMACH17, SRC_DMACH18, SRC_DMACH19, SRC_DMACH2, SRC_DMACH20, SRC_DMACH21, SRC_DMACH22, SRC_DMACH23, SRC_DMACH24, SRC_DMACH25, SRC_DMACH26, SRC_DMACH27, SRC_DMACH28, SRC_DMACH29, SRC_DMACH3, SRC_DMACH30, SRC_DMACH31, SRC_DMACH32, SRC_DMACH33, SRC_DMACH34, SRC_DMACH35, SRC_DMACH36, SRC_DMACH37, SRC_DMACH38, SRC_DMACH39, SRC_DMACH4, SRC_DMACH40, SRC_DMACH41, SRC_DMACH42, SRC_DMACH43, SRC_DMACH44, SRC_DMACH45, SRC_DMACH46, SRC_DMACH47, SRC_DMACH5, SRC_DMACH6, SRC_DMACH7, SRC_DMACH8, SRC_DMACH9, SRC_DMAERR, SRC_DSADCSRA0, SRC_DSADCSRA2, SRC_DSADCSRA3, SRC_DSADCSRM0, SRC_DSADCSRM2, SRC_DSADCSRM3, SRC_EMEM, SRC_ERAYIBUSY, SRC_ERAYINT0, SRC_ERAYINT1, SRC_ERAYMBSC0, SRC_ERAYMBSC1, SRC_ERAYNDAT0, SRC_ERAYNDAT1, SRC_ERAYOBUSY, SRC_ERAYTINT0, SRC_ERAYTINT1, SRC_ETH, SRC_FCE, SRC_FFTDONE, SRC_FFTERR, SRC_FFTRFS, SRC_GPSR00, SRC_GPSR01, SRC_GPSR02, SRC_GPSR03, SRC_GPSR10, SRC_GPSR11, SRC_GPSR12, SRC_GPSR13, SRC_GPT120CIRQ, SRC_GPT120T2, SRC_GPT120T3, SRC_GPT120T4, SRC_GPT120T5, SRC_GPT120T6, SRC_GTMAEIIRQ, SRC_GTMARUIRQ0, SRC_GTMARUIRQ1, SRC_GTMARUIRQ2, SRC_GTMATOM00, SRC_GTMATOM01, SRC_GTMATOM02, SRC_GTMATOM03, SRC_GTMATOM10, SRC_GTMATOM11, SRC_GTMATOM12, SRC_GTMATOM13, SRC_GTMATOM20, SRC_GTMATOM21, SRC_GTMATOM22, SRC_GTMATOM23, SRC_GTMATOM30, SRC_GTMATOM31, SRC_GTMATOM32, SRC_GTMATOM33, SRC_GTMBRCIRQ, SRC_GTMCMPIRQ, SRC_GTMDPLL0, SRC_GTMDPLL1, SRC_GTMDPLL10, SRC_GTMDPLL11, SRC_GTMDPLL12, SRC_GTMDPLL13, SRC_GTMDPLL14, SRC_GTMDPLL15, SRC_GTMDPLL16, SRC_GTMDPLL17, SRC_GTMDPLL18, SRC_GTMDPLL19, SRC_GTMDPLL2, SRC_GTMDPLL20, SRC_GTMDPLL21, SRC_GTMDPLL22, SRC_GTMDPLL23, SRC_GTMDPLL24, SRC_GTMDPLL25, SRC_GTMDPLL26, SRC_GTMDPLL3, SRC_GTMDPLL4, SRC_GTMDPLL5, SRC_GTMDPLL6, SRC_GTMDPLL7, SRC_GTMDPLL8, SRC_GTMDPLL9, SRC_GTMERR, SRC_GTMMCS00, SRC_GTMMCS01, SRC_GTMMCS02, SRC_GTMMCS03, SRC_GTMMCS04, SRC_GTMMCS05, SRC_GTMMCS06, SRC_GTMMCS07, SRC_GTMMCS10, SRC_GTMMCS11, SRC_GTMMCS12, SRC_GTMMCS13, SRC_GTMMCS14, SRC_GTMMCS15, SRC_GTMMCS16, SRC_GTMMCS17, SRC_GTMMCS20, SRC_GTMMCS21, SRC_GTMMCS22, SRC_GTMMCS23, SRC_GTMMCS24, SRC_GTMMCS25, SRC_GTMMCS26, SRC_GTMMCS27, SRC_GTMMCSW00, SRC_GTMMCSW01, SRC_GTMMCSW02, SRC_GTMMCSW10, SRC_GTMMCSW11, SRC_GTMMCSW12, SRC_GTMPSM00, SRC_GTMPSM01, SRC_GTMPSM02, SRC_GTMPSM03, SRC_GTMPSM04, SRC_GTMPSM05, SRC_GTMPSM06, SRC_GTMPSM07, SRC_GTMSPE0IRQ, SRC_GTMSPE1IRQ, SRC_GTMTIM00, SRC_GTMTIM01, SRC_GTMTIM02, SRC_GTMTIM03, SRC_GTMTIM04, SRC_GTMTIM05, SRC_GTMTIM06, SRC_GTMTIM07, SRC_GTMTIM10, SRC_GTMTIM11, SRC_GTMTIM12, SRC_GTMTIM13, SRC_GTMTIM14, SRC_GTMTIM15, SRC_GTMTIM16, SRC_GTMTIM17, SRC_GTMTIM20, SRC_GTMTIM21, SRC_GTMTIM22, SRC_GTMTIM23, SRC_GTMTIM24, SRC_GTMTIM25, SRC_GTMTIM26, SRC_GTMTIM27, SRC_GTMTOM00, SRC_GTMTOM01, SRC_GTMTOM02, SRC_GTMTOM03, SRC_GTMTOM04, SRC_GTMTOM05, SRC_GTMTOM06, SRC_GTMTOM07, SRC_GTMTOM10, SRC_GTMTOM11, SRC_GTMTOM12, SRC_GTMTOM13, SRC_GTMTOM14, SRC_GTMTOM15, SRC_GTMTOM16, SRC_GTMTOM17, SRC_HSCT, SRC_HSSLCOK0, SRC_HSSLCOK1, SRC_HSSLCOK2, SRC_HSSLCOK3, SRC_HSSLERR0, SRC_HSSLERR1, SRC_HSSLERR2, SRC_HSSLERR3, SRC_HSSLEXI, SRC_HSSLRDI0, SRC_HSSLRDI1, SRC_HSSLRDI2, SRC_HSSLRDI3, SRC_HSSLTRG0, SRC_HSSLTRG1, SRC_HSSLTRG2, SRC_HSSLTRG3, SRC_I2C0BREQ, SRC_I2C0ERR, SRC_I2C0LBREQ, SRC_I2C0LSREQ, SRC_I2C0P, SRC_I2C0SREQ, SRC_LMU, SRC_MSC0SR0, SRC_MSC0SR1, SRC_MSC0SR2, SRC_MSC0SR3, SRC_MSC0SR4, SRC_MSC1SR0, SRC_MSC1SR1, SRC_MSC1SR2, SRC_MSC1SR3, SRC_MSC1SR4, SRC_PMU00, SRC_PMU01, SRC_PSI50, SRC_PSI51, SRC_PSI52, SRC_PSI53, SRC_PSI54, SRC_PSI55, SRC_PSI56, SRC_PSI57, SRC_PSI5S0, SRC_PSI5S1, SRC_PSI5S2, SRC_PSI5S3, SRC_PSI5S4, SRC_PSI5S5, SRC_PSI5S6, SRC_PSI5S7, SRC_QSPI0ERR, SRC_QSPI0PT, SRC_QSPI0RX, SRC_QSPI0TX, SRC_QSPI0U, SRC_QSPI1ERR, SRC_QSPI1PT, SRC_QSPI1RX, SRC_QSPI1TX, SRC_QSPI1U, SRC_QSPI2ERR, SRC_QSPI2HC, SRC_QSPI2PT, SRC_QSPI2RX, SRC_QSPI2TX, SRC_QSPI2U, SRC_QSPI3ERR, SRC_QSPI3HC, SRC_QSPI3PT, SRC_QSPI3RX, SRC_QSPI3TX, SRC_QSPI3U, SRC_RESERVED10, SRC_RESERVED11, SRC_SCR, SRC_SCUDTS, SRC_SCUERU0, SRC_SCUERU1, SRC_SCUERU2, SRC_SCUERU3, SRC_SENT0, SRC_SENT1, SRC_SENT2, SRC_SENT3, SRC_SENT4, SRC_SENT5, SRC_SMU0, SRC_SMU1, SRC_SMU2, SRC_STM0SR0, SRC_STM0SR1, SRC_STM1SR0, SRC_STM1SR1, SRC_VADCCG0SR0, SRC_VADCCG0SR1, SRC_VADCCG0SR2, SRC_VADCCG0SR3, SRC_VADCCG1SR0, SRC_VADCCG1SR1, SRC_VADCCG1SR2, SRC_VADCCG1SR3, SRC_VADCG0SR0, SRC_VADCG0SR1, SRC_VADCG0SR2, SRC_VADCG0SR3, SRC_VADCG1SR0, SRC_VADCG1SR1, SRC_VADCG1SR2, SRC_VADCG1SR3, SRC_VADCG2SR0, SRC_VADCG2SR1, SRC_VADCG2SR2, SRC_VADCG2SR3, SRC_VADCG3SR0, SRC_VADCG3SR1, SRC_VADCG3SR2, SRC_VADCG3SR3, SRC_XBARSRC}, origin=ETAS-RTA-OS, set at pre-compile  # Value for CrossCore SRC4
        container CrossCoreSRC5 [0..1]  # Optionally specify the SRC assigned to the cross-core interrupt for core 5. A free register will be selected automatically if one is not specified. Multicore only.
          enumeration VALUE: {SRC_AGBT, SRC_ASCLIN0ERR, SRC_ASCLIN0RX, SRC_ASCLIN0TX, SRC_ASCLIN1ERR, SRC_ASCLIN1RX, SRC_ASCLIN1TX, SRC_ASCLIN2ERR, SRC_ASCLIN2RX, SRC_ASCLIN2TX, SRC_ASCLIN3ERR, SRC_ASCLIN3RX, SRC_ASCLIN3TX, SRC_BCUSPBSBSRC, SRC_CANINT0, SRC_CANINT1, SRC_CANINT10, SRC_CANINT11, SRC_CANINT12, SRC_CANINT13, SRC_CANINT14, SRC_CANINT15, SRC_CANINT2, SRC_CANINT3, SRC_CANINT4, SRC_CANINT5, SRC_CANINT6, SRC_CANINT7, SRC_CANINT8, SRC_CANINT9, SRC_CCU60SR0, SRC_CCU60SR1, SRC_CCU60SR2, SRC_CCU60SR3, SRC_CCU61SR0, SRC_CCU61SR1, SRC_CCU61SR2, SRC_CCU61SR3, SRC_CERBERUS0, SRC_CERBERUS1, SRC_CIFISP, SRC_CIFMI, SRC_CIFMIEP, SRC_CIFMJPEG, SRC_CPU0SBSRC, SRC_CPU1SBSRC, SRC_DMACH0, SRC_DMACH1, SRC_DMACH10, SRC_DMACH11, SRC_DMACH12, SRC_DMACH13, SRC_DMACH14, SRC_DMACH15, SRC_DMACH16, SRC_DMACH17, SRC_DMACH18, SRC_DMACH19, SRC_DMACH2, SRC_DMACH20, SRC_DMACH21, SRC_DMACH22, SRC_DMACH23, SRC_DMACH24, SRC_DMACH25, SRC_DMACH26, SRC_DMACH27, SRC_DMACH28, SRC_DMACH29, SRC_DMACH3, SRC_DMACH30, SRC_DMACH31, SRC_DMACH32, SRC_DMACH33, SRC_DMACH34, SRC_DMACH35, SRC_DMACH36, SRC_DMACH37, SRC_DMACH38, SRC_DMACH39, SRC_DMACH4, SRC_DMACH40, SRC_DMACH41, SRC_DMACH42, SRC_DMACH43, SRC_DMACH44, SRC_DMACH45, SRC_DMACH46, SRC_DMACH47, SRC_DMACH5, SRC_DMACH6, SRC_DMACH7, SRC_DMACH8, SRC_DMACH9, SRC_DMAERR, SRC_DSADCSRA0, SRC_DSADCSRA2, SRC_DSADCSRA3, SRC_DSADCSRM0, SRC_DSADCSRM2, SRC_DSADCSRM3, SRC_EMEM, SRC_ERAYIBUSY, SRC_ERAYINT0, SRC_ERAYINT1, SRC_ERAYMBSC0, SRC_ERAYMBSC1, SRC_ERAYNDAT0, SRC_ERAYNDAT1, SRC_ERAYOBUSY, SRC_ERAYTINT0, SRC_ERAYTINT1, SRC_ETH, SRC_FCE, SRC_FFTDONE, SRC_FFTERR, SRC_FFTRFS, SRC_GPSR00, SRC_GPSR01, SRC_GPSR02, SRC_GPSR03, SRC_GPSR10, SRC_GPSR11, SRC_GPSR12, SRC_GPSR13, SRC_GPT120CIRQ, SRC_GPT120T2, SRC_GPT120T3, SRC_GPT120T4, SRC_GPT120T5, SRC_GPT120T6, SRC_GTMAEIIRQ, SRC_GTMARUIRQ0, SRC_GTMARUIRQ1, SRC_GTMARUIRQ2, SRC_GTMATOM00, SRC_GTMATOM01, SRC_GTMATOM02, SRC_GTMATOM03, SRC_GTMATOM10, SRC_GTMATOM11, SRC_GTMATOM12, SRC_GTMATOM13, SRC_GTMATOM20, SRC_GTMATOM21, SRC_GTMATOM22, SRC_GTMATOM23, SRC_GTMATOM30, SRC_GTMATOM31, SRC_GTMATOM32, SRC_GTMATOM33, SRC_GTMBRCIRQ, SRC_GTMCMPIRQ, SRC_GTMDPLL0, SRC_GTMDPLL1, SRC_GTMDPLL10, SRC_GTMDPLL11, SRC_GTMDPLL12, SRC_GTMDPLL13, SRC_GTMDPLL14, SRC_GTMDPLL15, SRC_GTMDPLL16, SRC_GTMDPLL17, SRC_GTMDPLL18, SRC_GTMDPLL19, SRC_GTMDPLL2, SRC_GTMDPLL20, SRC_GTMDPLL21, SRC_GTMDPLL22, SRC_GTMDPLL23, SRC_GTMDPLL24, SRC_GTMDPLL25, SRC_GTMDPLL26, SRC_GTMDPLL3, SRC_GTMDPLL4, SRC_GTMDPLL5, SRC_GTMDPLL6, SRC_GTMDPLL7, SRC_GTMDPLL8, SRC_GTMDPLL9, SRC_GTMERR, SRC_GTMMCS00, SRC_GTMMCS01, SRC_GTMMCS02, SRC_GTMMCS03, SRC_GTMMCS04, SRC_GTMMCS05, SRC_GTMMCS06, SRC_GTMMCS07, SRC_GTMMCS10, SRC_GTMMCS11, SRC_GTMMCS12, SRC_GTMMCS13, SRC_GTMMCS14, SRC_GTMMCS15, SRC_GTMMCS16, SRC_GTMMCS17, SRC_GTMMCS20, SRC_GTMMCS21, SRC_GTMMCS22, SRC_GTMMCS23, SRC_GTMMCS24, SRC_GTMMCS25, SRC_GTMMCS26, SRC_GTMMCS27, SRC_GTMMCSW00, SRC_GTMMCSW01, SRC_GTMMCSW02, SRC_GTMMCSW10, SRC_GTMMCSW11, SRC_GTMMCSW12, SRC_GTMPSM00, SRC_GTMPSM01, SRC_GTMPSM02, SRC_GTMPSM03, SRC_GTMPSM04, SRC_GTMPSM05, SRC_GTMPSM06, SRC_GTMPSM07, SRC_GTMSPE0IRQ, SRC_GTMSPE1IRQ, SRC_GTMTIM00, SRC_GTMTIM01, SRC_GTMTIM02, SRC_GTMTIM03, SRC_GTMTIM04, SRC_GTMTIM05, SRC_GTMTIM06, SRC_GTMTIM07, SRC_GTMTIM10, SRC_GTMTIM11, SRC_GTMTIM12, SRC_GTMTIM13, SRC_GTMTIM14, SRC_GTMTIM15, SRC_GTMTIM16, SRC_GTMTIM17, SRC_GTMTIM20, SRC_GTMTIM21, SRC_GTMTIM22, SRC_GTMTIM23, SRC_GTMTIM24, SRC_GTMTIM25, SRC_GTMTIM26, SRC_GTMTIM27, SRC_GTMTOM00, SRC_GTMTOM01, SRC_GTMTOM02, SRC_GTMTOM03, SRC_GTMTOM04, SRC_GTMTOM05, SRC_GTMTOM06, SRC_GTMTOM07, SRC_GTMTOM10, SRC_GTMTOM11, SRC_GTMTOM12, SRC_GTMTOM13, SRC_GTMTOM14, SRC_GTMTOM15, SRC_GTMTOM16, SRC_GTMTOM17, SRC_HSCT, SRC_HSSLCOK0, SRC_HSSLCOK1, SRC_HSSLCOK2, SRC_HSSLCOK3, SRC_HSSLERR0, SRC_HSSLERR1, SRC_HSSLERR2, SRC_HSSLERR3, SRC_HSSLEXI, SRC_HSSLRDI0, SRC_HSSLRDI1, SRC_HSSLRDI2, SRC_HSSLRDI3, SRC_HSSLTRG0, SRC_HSSLTRG1, SRC_HSSLTRG2, SRC_HSSLTRG3, SRC_I2C0BREQ, SRC_I2C0ERR, SRC_I2C0LBREQ, SRC_I2C0LSREQ, SRC_I2C0P, SRC_I2C0SREQ, SRC_LMU, SRC_MSC0SR0, SRC_MSC0SR1, SRC_MSC0SR2, SRC_MSC0SR3, SRC_MSC0SR4, SRC_MSC1SR0, SRC_MSC1SR1, SRC_MSC1SR2, SRC_MSC1SR3, SRC_MSC1SR4, SRC_PMU00, SRC_PMU01, SRC_PSI50, SRC_PSI51, SRC_PSI52, SRC_PSI53, SRC_PSI54, SRC_PSI55, SRC_PSI56, SRC_PSI57, SRC_PSI5S0, SRC_PSI5S1, SRC_PSI5S2, SRC_PSI5S3, SRC_PSI5S4, SRC_PSI5S5, SRC_PSI5S6, SRC_PSI5S7, SRC_QSPI0ERR, SRC_QSPI0PT, SRC_QSPI0RX, SRC_QSPI0TX, SRC_QSPI0U, SRC_QSPI1ERR, SRC_QSPI1PT, SRC_QSPI1RX, SRC_QSPI1TX, SRC_QSPI1U, SRC_QSPI2ERR, SRC_QSPI2HC, SRC_QSPI2PT, SRC_QSPI2RX, SRC_QSPI2TX, SRC_QSPI2U, SRC_QSPI3ERR, SRC_QSPI3HC, SRC_QSPI3PT, SRC_QSPI3RX, SRC_QSPI3TX, SRC_QSPI3U, SRC_RESERVED10, SRC_RESERVED11, SRC_SCR, SRC_SCUDTS, SRC_SCUERU0, SRC_SCUERU1, SRC_SCUERU2, SRC_SCUERU3, SRC_SENT0, SRC_SENT1, SRC_SENT2, SRC_SENT3, SRC_SENT4, SRC_SENT5, SRC_SMU0, SRC_SMU1, SRC_SMU2, SRC_STM0SR0, SRC_STM0SR1, SRC_STM1SR0, SRC_STM1SR1, SRC_VADCCG0SR0, SRC_VADCCG0SR1, SRC_VADCCG0SR2, SRC_VADCCG0SR3, SRC_VADCCG1SR0, SRC_VADCCG1SR1, SRC_VADCCG1SR2, SRC_VADCCG1SR3, SRC_VADCG0SR0, SRC_VADCG0SR1, SRC_VADCG0SR2, SRC_VADCG0SR3, SRC_VADCG1SR0, SRC_VADCG1SR1, SRC_VADCG1SR2, SRC_VADCG1SR3, SRC_VADCG2SR0, SRC_VADCG2SR1, SRC_VADCG2SR2, SRC_VADCG2SR3, SRC_VADCG3SR0, SRC_VADCG3SR1, SRC_VADCG3SR2, SRC_VADCG3SR3, SRC_XBARSRC}, origin=ETAS-RTA-OS, set at pre-compile  # Value for CrossCore SRC5
        container block_default_interrupt [0..1]  # This option is provided for compatibility reasons only. SRC registers for unused registers are left in their power-on disabled state which blocks spurious interrupts and has no impact on the generated code.
          boolean VALUE: origin=ETAS-RTA-OS, set at pre-compile  # Value for Block default interrupt
        container UserMode [0..1]  # Specify the PSW.IO user mode setting used for untrusted code. You may need to set up SYSCON register in User-1 mode.
          enumeration VALUE: origin=ETAS-RTA-OS, set at pre-compile  # Value for User Mode
            User_0  # PSW-IO 00: no peripheral access (default)
            User_1  # PSW-IO 01: regular peripheral access
        container TWPprs [0..1]  # Specify the PSW.PRS setting used for trusted-with-protection code.
          enumeration VALUE: origin=ETAS-RTA-OS, set at pre-compile  # Value for Trusted with protection PRS
            Value_1  # PSW-PRS 01 (default)
            Value_2  # PSW-PRS 10
            Value_3  # PSW-PRS 11
        container guard_supervisor_access [0..1]  # This option adds extra security checks to the System Call trap handler to validate that the caller is the OS rather than some application code.
          boolean VALUE: origin=ETAS-RTA-OS, set at pre-compile  # Value for Guard supervisor access
        container IPL_matches_vector [0..1]  # RTA-OS will normally pack interrupts to minimize the size of the interrupt vector table. This reduces the memory size but and reduces the interrupt entry time. Some customers prefer to use the interrupt priority to determine the interrupt's SRC.SRPN value.
          boolean VALUE: origin=ETAS-RTA-OS, set at pre-compile  # Value for Interrupt vector matches priority
        container OSLockDisableAll [0..1]  # Specify whether all interrupts are disabled while internal OS spinlocks are held. This may reduce cross-core blocking. It should normally be selected if OS option 'Add Spinlock APIs for CAT1 ISRs' is active. This does not affect spinlocks accessed using the GetSpinlock or TryToGetSpinlock APIs
          boolean VALUE: origin=ETAS-RTA-OS, set at pre-compile  # Value for OS Locks disable Cat1
        container AlignUntrustedStacks [0..1]  # Use to support realignment of the stack for untrusted code when there are MPU protection region granularity issues. Refer to the documentation for Os_Cbk_SetMemoryAccess
          boolean VALUE: origin=ETAS-RTA-OS, set at pre-compile  # Value for Enable stack repositioning
        container EnhancedIsolation [0..1]  # Use to enforce additional checks to prevent errors in untrusted code from affecting any other part of the system. Refer to the documentation in the User and Reference Guides
          boolean VALUE: origin=ETAS-RTA-OS, set at pre-compile  # Value for Enhanced Isolation
        container OsLinkerModel [0..1]  # Select the type of map used in linker samples.
          enumeration VALUE: origin=ETAS-RTA-OS, set at pre-compile  # Value for Link Type
            Standalone  # Default: Code in internal flash, data in internal RAM
            IntRAM  # Code/data in internal RAM
            ExtRAM  # Code/data in external RAM
        container OsMemoryModel [0..1]  # Select the memory model.
          enumeration VALUE: origin=ETAS-RTA-OS, set at pre-compile  # Value for Memory model
            small  # Default: all data allocated to SDA (-msmall=0)
            small_const  # All constants allocated to SDA (-msmall-const=0)
            small_data  # All variables allocated to SDA (-msmall-data=0)
            large  # No data allocated to SDA
        container small_const_value [0..1]  # Sets the value used for -msmall-const=n when compiling. Overrides the Memory model option.
          string VALUE: origin=ETAS-RTA-OS, set at pre-compile  # Value for Small const threshold
        container small_data_value [0..1]  # Sets the value used for -msmall-data=n when compiling. Overrides the Memory model option.
          string VALUE: origin=ETAS-RTA-OS, set at pre-compile  # Value for Small data threshold
        container mcpu [0..1]  # Override the default value for the -mcpu compiler option. e.g. TC1766AC
          string VALUE: origin=ETAS-RTA-OS, set at pre-compile  # Value for mcpu override
        container su_files [0..1]  # Generate .su files [-fstack-usage compiler option]
          boolean VALUE: origin=ETAS-RTA-OS, set at pre-compile  # Value for emit stack usage
        container far_jumps [0..1]  # Select far jumps if interrupt/trap handlers are located at an address that is more than '24-bits' away from the vector tables.
          boolean VALUE: origin=ETAS-RTA-OS, set at pre-compile  # Value for Far jumps
    container OsRegSet [0..*]  # Target specific register sets that can be associated with a task or ISR. By association with a task or ISR, the integrator is specifying that a specific task or ISR uses this register set. Having no association defined allows potential optimization.
    container OsResource [0..*]  # An OsResource object is used to co-ordinate the concurrent access by tasks and ISRs to a shared resource, e.g. the scheduler, any program sequence, memory or any hardware area.
      enumeration OsResourceProperty: {INTERNAL, LINKED, STANDARD}, set at pre-compile  # This specifies the type of the resource.
      reference OsResourceAccessingApplication [0..*]: multiplicity set at pre-compile, set at pre-compile, destination=OsApplication  # Reference to applications which have an access to this object.
      reference OsResourceLinkedResourceRef [0..1]: multiplicity set at pre-compile, set at pre-compile, destination=OsResource  # The link to the resource. Must be valid if OsResourceProperty is LINKED. If OsResourceProperty is not LINKED the value is ignored.
    container OsScheduleTable [0..*]  # An OsScheduleTable addresses the synchronization issue by providing an encapsulation of a statically defined set of alarms that cannot be modified at runtime.
      integer OsScheduleTableDuration: 0..18446744073709551615, set at pre-compile  # This parameter defines the modulus of the schedule table (in ticks).
      boolean OsScheduleTableRepeating: scope=ECU, set at pre-compile  # true: first expiry point on the schedule table shall be processed at final expiry point delay ticks after the final expiry point is processed. | false: the schedule table processing stops when the final expiry point is processed.
      reference OsSchTblAccessingApplication [0..*]: multiplicity set at pre-compile, set at pre-compile, destination=OsApplication  # Reference to applications which have an access to this object.
      reference OsScheduleTableCounterRef: scope=ECU, set at pre-compile, destination=OsCounter  # This parameter contains a reference to the counter which drives the schedule table.
      container OsScheduleTableAutostart [0..1]  # This container specifies if and how the schedule table is started on startup of the Operating System. The options to start a schedule table correspond to the API calls to start schedule tables during runtime.
        enumeration OsScheduleTableAutostartType: {ABSOLUTE, RELATIVE, SYNCHRON}, set at pre-compile  # This specifies the type of the autostart for the schedule table.
        integer OsScheduleTableStartValue [0..1]: 0..18446744073709551615, scope=ECU, multiplicity set at pre-compile, set at pre-compile  # Absolute autostart tick value when the schedule table starts. Only used if the OsScheduleTableAutostartType is ABSOLUTE. | Relative offset in ticks when the schedule table starts. Only used if the OsScheduleTableAutostartType is RELATIVE.
        reference OsScheduleTableAppModeRef [1..*]: scope=ECU, multiplicity set at pre-compile, set at pre-compile, destination=OsAppMode  # Reference in which application modes the schedule table should be started during startup
      container OsScheduleTableExpiryPoint [1..*]  # The point on a Schedule Table at which the OS activates tasks and/or sets events
        integer OsScheduleTblExpPointOffset: 0..18446744073709551615, set at pre-compile  # The offset from zero (in ticks) at which the expiry point is to be processed.
        container OsScheduleTableEventSetting [0..*]  # Event that is triggered by that schedule table.
          reference OsScheduleTableSetEventRef: set at pre-compile, destination=OsEvent  # Reference to event that will be set by action
          reference OsScheduleTableSetEventTaskRef: set at pre-compile, destination=OsTask  # Reference to task owning the event that will be set by action
        container OsScheduleTableTaskActivation [0..*]  # Task that is triggered by that schedule table.
          reference OsScheduleTableActivateTaskRef: scope=ECU, set at pre-compile, destination=OsTask  # Reference to task that will be activated by action
        container OsScheduleTblAdjustableExpPoint [0..1]  # Adjustable expiry point
          integer OsScheduleTableMaxLengthen: 0..18446744073709551615, set at pre-compile  # The maximum positive adjustment that can be made to the expiry point offset (in ticks).
          integer OsScheduleTableMaxShorten: 0..18446744073709551615, set at pre-compile  # The maximum negative adjustment that can be made to the expiry point offset (in ticks).
      container OsScheduleTableSync [0..1]  # This container specifies the synchronization parameters of the schedule table.
        integer OsScheduleTblExplicitPrecision [0..1]: 0..18446744073709551615, scope=ECU, multiplicity set at pre-compile, set at pre-compile  # This configuration is only valid if the explicit synchronization is used.
        enumeration OsScheduleTblSyncStrategy: {EXPLICIT, IMPLICIT, NONE}, scope=ECU, origin=AUTOSAR ECUC, set at pre-compile, default-value=NONE  # AUTOSAR OS provides support for synchronization in two ways: explicit and implicit.
    container OsSpinlock [0..*]  # An OsSpinlock object is used to co-ordinate concurrent access by TASKs/ISR2s on different cores to a shared resource.
      enumeration OsSpinlockLockMethod [0..1]: origin=ETAS-RTA-OS_v5.7.0, set at pre-compile, default-value=LOCK_NOTHING  # Determines the locking method for the Spinlock.
        COMMONABLE_LOCK_ALL_INTERRUPTS  # Lock all interrupts when spinlock is taken. Lock is commonable.
        COMMONABLE_LOCK_CAT2_INTERRUPTS  # Lock OS interrupts when spinlock is taken. Lock is commonable.
        COMMONABLE_LOCK_NOTHING  # No lock when spinlock is taken. Lock is commonable.
        COMMONABLE_LOCK_WITH_RES_SCHEDULER  # Lock RES_SCHEDULER when spinlock is taken. Lock is commonable.
        LOCK_ALL_INTERRUPTS  # Lock all interrupts when spinlock is taken.
        LOCK_CAT2_INTERRUPTS  # Lock OS interrupts when spinlock is taken.
        LOCK_NOTHING  # No lock when spinlock is taken.
        LOCK_WITH_RES_SCHEDULER  # Lock RES_SCHEDULER when spinlock is taken.
        NESTABLE_COMMONABLE_LOCK_ALL_INTERRUPTS  # Lock all interrupts when spinlock is taken. Allow nesting. Lock is commonable.
        NESTABLE_COMMONABLE_LOCK_CAT2_INTERRUPTS  # Lock OS interrupts when spinlock is taken. Allow nesting. Lock is commonable.
        NESTABLE_COMMONABLE_LOCK_NOTHING  # No lock when spinlock is taken. Allow nesting. Lock is commonable.
        NESTABLE_COMMONABLE_LOCK_WITH_RES_SCHEDULER  # Lock RES_SCHEDULER when spinlock is taken. Allow nesting. Lock is commonable.
        NESTABLE_LOCK_ALL_INTERRUPTS  # Lock all interrupts when spinlock is taken. Allow nesting.
        NESTABLE_LOCK_CAT2_INTERRUPTS  # Lock OS interrupts when spinlock is taken. Allow nesting.
        NESTABLE_LOCK_NOTHING  # No lock when spinlock is taken. Allow nesting.
        NESTABLE_LOCK_WITH_RES_SCHEDULER  # Lock RES_SCHEDULER when spinlock is taken. Allow nesting.
      reference OsSpinlockAccessingApplication [1..*]: multiplicity set at pre-compile, set at pre-compile, destination=OsApplication  # Reference to OsApplications that have an access to this object.
      reference OsSpinlockSuccessor [0..1]: multiplicity set at pre-compile, set at pre-compile, destination=OsSpinlock  # Reference to OsApplications that have an access to this object. | To check whether a spinlock can be occupied (in a nested way) without any danger of deadlock, a linked list of spinlocks can be defined. A spinlock can only be occupied in the order of the linked list. It is allowed to skip a spinlock. If no linked list is specified, spinlocks cannot be nested.
    container OsTask [0..*]  # This container represents an OSEK task.
      integer OsTaskActivation: 1..4294967295, set at pre-compile  # This attribute defines the maximum number of queued activation requests for the task. A value equal to "1" means that at any time only a single activation is permitted for this task. Note that the value must be a natural number starting at 1.
      string OsTaskBudget [0..1]: origin=ETAS-RTA-OS_v5.7.0, set at pre-compile  # Execution budget expressed as a float, then timebase name, then units.
      boolean OsTaskCanCallSchedule [0..1]: origin=ETAS-RTA-OS_v5.7.0, set at pre-compile, default-value=true  # TRUE if a TASK calls, or might call, the Schedule() API. System stack usage may be reduced if this can be set FALSE. Ignored if global OS option 'Disallow Schedule()' is TRUE
      integer OsTaskPriority: 0..4294967295, set at pre-compile  # The priority of a task is defined by the value of this attribute. This value has to be understood as a relative value, i.e. the values show only the relative ordering of the tasks. | OSEK OS defines the lowest priority as zero (0); larger values correspond to higher priorities.
      enumeration OsTaskSchedule: {FULL, NON}, set at pre-compile  # The OsTaskSchedule attribute defines the preemptability of the task. | If this attribute is set to NON, no internal resources may be assigned to this task.
      string OsTaskStackAllocation [0..1]: origin=ETAS-RTA-OS_v5.7.0, set at pre-compile  # Task manual stack allocation in bytes.
      string OsTaskWaitStack [0..1]: origin=ETAS-RTA-OS_v5.7.0, set at pre-compile  # Task stack usage when invoking WaitEvent.
      reference OsRegSetRef [0..*]: origin=ETAS-RTA-OS_v5.7.0, set at pre-compile, destination=OsRegSet  # A reference to the register sets that are used by this Task.
      reference OsTaskAccessingApplication [0..*]: multiplicity set at pre-compile, set at pre-compile, destination=OsApplication  # Reference to applications which have an access to this object.
      reference OsTaskEventRef [0..*]: multiplicity set at pre-compile, set at pre-compile, destination=OsEvent  # This reference defines the list of events the extended task may react on.
      reference OsTaskResourceRef [0..*]: multiplicity set at pre-compile, set at pre-compile, destination=OsResource  # This reference defines a list of resources accessed by this task.
      container OsTaskAutostart [0..1]  # This container determines whether the task is activated during the system start-up procedure or not for some specific application modes. | If the task shall be activated during the system start-up, this container is present and holds the references to the application modes in which the task is auto-started.
        reference OsTaskAppModeRef [1..*]: multiplicity set at pre-compile, set at pre-compile, destination=OsAppMode  # Reference to application modes in which that task is activated on startup of the OS
      container OsTaskTimingProtection [0..1]  # This container contains all parameters regarding timing protection of the task.
        float OsTaskAllInterruptLockBudget [0..1]: 0..Inf, scope=ECU, multiplicity set at pre-compile, set at pre-compile  # This parameter contains the maximum time for which the task is allowed to lock all interrupts (via SuspendAllInterrupts() or DisableAllInterrupts()) (in seconds).
        float OsTaskExecutionBudget [0..1]: 0..Inf, scope=ECU, multiplicity set at pre-compile, set at pre-compile  # This parameter contains the maximum allowed execution time of the task (in seconds).
        float OsTaskOsInterruptLockBudget [0..1]: 0..Inf, scope=ECU, multiplicity set at pre-compile, set at pre-compile  # This parameter contains the maximum time for which the task is allowed to lock all Category 2 interrupts (via SuspendOSInterrupts()) (in seconds).
        float OsTaskTimeFrame [0..1]: 0..Inf, scope=ECU, multiplicity set at pre-compile, set at pre-compile  # The minimum inter-arrival time between activations and/or releases of a task (in seconds).
        container OsTaskResourceLock [0..*]  # This container contains the worst case time between getting and releasing a given resource (in seconds).
          float OsTaskResourceLockBudget: 0..Inf, scope=ECU, set at pre-compile  # This parameter contains the maximum time the task is allowed to lock the resource (in seconds)
          reference OsTaskResourceLockResourceRef: scope=ECU, set at pre-compile, destination=OsResource  # Reference to the resource used by the task
package /AUTOSAR_Os/LifeCycleInfoSets
  life cycle info set AUTOSARParameterDefinition
    life-cycle-infos:
      lc-object=BswMBswMModeRequest, lc-state=obsolete, period-begin=ar-release-version=4.2.2
      lc-object=BswMBswMModeDeclarationGroupRef, lc-state=obsolete, period-begin=ar-release-version=4.2.2
      lc-object=BswMBswMModeSwitchNotification, lc-state=obsolete, period-begin=ar-release-version=4.2.2
      lc-object=BswMBswMModeDeclarationGroupRef, lc-state=obsolete, period-begin=ar-release-version=4.2.2
      lc-object=BswMRequestRemoteMode, lc-state=obsolete, period-begin=ar-release-version=4.2.2
      lc-object=BswMModeDeclarationGroupPrototypeRef, lc-state=obsolete, period-begin=ar-release-version=4.2.2
      lc-object=BswMRequestedRemoteMode, lc-state=obsolete, period-begin=ar-release-version=4.2.2
      lc-object=BswMEcuCPartitionRef, lc-state=obsolete, period-begin=ar-release-version=4.2.2
      lc-object=BswMTriggerSlaveRTEStop, lc-state=obsolete
      lc-object=BswMCoreRef, lc-state=obsolete
      lc-object=BswMTriggerStartUpPhase2, lc-state=obsolete
      lc-object=BswMCoreRef, lc-state=obsolete
      lc-object=DcmDspDidInfotypeRef, lc-state=obsolete, period-begin=ar-release-version=4.2.2, remark=p=l-1=This reference is set to obsolete and will be removed in release 4.3. Use DcmDspEnableObdMirror instead.
      lc-object=DcmDspDidPidRef, lc-state=obsolete, period-begin=ar-release-version=4.2.2, remark=p=l-1=This reference is set to obsolete and will be removed in release 4.3. Use DcmDspEnableObdMirror instead.
      lc-object=DcmDspCommonAuthorizationRef, lc-state=obsolete, period-begin=ar-release-version=4.2.2, remark=p=l-1=This reference is set to obsolete and will be removed in release 4.3.
      lc-object=DcmDspRoutineTidRef, lc-state=obsolete, period-begin=ar-release-version=4.2.2, remark=p=l-1=This reference is set to obsolete and will be removed in release 4.3. Use DcmDspEnableObdMirror instead.
      lc-object=DemAgingCycleCounterProcessing, lc-state=obsolete, period-begin=ar-release-version=4.2.2, remark=p=l-1=This reference is set to obsolete and will be removed in release 4.3.
      lc-object=DemOBDDestinationOfEventsRef, lc-state=obsolete, period-begin=ar-release-version=4.2.2, remark=p=l-1=This reference is set to obsolete and will be removed in release 4.3.
      lc-object=EthIfMainFunctionRxTimeout, lc-state=obsolete, period-begin=ar-release-version=4.2.2
      lc-object=EthTSynGlobalTimeDomainId, lc-state=obsolete, period-begin=ar-release-version=4.2.2
      lc-object=FiMDataFixed, lc-state=obsolete
      lc-object=FiMTaskTime, lc-state=obsolete
      lc-object=FlsDemEventParameterRefs, lc-state=obsolete, period-begin=ar-release-version=4.2.2, remark=p=l-1=This container is set to obsolete and will be removed in release 4.3.
      lc-object=FLS_E_COMPARE_FAILED, lc-state=obsolete, period-begin=ar-release-version=4.2.2, remark=p=l-1=This reference is set to obsolete and will be removed in release 4.3.
      lc-object=FLS_E_ERASE_FAILED, lc-state=obsolete, period-begin=ar-release-version=4.2.2, remark=p=l-1=This reference is set to obsolete and will be removed in release 4.3.
      lc-object=FLS_E_READ_FAILED, lc-state=obsolete, period-begin=ar-release-version=4.2.2, remark=p=l-1=This reference is set to obsolete and will be removed in release 4.3.
      lc-object=FLS_E_UNEXPECTED_FLASH_ID, lc-state=obsolete, period-begin=ar-release-version=4.2.2, remark=p=l-1=This reference is set to obsolete and will be removed in release 4.3.
      lc-object=FLS_E_WRITE_FAILED, lc-state=obsolete, period-begin=ar-release-version=4.2.2, remark=p=l-1=This reference is set to obsolete and will be removed in release 4.3.
      lc-object=FlsTstNumberOfTestedCells, lc-state=obsolete, period-begin=ar-release-version=4.2.2
      lc-object=FlsTstNumberOfTestedCells, lc-state=obsolete, period-begin=ar-release-version=4.2.2
      lc-object=FrNmNumberOfClusters, lc-state=obsolete, period-begin=ar-release-version=4.2.2
      lc-object=LinNmComUserDataSupport, lc-state=obsolete
      lc-object=UDPNM_E_NETWORK_TIMEOUT, lc-state=obsolete, period-begin=ar-release-version=4.2.2
      lc-object=UDPNM_E_TCPIP_TRANSMIT_ERROR, lc-state=obsolete, period-begin=ar-release-version=4.2.2
      lc-object=WDGM_E_IMPROPER_CALLER, lc-state=obsolete, period-begin=ar-release-version=4.2.2, remark=p=l-1=This reference is set to obsolete and will be removed in R 4.3
      lc-object=WDGM_E_MONITORING, lc-state=obsolete, period-begin=ar-release-version=4.2.2, remark=p=l-1=use WDGM_E_SUPERVISION instead
      lc-object=WdgMDefensiveBehavior, lc-state=obsolete, period-begin=ar-release-version=4.2.2, remark=p=l-1=This parameter is set to obsolete and will be removed in R 4.3
      lc-object=WdgMCallerIds, lc-state=obsolete, period-begin=ar-release-version=4.2.2, remark=p=l-1=This container is set to obsolete and will be removed in R4.3
      lc-object=WdgMCallerId, lc-state=obsolete, period-begin=ar-release-version=4.2.2, remark=p=l-1=This parameter is set to obsolete and will be removed in R4.3
      lc-object=XfmTransformationBswModuleEntryRef, lc-state=obsolete, period-begin=ar-release-version=4.2.2
