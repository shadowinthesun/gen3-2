AUTOSAR XML (schema 4-0-3)
package /CSCR_Code_pkg/CSCR_Code_if
  121 x sender receiver interface:
    VaCSCR_U_CellVoltageArray_out
      data VaCSCR_U_CellVoltageArray_out: category=ARRAY, sw-calibration-access=READ-ONLY, type=rt_Array_Float_96
    VaCSCR_b_CellVoltageArrayFaulted_out
      data VaCSCR_b_CellVoltageArrayFaulted_out: category=ARRAY, sw-calibration-access=READ-ONLY, type=rt_Array_Boolean_96
    VeCSCR_U_MaxCellVoltageMod
      data VeCSCR_U_MaxCellVoltageMod: category=VALUE, sw-calibration-access=READ-ONLY, type=Float
    VeCSCR_n_MaxCellVoltageIndex
      data VeCSCR_n_MaxCellVoltageIndex: category=VALUE, sw-calibration-access=READ-ONLY, type=UInt8
    VeCSCR_U_MinCellVoltageMod
      data VeCSCR_U_MinCellVoltageMod: category=VALUE, sw-calibration-access=READ-ONLY, type=Float
    VeCSCR_n_MinCellVoltageIndex
      data VeCSCR_n_MinCellVoltageIndex: category=VALUE, sw-calibration-access=READ-ONLY, type=UInt8
    VeCSCR_U_DeltaCellVoltage
      data VeCSCR_U_DeltaCellVoltage: category=VALUE, sw-calibration-access=READ-ONLY, type=Float
    VeCSCR_U_SumPackVoltageMod
      data VeCSCR_U_SumPackVoltageMod: category=VALUE, sw-calibration-access=READ-ONLY, type=Float
    VeCSCR_U_AvgCellVoltageMod
      data VeCSCR_U_AvgCellVoltageMod: category=VALUE, sw-calibration-access=READ-ONLY, type=Float
    VeCSCR_U_VoltageStandardDevMod
      data VeCSCR_U_VoltageStandardDevMod: category=VALUE, sw-calibration-access=READ-ONLY, type=Float
    VeCSCR_U_PackVoltage_out
      data VeCSCR_U_PackVoltage_out: category=VALUE, sw-calibration-access=READ-ONLY, type=Float
    VaCSCR_U_StackArray_out
      data VaCSCR_U_StackArray_out: category=ARRAY, sw-calibration-access=READ-ONLY, type=rt_Array_Float_8
    VaCSCR_b_StackArrayFaulted_out
      data VaCSCR_b_StackArrayFaulted_out: category=ARRAY, sw-calibration-access=READ-ONLY, type=rt_Array_Boolean_8
    VaCSCR_I_CellCurrentArray_out
      data VaCSCR_I_CellCurrentArray_out: category=ARRAY, sw-calibration-access=READ-ONLY, type=rt_Array_Float_2
    VaCSCR_b_CellCurrentArrayFaulted_out
      data VaCSCR_b_CellCurrentArrayFaulted_out: category=ARRAY, sw-calibration-access=READ-ONLY, type=rt_Array_Boolean_2
    VeCSCR_U_CellVoltage
      data VeCSCR_U_CellVoltage: category=VALUE, sw-calibration-access=READ-ONLY, type=Float
    VeCSCR_n_CellVoltSensorIndex
      data VeCSCR_n_CellVoltSensorIndex: category=VALUE, sw-calibration-access=READ-ONLY, type=UInt8
    VeCSCR_T_MaxCellTempMod
      data VeCSCR_T_MaxCellTempMod: category=VALUE, sw-calibration-access=READ-ONLY, type=Float
    VeCSCR_n_MaxTempIndex
      data VeCSCR_n_MaxTempIndex: category=VALUE, sw-calibration-access=READ-ONLY, type=UInt8
    VeCSCR_T_MinCellTempMod
      data VeCSCR_T_MinCellTempMod: category=VALUE, sw-calibration-access=READ-ONLY, type=Float
    VeCSCR_n_MinTempIndex
      data VeCSCR_n_MinTempIndex: category=VALUE, sw-calibration-access=READ-ONLY, type=UInt8
    VeCSCR_T_DeltaCellTemp
      data VeCSCR_T_DeltaCellTemp: category=VALUE, sw-calibration-access=READ-ONLY, type=Float
    VeCSCR_T_AvgCellTempMod
      data VeCSCR_T_AvgCellTempMod: category=VALUE, sw-calibration-access=READ-ONLY, type=Float
    VeCSCR_T_TempStandardDevMod
      data VeCSCR_T_TempStandardDevMod: category=VALUE, sw-calibration-access=READ-ONLY, type=Float
    VeCSCR_T_ModuleTemperature
      data VeCSCR_T_ModuleTemperature: category=VALUE, sw-calibration-access=READ-ONLY, type=Float
    VeCSCR_n_MaxTempIndexPack
      data VeCSCR_n_MaxTempIndexPack: category=VALUE, sw-calibration-access=READ-ONLY, type=UInt8
    VeCSCR_n_MinTempIndexPack
      data VeCSCR_n_MinTempIndexPack: category=VALUE, sw-calibration-access=READ-ONLY, type=UInt8
    VeCSCR_T_MaxPackTemp
      data VeCSCR_T_MaxPackTemp: category=VALUE, sw-calibration-access=READ-ONLY, type=Float
    VeCSCR_T_MinPackTemp
      data VeCSCR_T_MinPackTemp: category=VALUE, sw-calibration-access=READ-ONLY, type=Float
    VeCSCR_T_TempSensor
      data VeCSCR_T_TempSensor: category=VALUE, sw-calibration-access=READ-ONLY, type=Float
    VeCSCR_n_TempSensorIndex
      data VeCSCR_n_TempSensorIndex: category=VALUE, sw-calibration-access=READ-ONLY, type=UInt8
    VeCSCR_b_BatteryUniformity
      data VeCSCR_b_BatteryUniformity: category=BOOLEAN, sw-calibration-access=READ-ONLY, type=Boolean
    VeCSCR_b_SysParamMismatch
      data VeCSCR_b_SysParamMismatch: category=BOOLEAN, sw-calibration-access=READ-ONLY, type=Boolean
    VeCSCR_b_BatteryTempMismatch
      data VeCSCR_b_BatteryTempMismatch: category=BOOLEAN, sw-calibration-access=READ-ONLY, type=Boolean
    VeCSCR_U_BattVoltForDB
      data VeCSCR_U_BattVoltForDB: category=VALUE, sw-calibration-access=READ-ONLY, type=Float
    VeCSCR_b_DeltaCellTemp_flt
      data VeCSCR_b_DeltaCellTemp_flt: category=BOOLEAN, sw-calibration-access=READ-ONLY, type=Boolean
    VeCSCR_k_CellCircuit_flt
      data VeCSCR_k_CellCircuit_flt: category=VALUE, sw-calibration-access=READ-ONLY, type=UInt8
    VeCSCR_k_StackCircuit_flt
      data VeCSCR_k_StackCircuit_flt: category=VALUE, sw-calibration-access=READ-ONLY, type=UInt8
    VeCSCR_b_CellCurrentArray_flt
      data VeCSCR_b_CellCurrentArray_flt: category=BOOLEAN, sw-calibration-access=READ-ONLY, type=Boolean
    VeCSCR_U_SumStackVoltages
      data VeCSCR_U_SumStackVoltages: category=VALUE, sw-calibration-access=READ-ONLY, type=Float
    VeCSCR_b_CurrSensor_flt
      data VeCSCR_b_CurrSensor_flt: category=BOOLEAN, sw-calibration-access=READ-ONLY, type=Boolean
    VeCSCR_U_LinkN2PackVolt_out
      data VeCSCR_U_LinkN2PackVolt_out: category=VALUE, sw-calibration-access=READ-ONLY, type=Float
    VeCSCR_b_PackVoltageFltd
      data VeCSCR_b_PackVoltageFltd: category=BOOLEAN, sw-calibration-access=READ-ONLY, type=Boolean
    VeCSCR_I_HVCurrent
      data VeCSCR_I_HVCurrent: category=VALUE, sw-calibration-access=READ-ONLY, type=Float
    VeCSCR_b_HVCurrentFaulted
      data VeCSCR_b_HVCurrentFaulted: category=BOOLEAN, sw-calibration-access=READ-ONLY, type=Boolean
    VeCSCR_k_CurSensorType
      data VeCSCR_k_CurSensorType: category=VALUE, sw-calibration-access=READ-ONLY, type=UInt8
    VeCSCR_b_CellUArrayReady
      data VeCSCR_b_CellUArrayReady: category=BOOLEAN, sw-calibration-access=READ-ONLY, type=Boolean
    VeCSCR_k_CBCircuit_flt
      data VeCSCR_k_CBCircuit_flt: category=VALUE, sw-calibration-access=READ-ONLY, type=UInt8
    VeCSCR_b_CellVoltage_Inv
      data VeCSCR_b_CellVoltage_Inv: category=BOOLEAN, sw-calibration-access=READ-ONLY, type=Boolean
    VeCSCR_k_TempArray_flt
      data VeCSCR_k_TempArray_flt: category=VALUE, sw-calibration-access=READ-ONLY, type=UInt8
    VeCSCR_b_QconOverTemp_L1_flt
      data VeCSCR_b_QconOverTemp_L1_flt: category=BOOLEAN, sw-calibration-access=READ-ONLY, type=Boolean
    VeCSCR_b_QconOverTemp_L2_flt
      data VeCSCR_b_QconOverTemp_L2_flt: category=BOOLEAN, sw-calibration-access=READ-ONLY, type=Boolean
    VeCSCR_b_CurrentSensor_flt
      data VeCSCR_b_CurrentSensor_flt: category=BOOLEAN, sw-calibration-access=READ-ONLY, type=Boolean
    VeCSCR_T_MaxSenorTemp
      data VeCSCR_T_MaxSenorTemp: category=VALUE, sw-calibration-access=READ-ONLY, type=Float
    VeCSCR_T_MinSenorTemp
      data VeCSCR_T_MinSenorTemp: category=VALUE, sw-calibration-access=READ-ONLY, type=Float
    VeCSCR_n_MaxSenorTempIndex
      data VeCSCR_n_MaxSenorTempIndex: category=VALUE, sw-calibration-access=READ-ONLY, type=UInt8
    VeCSCR_n_MinSenorTempIndex
      data VeCSCR_n_MinSenorTempIndex: category=VALUE, sw-calibration-access=READ-ONLY, type=UInt8
    VaCSCR_T_CellTempArray_out
      data VaCSCR_T_CellTempArray_out: category=ARRAY, sw-calibration-access=READ-ONLY, type=rt_Array_Float_16
    VeCSCR_k_TempArray_flt_CAN
      data VeCSCR_k_TempArray_flt_CAN: category=VALUE, sw-calibration-access=READ-ONLY, type=UInt8
    VeCSCR_b_AveTempReady
      data VeCSCR_b_AveTempReady: category=BOOLEAN, sw-calibration-access=READ-ONLY, type=Boolean
    VeCSCR_b_SafetyConnectStatus
      data VeCSCR_b_SafetyConnectStatus: category=BOOLEAN, sw-calibration-access=READ-ONLY, type=Boolean
    VeCSCR_b_CellTemp_Inv
      data VeCSCR_b_CellTemp_Inv: category=BOOLEAN, sw-calibration-access=READ-ONLY, type=Boolean
    VaCSCR_dT_CellTempRate_out
      data VaCSCR_dT_CellTempRate_out: category=ARRAY, sw-calibration-access=READ-ONLY, type=rt_Array_Float_16
    VaCSCR_T_WaterTempArray
      data VaCSCR_T_WaterTempArray: category=ARRAY, sw-calibration-access=READ-ONLY, type=rt_Array_Float_2
    VaCSCR_b_WaterTemp_Inv
      data VaCSCR_b_WaterTemp_Inv: category=ARRAY, sw-calibration-access=READ-ONLY, type=rt_Array_Boolean_2
    VeCSCR_k_WaterTemp_flt
      data VeCSCR_k_WaterTemp_flt: category=VALUE, sw-calibration-access=READ-ONLY, type=UInt8
    VeCSCR_n_WaterTemp_flt_CAN
      data VeCSCR_n_WaterTemp_flt_CAN: category=VALUE, sw-calibration-access=READ-ONLY, type=UInt8
    VeCSCR_T_MaxPCBTemp
      data VeCSCR_T_MaxPCBTemp: category=VALUE, sw-calibration-access=READ-ONLY, type=Float
    VeCSCR_T_MinPCBTemp
      data VeCSCR_T_MinPCBTemp: category=VALUE, sw-calibration-access=READ-ONLY, type=Float
    VeCSCR_T_AvePCBTemp
      data VeCSCR_T_AvePCBTemp: category=VALUE, sw-calibration-access=READ-ONLY, type=Float
    VeCSCR_n_MaxPCBTempIndex
      data VeCSCR_n_MaxPCBTempIndex: category=VALUE, sw-calibration-access=READ-ONLY, type=UInt8
    VeCSCR_n_MinPCBTempIndex
      data VeCSCR_n_MinPCBTempIndex: category=VALUE, sw-calibration-access=READ-ONLY, type=UInt8
    VeCSCR_b_PCBTemp_Inv
      data VeCSCR_b_PCBTemp_Inv: category=BOOLEAN, sw-calibration-access=READ-ONLY, type=Boolean
    VeCSCR_U_Heat2PackVolt_out
      data VeCSCR_U_Heat2PackVolt_out: category=VALUE, sw-calibration-access=READ-ONLY, type=Float
    VeCSCR_U_LinkP2PackVolt_out
      data VeCSCR_U_LinkP2PackVolt_out: category=VALUE, sw-calibration-access=READ-ONLY, type=Float
    VeCSCR_n_MaxVoltIndexPack
      data VeCSCR_n_MaxVoltIndexPack: category=VALUE, sw-calibration-access=READ-ONLY, type=UInt8
    VeCSCR_n_MinVoltIndexPack
      data VeCSCR_n_MinVoltIndexPack: category=VALUE, sw-calibration-access=READ-ONLY, type=UInt8
    VeCSCR_U_LinkP2PackVolt_CAN
      data VeCSCR_U_LinkP2PackVolt_CAN: category=VALUE, sw-calibration-access=READ-ONLY, type=Float
    VeCSCR_U_LinkN2PackVolt_CAN
      data VeCSCR_U_LinkN2PackVolt_CAN: category=VALUE, sw-calibration-access=READ-ONLY, type=Float
    VeCSCR_U_Heat2PackVolt_CAN
      data VeCSCR_U_Heat2PackVolt_CAN: category=VALUE, sw-calibration-access=READ-ONLY, type=Float
    VeCSCR_k_PCBTempInv_Flt
      data VeCSCR_k_PCBTempInv_Flt: category=VALUE, sw-calibration-access=READ-ONLY, type=UInt8
    VeCSCR_k_PackVolt_flt
      data VeCSCR_k_PackVolt_flt: category=VALUE, sw-calibration-access=READ-ONLY, type=UInt8
    VeCSCR_k_LinkPVolt_flt
      data VeCSCR_k_LinkPVolt_flt: category=VALUE, sw-calibration-access=READ-ONLY, type=UInt8
    VeCSCR_k_LinkNVolt_flt
      data VeCSCR_k_LinkNVolt_flt: category=VALUE, sw-calibration-access=READ-ONLY, type=UInt8
    VeCSCR_k_HeatVolt_flt
      data VeCSCR_k_HeatVolt_flt: category=VALUE, sw-calibration-access=READ-ONLY, type=UInt8
    VeCSCR_I_PackShuntCurrent
      data VeCSCR_I_PackShuntCurrent: category=VALUE, sw-calibration-access=READ-ONLY, type=Float
    VeCSCR_b_PackShuntCurrentFaulted
      data VeCSCR_b_PackShuntCurrentFaulted: category=BOOLEAN, sw-calibration-access=READ-ONLY, type=Boolean
    VeCSCR_T_InletWaterTemp
      data VeCSCR_T_InletWaterTemp: category=VALUE, sw-calibration-access=READ-ONLY, type=Float
    VeCSCR_T_OutletWaterTemp
      data VeCSCR_T_OutletWaterTemp: category=VALUE, sw-calibration-access=READ-ONLY, type=Float
    VaLLSR_U_CellVoltageArray
      data VaLLSR_U_CellVoltageArray: category=ARRAY, type=rt_Array_Float_96
    VaLLSR_b_CellVoltage_Inv
      data VaLLSR_b_CellVoltage_Inv: category=ARRAY, type=rt_Array_Boolean_96
    VeLLSR_U_PackVoltage
      data VeLLSR_U_PackVoltage: category=VALUE, type=Float
    VeLLSR_b_PackVoltage_Inv
      data VeLLSR_b_PackVoltage_Inv: category=BOOLEAN, type=Boolean
    VeLLSR_U_LinkP2PackVolt
      data VeLLSR_U_LinkP2PackVolt: category=VALUE, type=Float
    VeLLSR_b_LinkP2PackVolt_Inv
      data VeLLSR_b_LinkP2PackVolt_Inv: category=BOOLEAN, type=Boolean
    VaLLSR_U_StackArray
      data VaLLSR_U_StackArray: category=ARRAY, type=rt_Array_Float_8
    VaLLSR_b_StackVoltage_Inv
      data VaLLSR_b_StackVoltage_Inv: category=ARRAY, type=rt_Array_Boolean_8
    VaLLSR_I_CellCurrentArray
      data VaLLSR_I_CellCurrentArray: category=ARRAY, type=rt_Array_Float_2
    VaLLSR_b_CellCurrent_Inv
      data VaLLSR_b_CellCurrent_Inv: category=ARRAY, type=rt_Array_Boolean_2
    VaLLSR_T_CellTempArray
      data VaLLSR_T_CellTempArray: category=ARRAY, type=rt_Array_Float_16
    VaLLSR_b_CellTemp_Inv
      data VaLLSR_b_CellTemp_Inv: category=ARRAY, type=rt_Array_Boolean_16
    VeLLSR_T_DCChargePosTemp
      data VeLLSR_T_DCChargePosTemp: category=VALUE, type=Float
    VeLLSR_T_DCChargeNegTemp
      data VeLLSR_T_DCChargeNegTemp: category=VALUE, type=Float
    VeLLSR_U_LinkN2PackVolt
      data VeLLSR_U_LinkN2PackVolt: category=VALUE, type=Float
    VeLLSR_b_LinkN2PackVolt_Inv
      data VeLLSR_b_LinkN2PackVolt_Inv: category=BOOLEAN, type=Boolean
    VeLLSR_I_HVCurrent
      data VeLLSR_I_HVCurrent: category=VALUE, type=Float
    VeLLSR_b_HVCurrent_Inv
      data VeLLSR_b_HVCurrent_Inv: category=BOOLEAN, type=Boolean
    VeLLSR_k_CurSensorType
      data VeLLSR_k_CurSensorType: category=VALUE, type=UInt8
    VaLLSR_b_TempCircuitFaulted
      data VaLLSR_b_TempCircuitFaulted: category=ARRAY, type=rt_Array_Boolean_16
    VaLLSR_b_StackCircuitFaulted
      data VaLLSR_b_StackCircuitFaulted: category=ARRAY, type=rt_Array_Boolean_8
    VaLLSR_b_CellCircuitFaulted
      data VaLLSR_b_CellCircuitFaulted: category=ARRAY, type=rt_Array_Boolean_96
    VeLLSR_b_ClearDTC
      data VeLLSR_b_ClearDTC: category=BOOLEAN, type=Boolean
    VaLLSR_b_CBCircuitFaulted
      data VaLLSR_b_CBCircuitFaulted: category=ARRAY, type=rt_Array_Boolean_96
    VaLLSR_T_WaterTempArray
      data VaLLSR_T_WaterTempArray: category=ARRAY, type=rt_Array_Float_2
    VaLLSR_b_WaterTemp_Inv
      data VaLLSR_b_WaterTemp_Inv: category=ARRAY, type=rt_Array_Boolean_2
    VaLLSR_b_WaterTempCircuitFaulted
      data VaLLSR_b_WaterTempCircuitFaulted: category=ARRAY, type=rt_Array_Boolean_2
    VaLLSR_T_PCBTempArray
      data VaLLSR_T_PCBTempArray: category=ARRAY, type=rt_Array_Float_11
    VaLLSR_b_PCBTemp_Inv
      data VaLLSR_b_PCBTemp_Inv: category=ARRAY, type=rt_Array_Boolean_11
    VeLLSR_U_Heat2PackVolt
      data VeLLSR_U_Heat2PackVolt: category=VALUE, type=Float
    VeLLSR_b_Heat2PackVolt_Inv
      data VeLLSR_b_Heat2PackVolt_Inv: category=BOOLEAN, type=Boolean
    VeLLSR_I_PackShuntCurrent
      data VeLLSR_I_PackShuntCurrent: category=VALUE, type=Float
package /CalibrationComponents
  parameter interface CSCR_if
    211 x parameter data prototype, all with sw-calibration-access=READ-WRITE:
      KaCSCR_I_OvrdCellCurrArrayVals: category=ARRAY, type=rt_Array_Float_2
      KaCSCR_T_OvrdCellTempArrayVals: category=ARRAY, type=rt_Array_Float_16
      KaCSCR_U_OvrdCellVoltArrayVals: category=ARRAY, type=rt_Array_Float_96
      KaCSCR_U_OvrdStackVoltValue: category=ARRAY, type=rt_Array_Float_8
      KaCSCR_dT_CellTempRate_out_Val: category=ARRAY, type=rt_Array_Float_16
      KeCSCR_I_HVCurrent_Val: category=VALUE, type=Float
      KeCSCR_I_PackCurrDefaultVal: category=VALUE, type=Float
      KeCSCR_I_ShuntCurrent_Val: category=VALUE, type=Float
      KeCSCR_T_AvePCBTemp_Val: category=VALUE, type=Float
      KeCSCR_T_AvgCellTempMod_maxVal: category=VALUE, type=Float
      KeCSCR_T_AvgCellTempMod_minVal: category=VALUE, type=Float
      KeCSCR_T_CellTempArray_out_maxVal: category=VALUE, type=Float
      KeCSCR_T_CellTempArray_out_minVal: category=VALUE, type=Float
      KeCSCR_T_DeltaCellTemp_Val: category=VALUE, type=Float
      KeCSCR_T_DeltaCellTemp_maxVal: category=VALUE, type=Float
      KeCSCR_T_DeltaCellTemp_minVal: category=VALUE, type=Float
      KeCSCR_T_MaxCellTempMod_maxVal: category=VALUE, type=Float
      KeCSCR_T_MaxCellTempMod_minVal: category=VALUE, type=Float
      KeCSCR_T_MaxCellTempOvrdVal: category=VALUE, type=Float
      KeCSCR_T_MaxPCBTemp_Val: category=VALUE, type=Float
      KeCSCR_T_MaxPackTempOvrdVal: category=VALUE, type=Float
      KeCSCR_T_MaxPackTemp_maxVal: category=VALUE, type=Float
      KeCSCR_T_MaxPackTemp_minVal: category=VALUE, type=Float
      KeCSCR_T_MaxSenorTempOvrdVal: category=VALUE, type=Float
      KeCSCR_T_MaxTempFault: category=VALUE, type=Float
      KeCSCR_T_MinCellTempMod_maxVal: category=VALUE, type=Float
      KeCSCR_T_MinCellTempMod_minVal: category=VALUE, type=Float
      KeCSCR_T_MinCellTempOvrdVal: category=VALUE, type=Float
      KeCSCR_T_MinPCBTemp_Val: category=VALUE, type=Float
      KeCSCR_T_MinPackTempOvrdVal: category=VALUE, type=Float
      KeCSCR_T_MinPackTemp_maxVal: category=VALUE, type=Float
      KeCSCR_T_MinPackTemp_minVal: category=VALUE, type=Float
      KeCSCR_T_MinSenorTempOvrdVal: category=VALUE, type=Float
      KeCSCR_T_MinTempFault: category=VALUE, type=Float
      KeCSCR_T_ModuleTemperatureOvrdVal: category=VALUE, type=Float
      KeCSCR_T_OvrdAvgCellTempVal: category=VALUE, type=Float
      KeCSCR_T_PCBTempDeftVal: category=VALUE, type=Float
      KeCSCR_T_WaterTempDeftVal: category=VALUE, type=Float
      KeCSCR_U_BattVoltForDBOvrdVal: category=VALUE, type=Float
      KeCSCR_U_CellVoltArrayDefaultVals: category=VALUE, type=Float
      KeCSCR_U_CellVoltageArray_out_maxVal: category=VALUE, type=Float
      KeCSCR_U_CellVoltageArray_out_minVal: category=VALUE, type=Float
      KeCSCR_U_CellVoltageOvrdVal: category=VALUE, type=Float
      KeCSCR_U_DeltaCellVoltage_Val: category=VALUE, type=Float
      KeCSCR_U_Heat2PackVolt_Val: category=VALUE, type=Float
      KeCSCR_U_Heat2PackVolt_maxVal: category=VALUE, type=Float
      KeCSCR_U_Heat2PackVolt_minVal: category=VALUE, type=Float
      KeCSCR_U_Heat2PackVoltageDefaultVal: category=VALUE, type=Float
      KeCSCR_U_LinkNeg2PackVolt_Val: category=VALUE, type=Float
      KeCSCR_U_LinkNeg2PackVolt_maxVal: category=VALUE, type=Float
      KeCSCR_U_LinkNeg2PackVolt_minVal: category=VALUE, type=Float
      KeCSCR_U_LinkNeg2PackVoltageDefaultVal: category=VALUE, type=Float
      KeCSCR_U_LinkPos2PackVoltageDefaultVal: category=VALUE, type=Float
      KeCSCR_U_LinkPos2PackVoltage_out_maxVal: category=VALUE, type=Float
      KeCSCR_U_LinkPos2PackVoltage_out_minVal: category=VALUE, type=Float
      KeCSCR_U_MaxCellVoltOvrdVal: category=VALUE, type=Float
      KeCSCR_U_MaxCellVoltageMod_maxVal: category=VALUE, type=Float
      KeCSCR_U_MaxCellVoltageMod_minVal: category=VALUE, type=Float
      KeCSCR_U_MinCellVoltOvrdVal: category=VALUE, type=Float
      KeCSCR_U_MinCellVoltageMod_maxVal: category=VALUE, type=Float
      KeCSCR_U_MinCellVoltageMod_minVal: category=VALUE, type=Float
      KeCSCR_U_OvrdAvgCellVoltVal: category=VALUE, type=Float
      KeCSCR_U_OvrdLinkVoltValue: category=VALUE, type=Float
      KeCSCR_U_OvrdPackVoltValue: category=VALUE, type=Float
      KeCSCR_U_PackTempDefaultVal: category=VALUE, type=Float
      KeCSCR_U_PackVoltageDefaultVal: category=VALUE, type=Float
      KeCSCR_U_PackVoltage_out_maxVal: category=VALUE, type=Float
      KeCSCR_U_PackVoltage_out_minVal: category=VALUE, type=Float
      KeCSCR_U_SumPackVoltOvrdVal: category=VALUE, type=Float
      KeCSCR_U_SumPackVoltageMod_maxVal: category=VALUE, type=Float
      KeCSCR_U_SumPackVoltageMod_minVal: category=VALUE, type=Float
      KeCSCR_U_ThrshldDiffVoltSumCellPack: category=VALUE, type=Float
      KeCSCR_n_OvrdVoltStandardDevVal: category=VALUE, type=Float
      KeCSCR_r_TempLPFGain: category=VALUE, type=Float
      KeCSCR_t_CBCircuitFaultMaturation: category=VALUE, type=Float
      KeCSCR_t_CellTempRateTimeConstant: category=VALUE, type=Float
      KeCSCR_t_FastSampleRate: category=VALUE, type=Float
      KeCSCR_t_Maxinitwaittime: category=VALUE, type=Float
      KeCSCR_t_SlowSampleRate: category=VALUE, type=Float
      KeCSCR_t_TempCircuitFaultDeMaturation: category=VALUE, type=Float
      KeCSCR_t_TempCircuitFaultMaturation: category=VALUE, type=Float
      KeCSCR_t_TempFncCall: category=VALUE, type=Float
      KeCSCR_t_TempLPFWarmupTime: category=VALUE, type=Float
      KeCSCR_Cnt_DeltaCellTempFltDbnc: category=VALUE, type=UInt16
      KaCSCR_b_OvrdCellTempFltArrayVals: category=ARRAY, type=rt_Array_Boolean_16
      KaCSCR_b_OvrdCellVoltArrayFaultedVals: category=ARRAY, type=rt_Array_Boolean_96
      KaCSCR_b_WaterTemp_Inv_En: category=BOOLEAN, type=Boolean
      KaCSCR_b_WaterTemp_Inv_Val: category=ARRAY, type=rt_Array_Boolean_2
      KaLLSR_b_CellCircuitFaulted_Val: category=ARRAY, type=rt_Array_Boolean_96
      KaLLSR_b_StackCircuitFaulted_Val: category=ARRAY, type=rt_Array_Boolean_8
      KaLLSR_b_TempCircuitFaulted_Val: category=ARRAY, type=rt_Array_Boolean_16
      KaLLSR_b_WaterTempCircuitFaulted_Val: category=BOOLEAN, type=Boolean
      KeCSCR_I_HVCurrent_En: category=BOOLEAN, type=Boolean
      KeCSCR_I_ShuntCurrent_En: category=BOOLEAN, type=Boolean
      KeCSCR_U_Heat2PackVolt_En: category=BOOLEAN, type=Boolean
      KeCSCR_U_LinkNeg2PackVolt_En: category=BOOLEAN, type=Boolean
      KeCSCR_b_AvePCBTemp_En: category=BOOLEAN, type=Boolean
      KeCSCR_b_BattVoltForDBOvrd: category=BOOLEAN, type=Boolean
      KeCSCR_b_BatteryTempMismatchOvrd: category=BOOLEAN, type=Boolean
      KeCSCR_b_BatteryTempMismatchOvrdVal: category=BOOLEAN, type=Boolean
      KeCSCR_b_BatteryUniformityOvrd: category=BOOLEAN, type=Boolean
      KeCSCR_b_BatteryUniformityOvrdVal: category=BOOLEAN, type=Boolean
      KeCSCR_b_CBCircuit_flt_En: category=BOOLEAN, type=Boolean
      KeCSCR_b_CellCircuit_flt_En: category=BOOLEAN, type=Boolean
      KeCSCR_b_CellCurrentArrayFltEnable: category=BOOLEAN, type=Boolean
      KeCSCR_b_CellTempLPFEnable: category=BOOLEAN, type=Boolean
      KeCSCR_b_CellTempRate_out_En: category=BOOLEAN, type=Boolean
      KeCSCR_b_CellTemp_Inv_En: category=BOOLEAN, type=Boolean
      KeCSCR_b_CellTemp_Inv_Val: category=BOOLEAN, type=Boolean
      KeCSCR_b_CellUArrayReady_En: category=BOOLEAN, type=Boolean
      KeCSCR_b_CellUArrayReady_Val: category=BOOLEAN, type=Boolean
      KeCSCR_b_CellVoltSensorIndexOvrd: category=BOOLEAN, type=Boolean
      KeCSCR_b_CellVoltageOvrd: category=BOOLEAN, type=Boolean
      KeCSCR_b_CellVoltage_Inv_En: category=BOOLEAN, type=Boolean
      KeCSCR_b_CellVoltage_Inv_Val: category=BOOLEAN, type=Boolean
      KeCSCR_b_CurrSensor_flt_En: category=BOOLEAN, type=Boolean
      KeCSCR_b_CurrSensor_flt_Val: category=BOOLEAN, type=Boolean
      KeCSCR_b_CurrentSensorFltOvrd: category=BOOLEAN, type=Boolean
      KeCSCR_b_CurrentSensorFltOvrdVal: category=BOOLEAN, type=Boolean
      KeCSCR_b_DeltaCellTempFltOvrd: category=BOOLEAN, type=Boolean
      KeCSCR_b_DeltaCellTempFltOvrdVal: category=BOOLEAN, type=Boolean
      KeCSCR_b_DeltaCellTemp_En: category=BOOLEAN, type=Boolean
      KeCSCR_b_DeltaCellVoltage_En: category=BOOLEAN, type=Boolean
      KeCSCR_b_FaultValFilterEn: category=BOOLEAN, type=Boolean
      KeCSCR_b_HVCurrentFaulted_En: category=BOOLEAN, type=Boolean
      KeCSCR_b_HVCurrentFaulted_Val: category=BOOLEAN, type=Boolean
      KeCSCR_b_Heat2PackVoltFltd_En: category=BOOLEAN, type=Boolean
      KeCSCR_b_Heat2PackVoltFltd_Val: category=BOOLEAN, type=Boolean
      KeCSCR_b_LinkNeg2PackVoltFltd_En: category=BOOLEAN, type=Boolean
      KeCSCR_b_LinkNeg2PackVoltFltd_Val: category=BOOLEAN, type=Boolean
      KeCSCR_b_LinkPos2PackVoltageFltd_En: category=BOOLEAN, type=Boolean
      KeCSCR_b_LinkPos2PackVoltageFltd_Val: category=BOOLEAN, type=Boolean
      KeCSCR_b_MaxCellTempIndexOvrd: category=BOOLEAN, type=Boolean
      KeCSCR_b_MaxPCBTempIndex_En: category=BOOLEAN, type=Boolean
      KeCSCR_b_MaxPCBTemp_En: category=BOOLEAN, type=Boolean
      KeCSCR_b_MaxPackTempOvrd: category=BOOLEAN, type=Boolean
      KeCSCR_b_MaxSenorTempIndexOvrd: category=BOOLEAN, type=Boolean
      KeCSCR_b_MaxSenorTempOvrd: category=BOOLEAN, type=Boolean
      KeCSCR_b_MaxTempIndexPackOvrd: category=BOOLEAN, type=Boolean
      KeCSCR_b_MaxVoltIndexPackOvrd: category=BOOLEAN, type=Boolean
      KeCSCR_b_MinCellTempIndexOvrd: category=BOOLEAN, type=Boolean
      KeCSCR_b_MinPCBTempIndex_En: category=BOOLEAN, type=Boolean
      KeCSCR_b_MinPCBTemp_En: category=BOOLEAN, type=Boolean
      KeCSCR_b_MinPackTempOvrd: category=BOOLEAN, type=Boolean
      KeCSCR_b_MinSenorTempIndexOvrd: category=BOOLEAN, type=Boolean
      KeCSCR_b_MinSenorTempOvrd: category=BOOLEAN, type=Boolean
      KeCSCR_b_MinTempIndexPackOvrd: category=BOOLEAN, type=Boolean
      KeCSCR_b_MinVoltIndexPackOvrd: category=BOOLEAN, type=Boolean
      KeCSCR_b_ModuleTemperatureOvrd: category=BOOLEAN, type=Boolean
      KeCSCR_b_OvrdAvgCellTemp: category=BOOLEAN, type=Boolean
      KeCSCR_b_OvrdAvgCellVolt: category=BOOLEAN, type=Boolean
      KeCSCR_b_OvrdCellVoltArrayFaulted: category=BOOLEAN, type=Boolean
      KeCSCR_b_OvrdCurrentArray: category=BOOLEAN, type=Boolean
      KeCSCR_b_OvrdCurrentArrayFltArray: category=BOOLEAN, type=Boolean
      KeCSCR_b_OvrdCurrentArrayFltArrayVals: category=ARRAY, type=rt_Array_Boolean_2
      KeCSCR_b_OvrdLinkVolt: category=BOOLEAN, type=Boolean
      KeCSCR_b_OvrdMaxCellTemp: category=BOOLEAN, type=Boolean
      KeCSCR_b_OvrdMaxCellVolt: category=BOOLEAN, type=Boolean
      KeCSCR_b_OvrdMaxCellVoltIndex: category=BOOLEAN, type=Boolean
      KeCSCR_b_OvrdMinCellTemp: category=BOOLEAN, type=Boolean
      KeCSCR_b_OvrdMinCellVolt: category=BOOLEAN, type=Boolean
      KeCSCR_b_OvrdMinCellVoltIndex: category=BOOLEAN, type=Boolean
      KeCSCR_b_OvrdPackVolt: category=BOOLEAN, type=Boolean
      KeCSCR_b_OvrdStackVolt: category=BOOLEAN, type=Boolean
      KeCSCR_b_OvrdSumPackVolt: category=BOOLEAN, type=Boolean
      KeCSCR_b_OvrdTempArray: category=BOOLEAN, type=Boolean
      KeCSCR_b_OvrdTempFltArray: category=BOOLEAN, type=Boolean
      KeCSCR_b_OvrdVoltArray: category=BOOLEAN, type=Boolean
      KeCSCR_b_OvrdVoltStandardDev: category=BOOLEAN, type=Boolean
      KeCSCR_b_PCBTempLPFEnable: category=BOOLEAN, type=Boolean
      KeCSCR_b_PCBTemp_Inv_En: category=BOOLEAN, type=Boolean
      KeCSCR_b_PCBTemp_Inv_Val: category=BOOLEAN, type=Boolean
      KeCSCR_b_PackVoltageFltd_En: category=BOOLEAN, type=Boolean
      KeCSCR_b_PackVoltageFltd_Val: category=BOOLEAN, type=Boolean
      KeCSCR_b_SafetyConnectStatus_En: category=BOOLEAN, type=Boolean
      KeCSCR_b_SafetyConnectStatus_Val: category=BOOLEAN, type=Boolean
      KeCSCR_b_ShuntCurrentFaulted_En: category=BOOLEAN, type=Boolean
      KeCSCR_b_ShuntCurrentFaulted_Val: category=BOOLEAN, type=Boolean
      KeCSCR_b_StackCircuit_flt_En: category=BOOLEAN, type=Boolean
      KeCSCR_b_SysParamMismatchOvrd: category=BOOLEAN, type=Boolean
      KeCSCR_b_SysParamMismatchOvrdVal: category=BOOLEAN, type=Boolean
      KeCSCR_b_TempArray_flt_CAN_En: category=BOOLEAN, type=Boolean
      KeCSCR_b_TempArray_flt_En: category=BOOLEAN, type=Boolean
      KeCSCR_b_WaterTempLPFEnable: category=BOOLEAN, type=Boolean
      KeCSCR_k_CurSensorType_En: category=BOOLEAN, type=Boolean
      KeLLSR_b_CellCircuitFaulted_En: category=BOOLEAN, type=Boolean
      KeLLSR_b_StackCircuitFaulted_En: category=BOOLEAN, type=Boolean
      KeLLSR_b_TempCircuitFaulted_En: category=BOOLEAN, type=Boolean
      KeLLSR_b_WaterTempCircuitFaulted_En: category=BOOLEAN, type=Boolean
      KeCSCR_Cnt_NumPcbTempSens: category=VALUE, type=UInt8
      KeCSCR_Cnt_NumberofStacks: category=VALUE, type=UInt8
      KeCSCR_Cnt_ThermistorCountSingle: category=VALUE, type=UInt8
      KeCSCR_T_MaxSenorTempIndexOvrdVal: category=VALUE, type=UInt8
      KeCSCR_T_MinSenorTempIndexOvrdVal: category=VALUE, type=UInt8
      KeCSCR_k_CBCircuit_flt_Val: category=VALUE, type=UInt8
      KeCSCR_k_CellCircuit_flt_Val: category=VALUE, type=UInt8
      KeCSCR_k_CurSensorType_Val: category=VALUE, type=UInt8
      KeCSCR_k_StackCircuit_flt_Val: category=VALUE, type=UInt8
      KeCSCR_k_TempArray_flt_CAN_Val: category=VALUE, type=UInt8
      KeCSCR_k_TempArray_flt_Val: category=VALUE, type=UInt8
      KeCSCR_n_CellVoltSensorIndexOvrdVal: category=VALUE, type=UInt8
      KeCSCR_n_MaxCellTempIndexOvrdVal: category=VALUE, type=UInt8
      KeCSCR_n_MaxCellVoltIndexOvrdVal: category=VALUE, type=UInt8
      KeCSCR_n_MaxPCBTempIndex_Val: category=VALUE, type=UInt8
      KeCSCR_n_MaxTempIndexPackOvrdVal: category=VALUE, type=UInt8
      KeCSCR_n_MaxVoltIndexPackOvrdVal: category=VALUE, type=UInt8
      KeCSCR_n_MinCellTempIndexOvrdVal: category=VALUE, type=UInt8
      KeCSCR_n_MinCellVoltIndexOvrdVal: category=VALUE, type=UInt8
      KeCSCR_n_MinPCBTempIndex_Val: category=VALUE, type=UInt8
      KeCSCR_n_MinTempIndexPackOvrdVal: category=VALUE, type=UInt8
      KeCSCR_n_MinVoltIndexPackOvrdVal: category=VALUE, type=UInt8
