AUTOSAR XML (schema 4-0-3)
package /ISLR_Code_pkg/ISLR_Code_imp
  swc implementation ISLR_Code: programming-language=C, sw-version=1.295.1, used-code-generator=Embedded Coder 7.2 (R2019a) 23-Nov-2018, vendor-id=0, behavior=ISLR_Code
    code-descriptors:
      code Code
        artifact-descriptors:
          short-label=ISLR_Code_c, category=SWSRC
          short-label=ASW_Types_h, category=SWHDR
          short-label=ISLR_Code_h, category=SWHDR
          short-label=ISLR_Code_private_h, category=SWHDR
          short-label=ISLR_Code_types_h, category=SWHDR
          short-label=rtwtypes_h, category=SWHDR
    resource consumption RsrcCons_ISLR_Code
