AUTOSAR XML (schema 4-0-3)
standard types defined: Float, UInt8, Boolean, UInt16, float32, uint8, boolean, uint16
package /ADPR_Code_pkg/ADPR_Code_dt
  unit NoUnit: factor-si-to-unit=1, offset-si-to-unit=0
  impl type TeHVSR_e_StateMode: category=VALUE, base-type=uint8
  impl type TeCHMR_e_ChargingStateMachine: category=VALUE, base-type=uint8
  impl type TeCHMR_e_ChrgElecLock: category=VALUE, base-type=uint8
  impl type TeFCMR_e_ChrgOffBoardSt: category=VALUE, base-type=uint8
  impl type TeCHMR_e_OBC_ChrgEnable: category=VALUE, base-type=uint8
  impl type rt_Array_Float_300: category=ARRAY
    element rt_Array_Float_300: array-size=300, array-size-semantics=FIXED-SIZE, implementation-data-type=Float
  impl type rt_Array_Float_20: category=ARRAY
    element rt_Array_Float_20: array-size=20, array-size-semantics=FIXED-SIZE, implementation-data-type=Float
  impl type rt_Array_Float_15: category=ARRAY
    element rt_Array_Float_15: array-size=15, array-size-semantics=FIXED-SIZE, implementation-data-type=Float
package /ADPR_Code_pkg/ADPR_Code_dt/ApplDataTypes
  12 x app type, all with sw-calibration-access=READ-WRITE:
    Float: category=VALUE, compu {identical}, range phys -INF..INF
    UInt8: category=VALUE, compu {identical}, range phys 0..255
    Boolean: category=BOOLEAN, compu {0=FALSE, 1=TRUE}
    TeHVSR_e_StateMode: category=VALUE, compu {0=CeHVSR_e_StateModeReserved, 1=CeHVSR_e_StateModeInitial, 2=CeHVSR_e_StateModeStandBy, 3=CeHVSR_e_StateModePrecharge, 4=CeHVSR_e_StateModeNormalDischarge, 5=CeHVSR_e_StateModeWarningPowerReduction, 6=CeHVSR_e_StateModePowerReduction, 7=CeHVSR_e_StateModePreChargeFailed, 8=CeHVSR_e_StateModePowerHoldMode, 9=CeHVSR_e_StateModeShutdown, 10=CeHVSR_e_StateModeServiceMode, 11=CeHVSR_e_StateModeReady, 12=CeHVSR_e_StateModeAC_ChargeMode, 13=CeHVSR_e_StateModeEndOfCharge, 14=CeHVSR_e_StateModeDC_ChargeMode, 15=CeHVSR_e_StateModeSystemErr, 16=CeHVSR_e_StateModeTempChargState, 17=CeHVSR_e_StateModeHeatPreChgState, 18=CeHVSR_e_StateModeHeatingState, 19=CeHVSR_e_StateModeHeatFinishState}
    TeCHMR_e_ChargingStateMachine: category=VALUE, compu {0=CeCHMR_e_ChargingSM_Off, 1=CeCHMR_e_ChargingSM_Init, 2=CeCHMR_e_ChargingSM_Normal, 3=CeCHMR_e_ChargingSM_Derating, 4=CeCHMR_e_ChargingSM_Heating, 5=CeCHMR_e_ChargingSM_Cooling, 6=CeCHMR_e_ChargingSM_Interrupt, 7=CeCHMR_e_ChargingSM_Shutdown, 8=CeCHMR_e_ChargingSM_Mode_Select, 9=CeCHMR_e_ChargingSM_Discharge, 10=CeCHMR_e_ChargingSM_ChargeWait, 11=CeCHMR_e_ChargingSM_VTOLDischarge, 12=CeCHMR_e_ChargingSM_VTOVDischarge}
    UInt16: category=VALUE, compu {identical}, range phys 0..65535
    TeCHMR_e_ChrgElecLock: category=VALUE, compu {0=CeCHMR_e_ChrgElecLockUnlock, 1=CeCHMR_e_ChrgElecLockLock, 2=CeISLR_e_ChrgElecLockLockError, 3=CeISLR_e_ChrgElecLockUnlockError, 4=CeISLR_e_ChrgElecLockDefault}
    TeFCMR_e_ChrgOffBoardSt: category=VALUE, compu {0=CeFCMR_e_ChrgOffBoard_Init, 1=CeFCMR_e_ChrgOffBoard_HandShake, 2=CeFCMR_e_ChrgOffBoard_CheckCRM, 3=CeFCMR_e_ChrgOffBoard_CheckCRMAA, 4=CeFCMR_e_ChrgOffBoard_CheckCML, 5=CeFCMR_e_ChrgOffBoard_CheckChargerPara, 6=CeFCMR_e_ChrgOffBoard_CheckChargerReady, 7=CeFCMR_e_ChrgOffBoard_CheckCCS, 8=CeFCMR_e_ChrgOffBoard_Charging, 9=CeFCMR_e_ChrgOffBoard_ChargeStop, 10=CeFCMR_e_ChrgOffBoard_Check2OpenContactors, 11=CeFCMR_e_ChrgOffBoard_OpenContactors, 12=CeFCMR_e_ChrgOffBoard_EndOfCharge, 13=CeFCMR_e_ChrgOffBoard_PreHeatChk, 14=CeFCMR_e_ChrgOffBoard_Fault, 15=CeFCMR_e_ChrgOffBoard_ChargeKeepWarmJudge, 16=CeFCMR_e_ChrgOffBoard_ChargeKeepWarming, 18=CeFCMR_e_ChrgOffBoard_ChargeKeepWarmingEnd}
    TeCHMR_e_OBC_ChrgEnable: category=VALUE, compu {0=CeCHMR_e_OBC_ChrgEnblDefault, 1=CeCHMR_e_OBC_ChrgEnableReserved1, 2=CeCHMR_e_OBC_ChrgEnableReserved2, 3=CeCHMR_e_OBC_ChrgEnableReserved3, 4=CeCHMR_e_OBC_ChrgEnblAlwCharge, 5=CeCHMR_e_OBC_ChrgEnblAlwDischarge, 6=CeCHMR_e_OBC_ChrgEnblChrgBattHeating, 7=CeCHMR_e_OBC_ChrgEnblBatteryCooling, 8=CeCHMR_e_OBC_ChrgEnableReserved4, 9=CeCHMR_e_OBC_ChrgEnableReserved5, 10=CeCHMR_e_OBC_ChrgEnblDischNotAllow, 11=CeCHMR_e_OBC_ChrgEnblEndOfChrg, 12=CeCHMR_e_OBC_ChrgEnblReserved, 13=CeCHMR_e_OBC_ChrgEnblAlwVTOLDischarge, 14=CeCHMR_e_OBC_ChrgEnblAlwVTOVDischarge}
    Appl_CzADPR_kP_SOC_TempAChrgPwrLmt_data: category=MAP, sw-calprm-axis-set=[{sw-axis-index=1, category=COM_AXIS, sw-axis-grouped=Appl_CtADPR_kP_SOC_TempAChrgPwrLmt}, {sw-axis-index=2, category=COM_AXIS, sw-axis-grouped=Appl_CxADPR_kP_SOC_TempAChrgPwrLmt}], compu {identical}, range phys -INF..INF, sw-record-layout=Map_f32
    Appl_CxADPR_kP_SOC_TempAChrgPwrLmt: category=COM_AXIS, sw-calprm-axis-set={sw-axis-index=2, sw-axis-individual={compu {identical}, sw-max-axis-points=15, sw-min-axis-points=15, range phys -1000000..1000000}}, sw-record-layout=Distr_f32_M
    Appl_CtADPR_kP_SOC_TempAChrgPwrLmt: category=COM_AXIS, sw-calprm-axis-set={sw-axis-index=1, sw-axis-individual={compu {identical}, sw-max-axis-points=20, sw-min-axis-points=20, range phys -1000000..1000000}}, sw-record-layout=Distr_f32_M
package /ADPR_Code_pkg/ADPR_Code_dt/ApplDataTypes/RecordLayouts
  sw record layout Map_f32: sw-record-layout-group={short-label=Map_f32, sw-record-layout-group={short-label=Val, category=COLUMN_DIR, sw-record-layout-group-axis=1, sw-record-layout-group-index=X, sw-record-layout-group-from=1, sw-record-layout-group-to=-1, sw-record-layout-group={short-label=Val, sw-record-layout-group-axis=2, sw-record-layout-group-index=Y, sw-record-layout-group-from=1, sw-record-layout-group-to=-1, sw-record-layout-v={short-label=Val, base-type=float32, sw-record-layout-v-axis=0, sw-record-layout-v-prop=VALUE, sw-record-layout-v-index=X Y}}}}
  sw record layout Distr_f32_M: sw-record-layout-group={short-label=Y, category=INDEX_INCR, sw-record-layout-group-axis=1, sw-record-layout-group-from=1, sw-record-layout-group-to=-1, sw-record-layout-v={short-label=VALUE, base-type=float32, sw-record-layout-v-axis=1, sw-record-layout-v-prop=VALUE}}
package /ADPR_Code_pkg/ADPR_Code_dt/DataTypeMappings
  data type mapping set ADPR_CodeDataTypeMappingsSet
    data-type-maps:
      application-data-type=Float, implementation-data-type=Float
      application-data-type=UInt8, implementation-data-type=UInt8
      application-data-type=Boolean, implementation-data-type=Boolean
      application-data-type=TeHVSR_e_StateMode, implementation-data-type=TeHVSR_e_StateMode
      application-data-type=TeCHMR_e_ChargingStateMachine, implementation-data-type=TeCHMR_e_ChargingStateMachine
      application-data-type=UInt16, implementation-data-type=UInt16
      application-data-type=TeCHMR_e_ChrgElecLock, implementation-data-type=TeCHMR_e_ChrgElecLock
      application-data-type=TeFCMR_e_ChrgOffBoardSt, implementation-data-type=TeFCMR_e_ChrgOffBoardSt
      application-data-type=TeCHMR_e_OBC_ChrgEnable, implementation-data-type=TeCHMR_e_OBC_ChrgEnable
      application-data-type=Appl_CzADPR_kP_SOC_TempAChrgPwrLmt_data, implementation-data-type=rt_Array_Float_300
      application-data-type=Appl_CtADPR_kP_SOC_TempAChrgPwrLmt, implementation-data-type=rt_Array_Float_20
      application-data-type=Appl_CxADPR_kP_SOC_TempAChrgPwrLmt, implementation-data-type=rt_Array_Float_15
package /ADPR_Code_pkg/ADPR_Code_dt/Ground
  constant specification CtADPR_kP_SOC_TempAChrgPwrLmt: value-spec=[0 5 10 15 20 25 30 35 40 45 50 55 60 65 70 75 80 85 90 95]
  constant specification CxADPR_kP_SOC_TempAChrgPwrLmt: value-spec=[-11 -10 -5 0 5 10 15 20 25 30 35 40 45 50 51]
  constant specification CzADPR_kP_SOC_TempAChrgPwrLmt_data: value-spec=[0 2 3 5 6 6 6 6 6 6 6 6 6 6 0 0 2 3 5 6 6 6 6 6 6 6 6 6 6 0 0 2 3 5 6 6 6 6 6 6 6 6 6 6 0 0 2 3 5 6 6 6 6 6 6 6 6 6 6 0 0 2 3 5 6 6 6 6 6 6 6 6 6 6 0 0 2 3 5 6 6 6 6 6 6 6 6 6 6 0 0 1.5 2 4 6 6 6 6 6 6 6 6 6 6 0 0 1.5 2 4 6 6 6 6 6 6 6 6 6 6 0 0 1.5 2 4 6 6 6 6 6 6 6 6 6 6 0 0 1.5 2 4 6 6 6 6 6 6 6 6 6 6 0 0 1.5 2 4 6 6 6 6 6 6 6 6 6 6 0 0 1.5 2 4 6 6 6 6 6 6 6 6 6 6 0 0 1.2000000476837158 2 4 6 6 6 6 6 6 6 6 6 6 0 0 1.2000000476837158 2 4 6 6 6 6 6 6 6 6 6 6 0 0 1.2000000476837158 2 4 5 6 6 6 6 6 6 6 6 6 0 0 1 2 4 5 6 6 6 6 6 6 6 6 6 0 0 1 2 3 4 5 6 6 6 6 6 6 6 6 0 0 1 2 3 4 5 6 6 6 6 6 6 6 6 0 0 1 1.5 2 2 2 2 2 2 2 2 2 2 2 0 0 0 0 0 0 0 0 0 0 0 0 0 0 0 0]
package /ADPR_Code_pkg/ADPR_Code_dt/SwAddrMethods
  sw addr method CODE: section-type=CODE
  sw addr method CONST: section-type=CONST
  sw addr method VAR: section-type=VAR
