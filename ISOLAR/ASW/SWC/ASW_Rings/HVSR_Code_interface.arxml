AUTOSAR XML (schema 4-0-3)
package /CalibrationComponents
  parameter interface HVSR_if
    34 x parameter data prototype, all with sw-calibration-access=READ-WRITE:
      KeHVSR_i_statusCurrTR: category=VALUE, type=Float
      KeHVSR_t_BattPowerOffLossVCU: category=VALUE, type=Float
      KeHVSR_t_CurrTimeOpenNeg: category=VALUE, type=Float
      KeHVSR_t_FunctionCallRate: category=VALUE, type=Float
      KeHVSR_t_RTCTime2Sleep: category=VALUE, type=Float
      KeHVSR_t_ShowDownRdyEn: category=VALUE, type=Float
      KeHVSR_e_Ini_State_Val: category=VALUE, type=TeHVSR_e_BMS_InitialiseStatus
      KeHVSR_e_BMS_StayAwakeReasonOutOvrd: category=VALUE, type=TeHVSR_e_BMS_StayUpReason
      KeHVSR_e_BMS_Wakeup_reasonOutOvrd: category=VALUE, type=TeHVSR_e_BMS_WakeUpReason
      KeHVSR_e_BatteryState_Val: category=VALUE, type=TeHVSR_e_BatteryState
      KeHVSR_e_StateMode_Val: category=VALUE, type=TeHVSR_e_StateMode
      KeHVSR_b_BMSSts_En: category=BOOLEAN, type=Boolean
      KeHVSR_b_BatteryState_En: category=BOOLEAN, type=Boolean
      KeHVSR_b_BatteryWarm_En: category=BOOLEAN, type=Boolean
      KeHVSR_b_BatteryWarm_Val: category=BOOLEAN, type=Boolean
      KeHVSR_b_EnableContactors_En: category=BOOLEAN, type=Boolean
      KeHVSR_b_EnableHeatCircuitContactors_En: category=BOOLEAN, type=Boolean
      KeHVSR_b_FastIsolationActive_En: category=BOOLEAN, type=Boolean
      KeHVSR_b_FastIsolationActive_Val: category=BOOLEAN, type=Boolean
      KeHVSR_b_Ini_State_En: category=BOOLEAN, type=Boolean
      KeHVSR_b_IsolationActive_En: category=BOOLEAN, type=Boolean
      KeHVSR_b_IsolationActive_Val: category=BOOLEAN, type=Boolean
      KeHVSR_b_NotAllowReqHeat_En: category=BOOLEAN, type=Boolean
      KeHVSR_b_NotAllowReqHeat_Val: category=BOOLEAN, type=Boolean
      KeHVSR_b_SelfCheckCounter_En: category=BOOLEAN, type=Boolean
      KeHVSR_b_ShutdownReady_drv_En: category=BOOLEAN, type=Boolean
      KeHVSR_b_ShutdownReady_drv_Val: category=BOOLEAN, type=Boolean
      KeHVSR_b_StateMode_En: category=BOOLEAN, type=Boolean
      KeHVSR_b_WorkingMode_En: category=BOOLEAN, type=Boolean
      KeHVSR_k_BMSSts_Val: category=VALUE, type=UInt8
      KeHVSR_k_EnableContactors_Val: category=VALUE, type=UInt8
      KeHVSR_k_EnableHeatCircuitContactors_Val: category=VALUE, type=UInt8
      KeHVSR_k_SelfCheckCounter_Val: category=VALUE, type=UInt8
      KeHVSR_k_WorkingMode_Val: category=VALUE, type=UInt8
package /HVSR_Code_pkg/HVSR_Code_if
  46 x sender receiver interface:
    VeHVSR_e_BMS_StayAwakeReason_drv
      data VeHVSR_e_BMS_StayAwakeReason_drv: category=VALUE, sw-calibration-access=READ-ONLY, type=TeHVSR_e_BMS_StayUpReason
    VeHVSR_b_IsolationActive
      data VeHVSR_b_IsolationActive: category=BOOLEAN, sw-calibration-access=READ-ONLY, type=Boolean
    VeHVSR_e_BMS_Wakeup_reason_drv
      data VeHVSR_e_BMS_Wakeup_reason_drv: category=VALUE, sw-calibration-access=READ-ONLY, type=TeHVSR_e_BMS_WakeUpReason
    VeHVSR_k_EnableContactors
      data VeHVSR_k_EnableContactors: category=VALUE, sw-calibration-access=READ-ONLY, type=UInt8
    VeHVSR_e_StateMode
      data VeHVSR_e_StateMode: category=VALUE, sw-calibration-access=READ-ONLY, type=TeHVSR_e_StateMode
    VeHVSR_b_ShutdownReady_drv
      data VeHVSR_b_ShutdownReady_drv: category=BOOLEAN, sw-calibration-access=READ-ONLY, type=Boolean
    VeHVSR_b_FastIsolationActive
      data VeHVSR_b_FastIsolationActive: category=BOOLEAN, sw-calibration-access=READ-ONLY, type=Boolean
    VeHVSR_e_Ini_State
      data VeHVSR_e_Ini_State: category=VALUE, sw-calibration-access=READ-ONLY, type=TeHVSR_e_BMS_InitialiseStatus
    VeHVSR_k_SelfCheckCounter
      data VeHVSR_k_SelfCheckCounter: category=VALUE, sw-calibration-access=READ-ONLY, type=UInt8
    VeHVSR_e_BatteryState
      data VeHVSR_e_BatteryState: category=VALUE, sw-calibration-access=READ-ONLY, type=TeHVSR_e_BatteryState
    VeHVSR_b_BatteryWarm
      data VeHVSR_b_BatteryWarm: category=BOOLEAN, sw-calibration-access=READ-ONLY, type=Boolean
    VeHVSR_k_BMSSts
      data VeHVSR_k_BMSSts: category=VALUE, sw-calibration-access=READ-ONLY, type=UInt8
    VeHVSR_k_EnableHeatCircuitContactors
      data VeHVSR_k_EnableHeatCircuitContactors: category=VALUE, sw-calibration-access=READ-ONLY, type=UInt8
    VeHVSR_k_WorkingMode
      data VeHVSR_k_WorkingMode: category=VALUE, sw-calibration-access=READ-ONLY, type=UInt8
    VeHVSR_b_NotAllowReqHeat
      data VeHVSR_b_NotAllowReqHeat: category=BOOLEAN, sw-calibration-access=READ-ONLY, type=Boolean
    VeLLSR_b_CloseContactors
      data VeLLSR_b_CloseContactors: category=BOOLEAN, type=Boolean
    VeLLSR_b_ActivateBSWOvrd
      data VeLLSR_b_ActivateBSWOvrd: category=BOOLEAN, type=Boolean
    VeCLBR_b_BalReadyToSleep
      data VeCLBR_b_BalReadyToSleep: category=BOOLEAN, type=Boolean
    VeCANR_k_VCUHvPowerCtrl
      data VeCANR_k_VCUHvPowerCtrl: category=VALUE, type=UInt8
    VeCFLR_k_DiagCounter
      data VeCFLR_k_DiagCounter: category=VALUE, type=UInt8
    VeCFLR_b_ContactorsClosed
      data VeCFLR_b_ContactorsClosed: category=BOOLEAN, type=Boolean
    VeCFLR_b_HeatClosed
      data VeCFLR_b_HeatClosed: category=BOOLEAN, type=Boolean
    VeVSDR_I_HVCurrent
      data VeVSDR_I_HVCurrent: category=VALUE, type=Float
    VeDHSR_b_BattPowerOff
      data VeDHSR_b_BattPowerOff: category=BOOLEAN, type=Boolean
    VeLLSR_b_VCU_Wake
      data VeLLSR_b_VCU_Wake: category=BOOLEAN, type=Boolean
    VeLLSR_n_FirstWakeUpReason
      data VeLLSR_n_FirstWakeUpReason: category=VALUE, type=UInt8
    VeLLSR_k_VCUComLoss_flt
      data VeLLSR_k_VCUComLoss_flt: category=VALUE, type=UInt8
    VeCANR_k_ACChConnStatus
      data VeCANR_k_ACChConnStatus: category=VALUE, type=UInt8
    VeLLSR_b_CC2
      data VeLLSR_b_CC2: category=BOOLEAN, type=Boolean
    VeCANR_b_VCUBMSEmgyToShutDown
      data VeCANR_b_VCUBMSEmgyToShutDown: category=BOOLEAN, type=Boolean
    VeCANR_b_HCUSleepAllow
      data VeCANR_b_HCUSleepAllow: category=BOOLEAN, type=Boolean
    VeCANR_e_ChrgStatus
      data VeCANR_e_ChrgStatus: category=VALUE, type=TeCHMR_e_ChrgMode
    VeFCMR_b_DCPreHeatReq
      data VeFCMR_b_DCPreHeatReq: category=BOOLEAN, type=Boolean
    VeLLSR_b_ClearDTC
      data VeLLSR_b_ClearDTC: category=BOOLEAN, type=Boolean
    VeCFLR_b_HVFaultReady
      data VeCFLR_b_HVFaultReady: category=BOOLEAN, type=Boolean
    VeADPR_e_ChargerEnable
      data VeADPR_e_ChargerEnable: category=VALUE, type=Float
    VeCANR_k_VCUAllowToCharge
      data VeCANR_k_VCUAllowToCharge: category=VALUE, type=UInt8
    VeCHMR_e_ChargingSM
      data VeCHMR_e_ChargingSM: category=VALUE, type=TeCHMR_e_ChargingStateMachine
    VeDHSR_b_ReqPowerOff
      data VeDHSR_b_ReqPowerOff: category=BOOLEAN, type=Boolean
    VeCANR_b_HCUHeatAllow
      data VeCANR_b_HCUHeatAllow: category=BOOLEAN, type=Boolean
    VeCANR_b_TBOXChargeAllow
      data VeCANR_b_TBOXChargeAllow: category=BOOLEAN, type=Boolean
    VeCANR_b_TBOXACActive
      data VeCANR_b_TBOXACActive: category=BOOLEAN, type=Boolean
    VeCHMR_b_HCUHeatReq
      data VeCHMR_b_HCUHeatReq: category=BOOLEAN, type=Boolean
    VeDHSR_b_BattPerfomTest_Fault
      data VeDHSR_b_BattPerfomTest_Fault: category=BOOLEAN, type=Boolean
    VeCANR_I_OBCChrgOutCurr
      data VeCANR_I_OBCChrgOutCurr: category=VALUE, type=Float
    VeSOCR_Pct_DisplayPackSOC
      data VeSOCR_Pct_DisplayPackSOC: category=VALUE, type=Float
