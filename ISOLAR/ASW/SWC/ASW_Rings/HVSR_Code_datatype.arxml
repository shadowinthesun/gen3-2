AUTOSAR XML (schema 4-0-3)
standard types defined: Boolean, UInt8, Float, boolean, uint8, float32
package /HVSR_Code_pkg/HVSR_Code_dt
  unit NoUnit: factor-si-to-unit=1, offset-si-to-unit=0
  impl type TeCHMR_e_ChrgMode: category=VALUE, base-type=uint8
  impl type TeCHMR_e_ChargingStateMachine: category=VALUE, base-type=uint8
  impl type TeHVSR_e_BMS_StayUpReason: category=VALUE, base-type=uint8
  impl type TeHVSR_e_BMS_WakeUpReason: category=VALUE, base-type=uint8
  impl type TeHVSR_e_StateMode: category=VALUE, base-type=uint8
  impl type TeHVSR_e_BMS_InitialiseStatus: category=VALUE, base-type=uint8
  impl type TeHVSR_e_BatteryState: category=VALUE, base-type=uint8
  impl type TeHVSR_e_VCU_ChargeRequest: category=VALUE, base-type=uint8
  impl type TeHVSR_e_DischargeControl: category=VALUE, base-type=uint8
package /HVSR_Code_pkg/HVSR_Code_dt/ApplDataTypes
  12 x app type, all with sw-calibration-access=READ-WRITE:
    Boolean: category=BOOLEAN, compu {0=FALSE, 1=TRUE}
    UInt8: category=VALUE, compu {identical}, range phys 0..255
    Float: category=VALUE, compu {identical}, range phys -INF..INF
    TeCHMR_e_ChrgMode: category=VALUE, compu {0=CeCHMR_e_ChrgModeReserved1, 1=CeCHMR_e_ChrgModeInit, 2=CeCHMR_e_ChrgModeStandby, 3=CeCHMR_e_ChrgModeReqDischrg, 4=CeCHMR_e_ChrgModeCharging, 5=CeCHMR_e_ChrgModeDischarging, 6=CeCHMR_e_ChrgModeHndlCheck, 7=CeCHMR_e_ChrgModeDelChrgCheck, 8=CeCHMR_e_ChrgModeFault, 9=CeCHMR_e_ChrgModeDerating, 10=CeCHMR_e_ChrgModeReserved2, 11=CeCHMR_e_ChrgModeShutdown, 12=CeCHMR_e_ChrgModeOff}
    TeCHMR_e_ChargingStateMachine: category=VALUE, compu {0=CeCHMR_e_ChargingSM_Off, 1=CeCHMR_e_ChargingSM_Init, 2=CeCHMR_e_ChargingSM_Normal, 3=CeCHMR_e_ChargingSM_Derating, 4=CeCHMR_e_ChargingSM_Heating, 5=CeCHMR_e_ChargingSM_Cooling, 6=CeCHMR_e_ChargingSM_Interrupt, 7=CeCHMR_e_ChargingSM_Shutdown, 8=CeCHMR_e_ChargingSM_Mode_Select, 9=CeCHMR_e_ChargingSM_Discharge, 10=CeCHMR_e_ChargingSM_ChargeWait, 11=CeCHMR_e_ChargingSM_VTOLDischarge, 12=CeCHMR_e_ChargingSM_VTOVDischarge}
    TeHVSR_e_BMS_StayUpReason: category=VALUE, compu {0=CeHVSR_e_BMS_StayUpReasonReserved, 1=CeHVSR_e_BMS_StayUpReasonNoIgn, 2=CeHVSR_e_BMS_StayUpReasonOBC_Charge, 3=CeHVSR_e_BMS_StayUpReasonLocalReservationChrg, 4=CeHVSR_e_BMS_StayUpReasonRemoteReservationChrg}
    TeHVSR_e_BMS_WakeUpReason: category=VALUE, compu {0=CeHVSR_e_BMS_WakeUpReasonDflt, 1=CeHVSR_e_BMS_WakeUpReasonIGNChange, 2=CeHVSR_e_BMS_WakeUpCAN_WakeUp, 3=CeHVSR_e_BMS_WakeUp_ReservationCharge, 4=CeHVSR_e_BMS_IntelligentCharging, 5=CeHVSR_e_BMS_WakeUp_DCCharge}
    TeHVSR_e_StateMode: category=VALUE, compu {0=CeHVSR_e_StateModeReserved, 1=CeHVSR_e_StateModeInitial, 2=CeHVSR_e_StateModeStandBy, 3=CeHVSR_e_StateModePrecharge, 4=CeHVSR_e_StateModeNormalDischarge, 5=CeHVSR_e_StateModeWarningPowerReduction, 6=CeHVSR_e_StateModePowerReduction, 7=CeHVSR_e_StateModePreChargeFailed, 8=CeHVSR_e_StateModePowerHoldMode, 9=CeHVSR_e_StateModeShutdown, 10=CeHVSR_e_StateModeServiceMode, 11=CeHVSR_e_StateModeReady, 12=CeHVSR_e_StateModeAC_ChargeMode, 13=CeHVSR_e_StateModeEndOfCharge, 14=CeHVSR_e_StateModeDC_ChargeMode, 15=CeHVSR_e_StateModeSystemErr, 16=CeHVSR_e_StateModeTempChargState, 17=CeHVSR_e_StateModeHeatPreChgState, 18=CeHVSR_e_StateModeHeatingState, 19=CeHVSR_e_StateModeHeatFinishState}
    TeHVSR_e_BMS_InitialiseStatus: category=VALUE, compu {0=CeHVSR_e_BMS_Initialsing, 1=CeHVSR_e_BMS_InitialsingSucceed, 2=CeHVSR_e_BMS_InitialsingFail}
    TeHVSR_e_BatteryState: category=VALUE, compu {0=CeHVSR_e_Void, 1=CeHVSR_e_Charge, 2=CeHVSR_e_Discharge}
    TeHVSR_e_VCU_ChargeRequest: category=VALUE, compu {0=CeHVSR_e_VCU_ChargeRequestDflt, 1=CeHVSR_e_VCU_ACChargeRequest, 2=CeHVSR_e_VCU_DCChargeRequest, 3=CeHVSR_e_VCU_ChargeRequestOff, 4=CeHVSR_e_VCU_ChargeRequestReserved}
    TeHVSR_e_DischargeControl: category=VALUE, compu {0=CeHVSR_e_DR_NoRequest, 1=CeHVSR_e_DR_ClosedMainRelay, 2=CeHVSR_e_DR_Shutdown, 3=CeHVSR_e_DR_EmergencyOpen, 4=CeHVSR_e_DR_ServiceMode, 5=CeHVSR_e_VCU_ChargeRequestAllow, 6=CeHVSR_e_DR_DCDCOn, 7=CeHVSR_e_DR_Standby}
package /HVSR_Code_pkg/HVSR_Code_dt/DataTypeMappings
  data type mapping set HVSR_CodeDataTypeMappingsSet
    data-type-maps:
      application-data-type=Boolean, implementation-data-type=Boolean
      application-data-type=UInt8, implementation-data-type=UInt8
      application-data-type=Float, implementation-data-type=Float
      application-data-type=TeCHMR_e_ChrgMode, implementation-data-type=TeCHMR_e_ChrgMode
      application-data-type=TeCHMR_e_ChargingStateMachine, implementation-data-type=TeCHMR_e_ChargingStateMachine
      application-data-type=TeHVSR_e_BMS_StayUpReason, implementation-data-type=TeHVSR_e_BMS_StayUpReason
      application-data-type=TeHVSR_e_BMS_WakeUpReason, implementation-data-type=TeHVSR_e_BMS_WakeUpReason
      application-data-type=TeHVSR_e_StateMode, implementation-data-type=TeHVSR_e_StateMode
      application-data-type=TeHVSR_e_BMS_InitialiseStatus, implementation-data-type=TeHVSR_e_BMS_InitialiseStatus
      application-data-type=TeHVSR_e_BatteryState, implementation-data-type=TeHVSR_e_BatteryState
      application-data-type=TeHVSR_e_VCU_ChargeRequest, implementation-data-type=TeHVSR_e_VCU_ChargeRequest
      application-data-type=TeHVSR_e_DischargeControl, implementation-data-type=TeHVSR_e_DischargeControl
package /HVSR_Code_pkg/HVSR_Code_dt/SwAddrMethods
  sw addr method CODE: section-type=CODE
  sw addr method CONST: section-type=CONST
  sw addr method VAR: section-type=VAR
