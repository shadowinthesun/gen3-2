AUTOSAR XML (schema 4-0-3)
standard types defined: Float, Boolean, UInt8, UInt16, float32, boolean, uint8, uint16
package /CSCR_Code_pkg/CSCR_Code_dt
  unit NoUnit: factor-si-to-unit=1, offset-si-to-unit=0
  impl type rt_Array_Float_96: category=ARRAY
    element rt_Array_Float_96: array-size=96, array-size-semantics=FIXED-SIZE, implementation-data-type=Float
  9 x impl type, all with category=ARRAY:
    rt_Array_Boolean_96
      element rt_Array_Boolean_96: array-size=96, array-size-semantics=FIXED-SIZE, implementation-data-type=Boolean
    rt_Array_Float_8
      element rt_Array_Float_8: array-size=8, array-size-semantics=FIXED-SIZE, implementation-data-type=Float
    rt_Array_Boolean_8
      element rt_Array_Boolean_8: array-size=8, array-size-semantics=FIXED-SIZE, implementation-data-type=Boolean
    rt_Array_Float_2
      element rt_Array_Float_2: array-size=2, array-size-semantics=FIXED-SIZE, implementation-data-type=Float
    rt_Array_Boolean_2
      element rt_Array_Boolean_2: array-size=2, array-size-semantics=FIXED-SIZE, implementation-data-type=Boolean
    rt_Array_Float_16
      element rt_Array_Float_16: array-size=16, array-size-semantics=FIXED-SIZE, implementation-data-type=Float
    rt_Array_Boolean_16
      element rt_Array_Boolean_16: array-size=16, array-size-semantics=FIXED-SIZE, implementation-data-type=Boolean
    rt_Array_Float_11
      element rt_Array_Float_11: array-size=11, array-size-semantics=FIXED-SIZE, implementation-data-type=Float
    rt_Array_Boolean_11
      element rt_Array_Boolean_11: array-size=11, array-size-semantics=FIXED-SIZE, implementation-data-type=Boolean
package /CSCR_Code_pkg/CSCR_Code_dt/ApplDataTypes
  app type Float: category=VALUE, sw-calibration-access=READ-WRITE, compu {identical}, range phys -INF..INF
  application array data type rt_Array_Float_96: category=ARRAY, sw-calibration-access=READ-WRITE
    element rt_Array_Float_96: category=VALUE, type=Float, array-size-semantics=FIXED-SIZE, max-number-of-elements=96
  app type Boolean: category=BOOLEAN, sw-calibration-access=READ-WRITE, compu {0=FALSE, 1=TRUE}
  7 x application array data type, all with category=ARRAY, sw-calibration-access=READ-WRITE:
    rt_Array_Boolean_96
      element rt_Array_Boolean_96: category=BOOLEAN, type=Boolean, array-size-semantics=FIXED-SIZE, max-number-of-elements=96
    rt_Array_Float_8
      element rt_Array_Float_8: category=VALUE, type=Float, array-size-semantics=FIXED-SIZE, max-number-of-elements=8
    rt_Array_Boolean_8
      element rt_Array_Boolean_8: category=BOOLEAN, type=Boolean, array-size-semantics=FIXED-SIZE, max-number-of-elements=8
    rt_Array_Float_2
      element rt_Array_Float_2: category=VALUE, type=Float, array-size-semantics=FIXED-SIZE, max-number-of-elements=2
    rt_Array_Boolean_2
      element rt_Array_Boolean_2: category=BOOLEAN, type=Boolean, array-size-semantics=FIXED-SIZE, max-number-of-elements=2
    rt_Array_Float_16
      element rt_Array_Float_16: category=VALUE, type=Float, array-size-semantics=FIXED-SIZE, max-number-of-elements=16
    rt_Array_Boolean_16
      element rt_Array_Boolean_16: category=BOOLEAN, type=Boolean, array-size-semantics=FIXED-SIZE, max-number-of-elements=16
  app type UInt8: category=VALUE, sw-calibration-access=READ-WRITE, compu {identical}, range phys 0..255
  application array data type rt_Array_Float_11: category=ARRAY, sw-calibration-access=READ-WRITE
    element rt_Array_Float_11: category=VALUE, type=Float, array-size-semantics=FIXED-SIZE, max-number-of-elements=11
  application array data type rt_Array_Boolean_11: category=ARRAY, sw-calibration-access=READ-WRITE
    element rt_Array_Boolean_11: category=BOOLEAN, type=Boolean, array-size-semantics=FIXED-SIZE, max-number-of-elements=11
  app type UInt16: category=VALUE, sw-calibration-access=READ-WRITE, compu {identical}, range phys 0..65535
package /CSCR_Code_pkg/CSCR_Code_dt/DataTypeMappings
  data type mapping set CSCR_CodeDataTypeMappingsSet
    data-type-maps:
      application-data-type=Float, implementation-data-type=Float
      application-data-type=rt_Array_Float_96, implementation-data-type=rt_Array_Float_96
      application-data-type=Boolean, implementation-data-type=Boolean
      application-data-type=rt_Array_Boolean_96, implementation-data-type=rt_Array_Boolean_96
      application-data-type=rt_Array_Float_8, implementation-data-type=rt_Array_Float_8
      application-data-type=rt_Array_Boolean_8, implementation-data-type=rt_Array_Boolean_8
      application-data-type=rt_Array_Float_2, implementation-data-type=rt_Array_Float_2
      application-data-type=rt_Array_Boolean_2, implementation-data-type=rt_Array_Boolean_2
      application-data-type=rt_Array_Float_16, implementation-data-type=rt_Array_Float_16
      application-data-type=rt_Array_Boolean_16, implementation-data-type=rt_Array_Boolean_16
      application-data-type=UInt8, implementation-data-type=UInt8
      application-data-type=rt_Array_Float_11, implementation-data-type=rt_Array_Float_11
      application-data-type=rt_Array_Boolean_11, implementation-data-type=rt_Array_Boolean_11
      application-data-type=UInt16, implementation-data-type=UInt16
package /CSCR_Code_pkg/CSCR_Code_dt/SwAddrMethods
  sw addr method CODE: section-type=CODE
  sw addr method CONST: section-type=CONST
  sw addr method VAR: section-type=VAR
