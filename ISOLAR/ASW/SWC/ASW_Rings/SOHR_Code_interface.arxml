AUTOSAR XML (schema 4-0-3)
package /CalibrationComponents
  parameter interface SOHR_if
    22 x parameter data prototype, all with sw-calibration-access=READ-WRITE:
      KeSOHR_Ah_AvailableCapacityInst_MaxVal: category=VALUE, type=Float
      KeSOHR_Ah_AvailableCapacityInst_minVal: category=VALUE, type=Float
      KeSOHR_Ah_AvailableCapacity_MaxVal: category=VALUE, type=Float
      KeSOHR_Ah_AvailableCapacity_minVal: category=VALUE, type=Float
      KeSOHR_Ah_InitialAccumCharge: category=VALUE, type=Float
      KeSOHR_Ah_OvrdValue_AccumCharge: category=VALUE, type=Float
      KeSOHR_Ah_OvrdValue_AvailableCapacity: category=VALUE, type=Float
      KeSOHR_Ah_OvrdValue_AvailableCapacityInst: category=VALUE, type=Float
      KeSOHR_Ah_UpdateIncrement: category=VALUE, type=Float
      KeSOHR_Pct_BatteryPackSOH_MaxVal: category=VALUE, type=Float
      KeSOHR_Pct_BatteryPackSOH_minVal: category=VALUE, type=Float
      KeSOHR_Pct_LowSOH_flt_Set: category=VALUE, type=Float
      KeSOHR_Pct_OvrdValue_BatteryPackSOH: category=VALUE, type=Float
      KeSOHR_t_LowSOH_flt_Set: category=VALUE, type=Float
      KeSOHR_b_LowSOH_flt_En: category=BOOLEAN, type=Boolean
      KeSOHR_b_OvrdCond_AccumCharge: category=BOOLEAN, type=Boolean
      KeSOHR_b_OvrdCond_AvailableCapacity: category=BOOLEAN, type=Boolean
      KeSOHR_b_OvrdCond_AvailableCapacityInst: category=BOOLEAN, type=Boolean
      KeSOHR_b_OvrdCond_BatteryPackSOH: category=BOOLEAN, type=Boolean
      KeSOHR_b_SOHRank_En: category=BOOLEAN, type=Boolean
      KeSOHR_k_LowSOH_flt_Val: category=VALUE, type=UInt8
      KeSOHR_k_SOHRank_Val: category=VALUE, type=UInt8
package /SOHR_Code_pkg/SOHR_Code_if
  15 x sender receiver interface:
    VeSOHR_Ah_AccumCharge
      data VeSOHR_Ah_AccumCharge: category=VALUE, sw-calibration-access=READ-ONLY, type=Float
    VeSOHR_Ah_AccumChargeRounded
      data VeSOHR_Ah_AccumChargeRounded: category=VALUE, sw-calibration-access=READ-ONLY, type=Float
    VeSOHR_Pct_BatteryPackSOH
      data VeSOHR_Pct_BatteryPackSOH: category=VALUE, sw-calibration-access=READ-ONLY, type=Float
    VeSOHR_Ah_AvailableCapacity
      data VeSOHR_Ah_AvailableCapacity: category=VALUE, sw-calibration-access=READ-ONLY, type=Float
    VeSOHR_Ah_AvailableCapacityInst
      data VeSOHR_Ah_AvailableCapacityInst: category=VALUE, sw-calibration-access=READ-ONLY, type=Float
    VeSOHR_k_LowSOH_flt
      data VeSOHR_k_LowSOH_flt: category=VALUE, sw-calibration-access=READ-ONLY, type=UInt8
    VeSOHR_k_SOHRank
      data VeSOHR_k_SOHRank: category=VALUE, sw-calibration-access=READ-ONLY, type=UInt8
    VeVSDR_q_AccuChgCoulombs
      data VeVSDR_q_AccuChgCoulombs: category=VALUE, type=Float
    VeCSCR_T_AvgCellTempMod
      data VeCSCR_T_AvgCellTempMod: category=VALUE, type=Float
    VeCSCR_T_MinCellTempMod
      data VeCSCR_T_MinCellTempMod: category=VALUE, type=Float
    VeSOCR_Pct_DisplayPackSOC
      data VeSOCR_Pct_DisplayPackSOC: category=VALUE, type=Float
    VeLLSR_b_IntEEP_Invalid
      data VeLLSR_b_IntEEP_Invalid: category=BOOLEAN, type=Boolean
    VeLLSR_b_ExtEEP_Invalid
      data VeLLSR_b_ExtEEP_Invalid: category=BOOLEAN, type=Boolean
    VeLLSR_Ah_AccumChargeExt
      data VeLLSR_Ah_AccumChargeExt: category=VALUE, type=Float
    VeLLSR_b_ClearDTC
      data VeLLSR_b_ClearDTC: category=BOOLEAN, type=Boolean
