AUTOSAR XML (schema 4-0-3)
package /CFLR_Code_pkg/CFLR_Code_imp
  swc implementation CFLR_Code: programming-language=C, sw-version=1.295.1, used-code-generator=Embedded Coder 7.2 (R2019a) 23-Nov-2018, vendor-id=0, behavior=CFLR_Code
    code-descriptors:
      code Code
        artifact-descriptors:
          short-label=CFLR_Code_c, category=SWSRC
          short-label=CFLR_Code_Calibrations_c, category=SWSRC
          short-label=CFLR_Code_ContactorDiag_c, category=SWSRC
          short-label=ContactorDrive_c, category=SWSRC
          short-label=g_App_Bin2TernLatch_c, category=SWSRC
          short-label=g_App_DualDebouncerOnOff_c, category=SWSRC
          short-label=g_App_TernLatch_c, category=SWSRC
          short-label=ASW_Types_h, category=SWHDR
          short-label=CFLR_Code_h, category=SWHDR
          short-label=CFLR_Code_Calibrations_h, category=SWHDR
          short-label=CFLR_Code_ContactorDiag_h, category=SWHDR
          short-label=CFLR_Code_private_h, category=SWHDR
          short-label=CFLR_Code_types_h, category=SWHDR
          short-label=ContactorDrive_h, category=SWHDR
          short-label=g_App_Bin2TernLatch_h, category=SWHDR
          short-label=g_App_Bin2TernLatch_private_h, category=SWHDR
          short-label=g_App_Bin2TernLatch_types_h, category=SWHDR
          short-label=g_App_DualDebouncerOnOff_h, category=SWHDR
          short-label=g_App_DualDebouncerOnOff_private_h, category=SWHDR
          short-label=g_App_DualDebouncerOnOff_types_h, category=SWHDR
          short-label=g_App_TernLatch_h, category=SWHDR
          short-label=g_App_TernLatch_private_h, category=SWHDR
          short-label=g_App_TernLatch_types_h, category=SWHDR
          short-label=rtwtypes_h, category=SWHDR
          short-label=tmwtypes_h, category=SWHDR
    resource consumption RsrcCons_CFLR_Code
