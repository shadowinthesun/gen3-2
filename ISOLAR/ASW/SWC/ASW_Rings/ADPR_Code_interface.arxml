AUTOSAR XML (schema 4-0-3)
package /ADPR_Code_pkg/ADPR_Code_if
  138 x sender receiver interface:
    VeADPR_e_ChargerEnable
      data VeADPR_e_ChargerEnable: category=VALUE, sw-calibration-access=READ-ONLY, type=TeCHMR_e_OBC_ChrgEnable
    VeADPR_b_ACChargEn
      data VeADPR_b_ACChargEn: category=BOOLEAN, sw-calibration-access=READ-ONLY, type=Boolean
    VeADPR_k_ChargeStatus
      data VeADPR_k_ChargeStatus: category=VALUE, sw-calibration-access=READ-ONLY, type=UInt8
    VeADPR_b_ChargeReq
      data VeADPR_b_ChargeReq: category=BOOLEAN, sw-calibration-access=READ-ONLY, type=Boolean
    VeADPR_I_ChrgCurrentRq
      data VeADPR_I_ChrgCurrentRq: category=VALUE, sw-calibration-access=READ-ONLY, type=Float
    VeADPR_U_ChrgVoltSetPt
      data VeADPR_U_ChrgVoltSetPt: category=VALUE, sw-calibration-access=READ-ONLY, type=Float
    VeADPR_k_DCRelayCheckReq
      data VeADPR_k_DCRelayCheckReq: category=VALUE, sw-calibration-access=READ-ONLY, type=UInt8
    VeADPR_b_ChgPlugInCounterReset
      data VeADPR_b_ChgPlugInCounterReset: category=BOOLEAN, sw-calibration-access=READ-ONLY, type=Boolean
    VeADPR_k_ChargeMode
      data VeADPR_k_ChargeMode: category=VALUE, sw-calibration-access=READ-ONLY, type=UInt8
    VeADPR_k_OBCWorkingCommand
      data VeADPR_k_OBCWorkingCommand: category=VALUE, sw-calibration-access=READ-ONLY, type=UInt8
    VeADPR_k_OBCChDischReady
      data VeADPR_k_OBCChDischReady: category=VALUE, sw-calibration-access=READ-ONLY, type=UInt8
    VeADPR_k_BattNeedCharge
      data VeADPR_k_BattNeedCharge: category=VALUE, sw-calibration-access=READ-ONLY, type=UInt8
    VeADPR_b_ACOrDCChargeFullFlag
      data VeADPR_b_ACOrDCChargeFullFlag: category=BOOLEAN, sw-calibration-access=READ-ONLY, type=Boolean
    VeADPR_b_AuxilPwrSply
      data VeADPR_b_AuxilPwrSply: category=BOOLEAN, sw-calibration-access=READ-ONLY, type=Boolean
    VeADPR_b_CC2ConnState
      data VeADPR_b_CC2ConnState: category=BOOLEAN, sw-calibration-access=READ-ONLY, type=Boolean
    VeADPR_T_FastChrgNegSocketTemp
      data VeADPR_T_FastChrgNegSocketTemp: category=VALUE, sw-calibration-access=READ-ONLY, type=Float
    VeADPR_T_FastChrgPosSocketTemp
      data VeADPR_T_FastChrgPosSocketTemp: category=VALUE, sw-calibration-access=READ-ONLY, type=Float
    VeADPR_b_FCSocketTempSensorPos_Invalid
      data VeADPR_b_FCSocketTempSensorPos_Invalid: category=BOOLEAN, sw-calibration-access=READ-ONLY, type=Boolean
    VeADPR_b_FCSocketTempSensorNeg_Invalid
      data VeADPR_b_FCSocketTempSensorNeg_Invalid: category=BOOLEAN, sw-calibration-access=READ-ONLY, type=Boolean
    VeADPR_b_ChargeEn
      data VeADPR_b_ChargeEn: category=BOOLEAN, sw-calibration-access=READ-ONLY, type=Boolean
    VeADPR_b_DCRelayStatus
      data VeADPR_b_DCRelayStatus: category=BOOLEAN, sw-calibration-access=READ-ONLY, type=Boolean
    VeADPR_k_ShutDownReq
      data VeADPR_k_ShutDownReq: category=VALUE, sw-calibration-access=READ-ONLY, type=UInt8
    VeADPR_k_ChDIschWaitTimeOut
      data VeADPR_k_ChDIschWaitTimeOut: category=VALUE, sw-calibration-access=READ-ONLY, type=UInt8
    VeADPR_k_ChargeDischReady
      data VeADPR_k_ChargeDischReady: category=VALUE, sw-calibration-access=READ-ONLY, type=UInt8
    VeADPR_k_HeatingMethod
      data VeADPR_k_HeatingMethod: category=VALUE, sw-calibration-access=READ-ONLY, type=UInt8
    VeADPR_k_SendChargingStatus
      data VeADPR_k_SendChargingStatus: category=VALUE, sw-calibration-access=READ-ONLY, type=UInt8
    VeADPR_k_VehicleDischargingStatus
      data VeADPR_k_VehicleDischargingStatus: category=VALUE, sw-calibration-access=READ-ONLY, type=UInt8
    VeADPR_b_BattHeatChkComplt
      data VeADPR_b_BattHeatChkComplt: category=BOOLEAN, sw-calibration-access=READ-ONLY, type=Boolean
    VeADPR_k_BattPreHeatReq
      data VeADPR_k_BattPreHeatReq: category=VALUE, sw-calibration-access=READ-ONLY, type=UInt8
    VeADPR_b_ReChDischargeReq
      data VeADPR_b_ReChDischargeReq: category=BOOLEAN, sw-calibration-access=READ-ONLY, type=Boolean
    VeADPR_b_ACChConnect
      data VeADPR_b_ACChConnect: category=BOOLEAN, sw-calibration-access=READ-ONLY, type=Boolean
    VeADPR_b_DisStopFlag
      data VeADPR_b_DisStopFlag: category=BOOLEAN, sw-calibration-access=READ-ONLY, type=Boolean
    VeADPR_b_ChrgElecLock
      data VeADPR_b_ChrgElecLock: category=BOOLEAN, sw-calibration-access=READ-ONLY, type=Boolean
    VeADPR_I_ChrgMaxOutCurr
      data VeADPR_I_ChrgMaxOutCurr: category=VALUE, sw-calibration-access=READ-ONLY, type=Float
    VeADPR_b_ACpreheatingEn
      data VeADPR_b_ACpreheatingEn: category=BOOLEAN, sw-calibration-access=READ-ONLY, type=Boolean
    VeADPR_k_S2Command
      data VeADPR_k_S2Command: category=VALUE, sw-calibration-access=READ-ONLY, type=UInt8
    VeADPR_b_PosandNegClosed
      data VeADPR_b_PosandNegClosed: category=BOOLEAN, sw-calibration-access=READ-ONLY, type=Boolean
    VeADPR_b_KeepWarmEn
      data VeADPR_b_KeepWarmEn: category=BOOLEAN, sw-calibration-access=READ-ONLY, type=Boolean
    VeADPR_b_ACChargeSystemFault
      data VeADPR_b_ACChargeSystemFault: category=BOOLEAN, sw-calibration-access=READ-ONLY, type=Boolean
    VeADPR_b_ShutDownEn
      data VeADPR_b_ShutDownEn: category=BOOLEAN, sw-calibration-access=READ-ONLY, type=Boolean
    VeADPR_b_DCRelayStatusfault
      data VeADPR_b_DCRelayStatusfault: category=BOOLEAN, sw-calibration-access=READ-ONLY, type=Boolean
    VeADPR_T_SlowChrgPosSocketTemp
      data VeADPR_T_SlowChrgPosSocketTemp: category=VALUE, sw-calibration-access=READ-ONLY, type=Float
    VeADPR_T_SlowChrgNegSocketTemp
      data VeADPR_T_SlowChrgNegSocketTemp: category=VALUE, sw-calibration-access=READ-ONLY, type=Float
    VeADPR_b_FastChrgSocketTempDetectEn
      data VeADPR_b_FastChrgSocketTempDetectEn: category=BOOLEAN, sw-calibration-access=READ-ONLY, type=Boolean
    VeADPR_b_ECCFucLimitCMD
      data VeADPR_b_ECCFucLimitCMD: category=BOOLEAN, sw-calibration-access=READ-ONLY, type=Boolean
    VeADPR_k_BookSetReq
      data VeADPR_k_BookSetReq: category=VALUE, sw-calibration-access=READ-ONLY, type=UInt8
    VeADPR_k_IntelligentChargeReq
      data VeADPR_k_IntelligentChargeReq: category=VALUE, sw-calibration-access=READ-ONLY, type=UInt8
    VeADPR_k_BatteryMaintainLightReq
      data VeADPR_k_BatteryMaintainLightReq: category=VALUE, sw-calibration-access=READ-ONLY, type=UInt8
    VeADPR_k_ChargeOutMinCurSet
      data VeADPR_k_ChargeOutMinCurSet: category=VALUE, sw-calibration-access=READ-ONLY, type=UInt8
    VeADPR_b_ACPConnect
      data VeADPR_b_ACPConnect: category=BOOLEAN, sw-calibration-access=READ-ONLY, type=Boolean
    VeCSCR_T_MinCellTempMod
      data VeCSCR_T_MinCellTempMod: category=VALUE, type=Float
    VeCSCR_T_MaxCellTempMod
      data VeCSCR_T_MaxCellTempMod: category=VALUE, type=Float
    VeCANR_k_PowerSupplyStatus
      data VeCANR_k_PowerSupplyStatus: category=VALUE, type=UInt8
    VeCANR_k_DiscVehicleStatus
      data VeCANR_k_DiscVehicleStatus: category=VALUE, type=UInt8
    VeCANR_k_DiscButtonPress
      data VeCANR_k_DiscButtonPress: category=VALUE, type=UInt8
    VeCANR_b_DiscManualStop
      data VeCANR_b_DiscManualStop: category=BOOLEAN, type=Boolean
    VeCANR_k_ChargeEn
      data VeCANR_k_ChargeEn: category=VALUE, type=UInt8
    VeCANR_k_DCRelayStatus
      data VeCANR_k_DCRelayStatus: category=VALUE, type=UInt8
    VeHVSR_e_StateMode
      data VeHVSR_e_StateMode: category=VALUE, type=TeHVSR_e_StateMode
    VeCHMR_k_ChargeStatus
      data VeCHMR_k_ChargeStatus: category=VALUE, type=UInt8
    VeFCMR_k_ChargeStatus
      data VeFCMR_k_ChargeStatus: category=VALUE, type=UInt8
    VeCHMR_b_ChargingActive
      data VeCHMR_b_ChargingActive: category=BOOLEAN, type=Boolean
    VeFCMR_b_FC_Active
      data VeFCMR_b_FC_Active: category=BOOLEAN, type=Boolean
    VeCANR_k_ACChConnStatus
      data VeCANR_k_ACChConnStatus: category=VALUE, type=UInt8
    VeFCMR_b_FastChgConntState
      data VeFCMR_b_FastChgConntState: category=BOOLEAN, type=Boolean
    VeCHMR_b_ChargeReq
      data VeCHMR_b_ChargeReq: category=BOOLEAN, type=Boolean
    VeFCMR_b_DCChargeReq
      data VeFCMR_b_DCChargeReq: category=BOOLEAN, type=Boolean
    VeCHMR_I_ChrgCurrentRq
      data VeCHMR_I_ChrgCurrentRq: category=VALUE, type=Float
    VeFCMR_I_DemandCurr
      data VeFCMR_I_DemandCurr: category=VALUE, type=Float
    VeCHMR_U_ChrgVoltSetPt
      data VeCHMR_U_ChrgVoltSetPt: category=VALUE, type=Float
    VeFCMR_U_DemandVolt
      data VeFCMR_U_DemandVolt: category=VALUE, type=Float
    VeCHMR_e_ChargingSM
      data VeCHMR_e_ChargingSM: category=VALUE, type=TeCHMR_e_ChargingStateMachine
    VeFCMR_b_DCRelayCheckReq
      data VeFCMR_b_DCRelayCheckReq: category=BOOLEAN, type=Boolean
    VeCANR_k_VehicleState
      data VeCANR_k_VehicleState: category=VALUE, type=UInt16
    VeCANR_k_OBCWorkingMode
      data VeCANR_k_OBCWorkingMode: category=VALUE, type=UInt8
    VeCHMR_b_ChrgComplete
      data VeCHMR_b_ChrgComplete: category=BOOLEAN, type=Boolean
    VeFCMR_b_FC_ChargeComplete
      data VeFCMR_b_FC_ChargeComplete: category=BOOLEAN, type=Boolean
    VeLLSR_b_AuxilPwrSupply
      data VeLLSR_b_AuxilPwrSupply: category=BOOLEAN, type=Boolean
    VeCANR_b_AuxilPwrSply
      data VeCANR_b_AuxilPwrSply: category=BOOLEAN, type=Boolean
    VeLLSR_b_CC2ConnState
      data VeLLSR_b_CC2ConnState: category=BOOLEAN, type=Boolean
    VeCANR_U_CC2Volt
      data VeCANR_U_CC2Volt: category=VALUE, type=Float
    VeLLSR_T_FastChrgNegSocketTemp
      data VeLLSR_T_FastChrgNegSocketTemp: category=VALUE, type=Float
    VeCANR_T_FastChrgNegSocketTemp
      data VeCANR_T_FastChrgNegSocketTemp: category=VALUE, type=Float
    VeLLSR_T_FastChrgPosSocketTemp
      data VeLLSR_T_FastChrgPosSocketTemp: category=VALUE, type=Float
    VeCANR_T_FastChrgPosSocketTemp
      data VeCANR_T_FastChrgPosSocketTemp: category=VALUE, type=Float
    VeLLSR_b_FCSocketTempSensorPos_Invalid
      data VeLLSR_b_FCSocketTempSensorPos_Invalid: category=BOOLEAN, type=Boolean
    VeCANR_b_FCSocketTempSensorPos_Invalid
      data VeCANR_b_FCSocketTempSensorPos_Invalid: category=BOOLEAN, type=Boolean
    VeLLSR_b_FCSocketTempSensorNeg_Invalid
      data VeLLSR_b_FCSocketTempSensorNeg_Invalid: category=BOOLEAN, type=Boolean
    VeCANR_b_FCSocketTempSensorNeg_Invalid
      data VeCANR_b_FCSocketTempSensorNeg_Invalid: category=BOOLEAN, type=Boolean
    VeCFLR_e_DCPreChargeSts
      data VeCFLR_e_DCPreChargeSts: category=VALUE, type=Float
    VeCANR_b_DCPosCloseCmd
      data VeCANR_b_DCPosCloseCmd: category=BOOLEAN, type=Boolean
    VeCANR_b_DCNegCloseCmd
      data VeCANR_b_DCNegCloseCmd: category=BOOLEAN, type=Boolean
    VeCANR_k_OBCCurrentStatus
      data VeCANR_k_OBCCurrentStatus: category=VALUE, type=UInt8
    VeCANR_b_ElecLockUnlockingFlt
      data VeCANR_b_ElecLockUnlockingFlt: category=BOOLEAN, type=Boolean
    VeCANR_k_ElecLockControlCmd
      data VeCANR_k_ElecLockControlCmd: category=VALUE, type=UInt8
    VeDHSR_b_BattPowerOff5S
      data VeDHSR_b_BattPowerOff5S: category=BOOLEAN, type=Boolean
    VeDHSR_b_BattPowerOff30S
      data VeDHSR_b_BattPowerOff30S: category=BOOLEAN, type=Boolean
    VeDHSR_b_BattPowerOff10Min
      data VeDHSR_b_BattPowerOff10Min: category=BOOLEAN, type=Boolean
    VeCHMR_k_SWS2Control
      data VeCHMR_k_SWS2Control: category=VALUE, type=UInt8
    VeCANR_U_OBCInputVoltage
      data VeCANR_U_OBCInputVoltage: category=VALUE, type=Float
    VeCANR_k_BCMDischargeStop
      data VeCANR_k_BCMDischargeStop: category=VALUE, type=UInt8
    VeCHMR_k_HeatingInsulationReq
      data VeCHMR_k_HeatingInsulationReq: category=VALUE, type=UInt8
    VeSOHR_Ah_AvailableCapacityInst
      data VeSOHR_Ah_AvailableCapacityInst: category=VALUE, type=Float
    VeSOCR_Pct_DisplayPackSOC
      data VeSOCR_Pct_DisplayPackSOC: category=VALUE, type=Float
    VeCANR_Pct_ICMUserSetDisStopSOC
      data VeCANR_Pct_ICMUserSetDisStopSOC: category=VALUE, type=Float
    VeCHMR_k_OBCWorkingCommand
      data VeCHMR_k_OBCWorkingCommand: category=VALUE, type=UInt8
    VeCANR_k_VCUVehicleModel
      data VeCANR_k_VCUVehicleModel: category=VALUE, type=UInt8
    VeCHMR_b_HeatingInsulationReqcomplt
      data VeCHMR_b_HeatingInsulationReqcomplt: category=BOOLEAN, type=Boolean
    VeFCMR_b_DCPreHeatChkCmplt
      data VeFCMR_b_DCPreHeatChkCmplt: category=BOOLEAN, type=Boolean
    VeFCMR_b_DCPreHeatReq
      data VeFCMR_b_DCPreHeatReq: category=BOOLEAN, type=Boolean
    VeHVSR_b_OBCDischgAllowed
      data VeHVSR_b_OBCDischgAllowed: category=BOOLEAN, type=Boolean
    VeCHMR_b_ReChargeStatus
      data VeCHMR_b_ReChargeStatus: category=BOOLEAN, type=Boolean
    VeCANR_b_ACAwake
      data VeCANR_b_ACAwake: category=BOOLEAN, type=Boolean
    VeCANR_e_ChrgElecLock
      data VeCANR_e_ChrgElecLock: category=VALUE, type=TeCHMR_e_ChrgElecLock
    VeCANR_I_ChrgMaxOutCurr
      data VeCANR_I_ChrgMaxOutCurr: category=VALUE, type=Float
    VeCANR_kP_OBCOutPowerMax
      data VeCANR_kP_OBCOutPowerMax: category=VALUE, type=Float
    VeCSCR_U_PackVoltage_out
      data VeCSCR_U_PackVoltage_out: category=VALUE, type=Float
    VeTHMR_b_HeaterContator
      data VeTHMR_b_HeaterContator: category=BOOLEAN, type=Boolean
    VeHVSR_k_SelfCheckCounter
      data VeHVSR_k_SelfCheckCounter: category=VALUE, type=UInt8
    VeFCMR_b_DC_PowerDownReq
      data VeFCMR_b_DC_PowerDownReq: category=BOOLEAN, type=Boolean
    VeCFLR_k_HVClosingReq
      data VeCFLR_k_HVClosingReq: category=VALUE, type=UInt8
    VeFCMR_e_ChrgOffBoardSt
      data VeFCMR_e_ChrgOffBoardSt: category=VALUE, type=TeFCMR_e_ChrgOffBoardSt
    VeCANR_b_OnWakeUp
      data VeCANR_b_OnWakeUp: category=BOOLEAN, type=Boolean
    VeCANR_b_GridBreakeFlag
      data VeCANR_b_GridBreakeFlag: category=BOOLEAN, type=Boolean
    VeFCMR_k_KeepWarmReqStatus
      data VeFCMR_k_KeepWarmReqStatus: category=VALUE, type=UInt8
    VeTHMR_k_BMSToEHUInslationReq
      data VeTHMR_k_BMSToEHUInslationReq: category=VALUE, type=UInt8
    VeCANR_T_SlowChrgPosSocketTemp
      data VeCANR_T_SlowChrgPosSocketTemp: category=VALUE, type=Float
    VeCANR_T_SlowChrgNegSocketTemp
      data VeCANR_T_SlowChrgNegSocketTemp: category=VALUE, type=Float
    VeDHSR_b_ChargeStandby
      data VeDHSR_b_ChargeStandby: category=BOOLEAN, type=Boolean
    VeDHSR_b_ChargeReqPOff
      data VeDHSR_b_ChargeReqPOff: category=BOOLEAN, type=Boolean
    VeCANR_b_ECCFucLimitCMD
      data VeCANR_b_ECCFucLimitCMD: category=BOOLEAN, type=Boolean
    VeLLSR_k_OBCComLoss_flt
      data VeLLSR_k_OBCComLoss_flt: category=VALUE, type=UInt8
    VeCFLR_b_HeatContactor
      data VeCFLR_b_HeatContactor: category=BOOLEAN, type=Boolean
    VeCHMR_b_ActiveHeatFlag
      data VeCHMR_b_ActiveHeatFlag: category=BOOLEAN, type=Boolean
    VeCANR_Pct_CPDutyVl
      data VeCANR_Pct_CPDutyVl: category=VALUE, type=Float
    VeCANR_b_CPDutyFault
      data VeCANR_b_CPDutyFault: category=BOOLEAN, type=Boolean
    VeCHMR_b_HeatReset
      data VeCHMR_b_HeatReset: category=BOOLEAN, type=Boolean
    VeLLSR_k_ActiveVariant
      data VeLLSR_k_ActiveVariant: category=VALUE, type=UInt8
package /CalibrationComponents
  parameter interface ADPR_if
    112 x parameter data prototype, all with sw-calibration-access=READ-WRITE:
      KeADPR_I_ChrgCurrentRqOvrdVal: category=VALUE, type=Float
      KeADPR_I_OBCMaxOutPowOvrdVal: category=VALUE, type=Float
      KeADPR_I_PreheatingCurrentRq: category=VALUE, type=Float
      KeADPR_T_MaxTAllowToHeat: category=VALUE, type=Float
      KeADPR_T_MinTAllowToChrg: category=VALUE, type=Float
      KeADPR_U_ChrgVoltSetPtOvrdVal: category=VALUE, type=Float
      KeADPR_U_OBCInputVoltageMax: category=VALUE, type=Float
      KeADPR_U_OBCInputVoltageMin: category=VALUE, type=Float
      KeADPR_b_SlowChrgNegSocketTempVal: category=VALUE, type=Float
      KeADPR_b_SlowChrgPosSocketTempVal: category=VALUE, type=Float
      KeADPR_t_ACChargeNoConnect_Timer: category=VALUE, type=Float
      KeADPR_t_ACChargeNoConnect_Timer1: category=VALUE, type=Float
      KeADPR_t_ACChargeSemiConnect_Timer: category=VALUE, type=Float
      KeADPR_t_ACChargeSemiConnect_Timer1: category=VALUE, type=Float
      KeADPR_t_ACVoltageExceed_Timer: category=VALUE, type=Float
      KeADPR_t_BattPowerOffThresh{1..3}: category=VALUE, type=Float
      KeADPR_t_CHMR_FunctionCallRate: category=VALUE, type=Float
      KeADPR_t_ChrgEnDelay: category=VALUE, type=Float
      KeADPR_t_DCRelayCheckReqReSetTime: category=VALUE, type=Float
      KeADPR_t_DCRelayCheckReqSetTime: category=VALUE, type=Float
      KeADPR_t_DCRelayStatusfault_Timer: category=VALUE, type=Float
      KeADPR_t_DiscButtonPress_Timer1: category=VALUE, type=Float
      KeADPR_t_DiscManualStop_Timer1: category=VALUE, type=Float
      KeADPR_t_DiscVehicleStatus_Timer1: category=VALUE, type=Float
      KeADPR_t_ElecLockUnlocking_Timer: category=VALUE, type=Float
      KeADPR_t_FunctionCallRate: category=VALUE, type=Float
      KeADPR_t_NoRequireShutDownReset: category=VALUE, type=Float
      KeADPR_t_NoRequireShutDownSet: category=VALUE, type=Float
      KeADPR_t_OBCFltStatus_Timer: category=VALUE, type=Float
      KeADPR_t_OBCFltStatus_Timer1: category=VALUE, type=Float
      KeADPR_t_OBCInputVoltageUnnormal_Timer1: category=VALUE, type=Float
      KeADPR_t_OBCNoVTOLMode_Timer1: category=VALUE, type=Float
      KeADPR_t_OBCNoVTOVMode_Timer1: category=VALUE, type=Float
      KeADPR_t_OBCNochargingMode_Timer: category=VALUE, type=Float
      KeADPR_t_OBCNochargingMode_Timer1: category=VALUE, type=Float
      KeADPR_t_OBCStandbyModelMismatchFlt_Timer: category=VALUE, type=Float
      KeADPR_t_OBCUnnormalStatus_Timer1: category=VALUE, type=Float
      KeADPR_t_OBCWorkingModelMismatchFlt_Timer: category=VALUE, type=Float
      KeADPR_t_PowerSupplyStatus2_Timer: category=VALUE, type=Float
      KeADPR_t_PowerSupplyStatus3_Timer1: category=VALUE, type=Float
      KeADPR_t_S2CommandWaiting: category=VALUE, type=Float
      KeADPR_t_VTOLOBCNoVTOLMode_Timer1: category=VALUE, type=Float
      KeADPR_t_VTOVACChargeNoConnect_Timer: category=VALUE, type=Float
      KeADPR_t_VTOVACChargeSemiConnect_Timer: category=VALUE, type=Float
      KeADPR_t_VTOVDiscButtonPress_Timer1: category=VALUE, type=Float
      KeADPR_t_VTOVDiscManualStop_Timer1: category=VALUE, type=Float
      KeADPR_t_VTOVDiscVehicleStatus_Timer1: category=VALUE, type=Float
      KeADPR_t_VTOVElecLockUnlocking_Timer: category=VALUE, type=Float
      KeADPR_t_VTOVOBCFltStatus_Timer1: category=VALUE, type=Float
      KeADPR_t_VTOVOBCNoVTOVMode_Timer1: category=VALUE, type=Float
      KeADPR_t_VTOVOBCWorkingModelMismatchFlt1_Timer: category=VALUE, type=Float
      KeADPR_t_VTOVOBCWorkingModelMismatchFlt_Timer: category=VALUE, type=Float
      KeADPR_t_VehicleStateWaiting_Timer1: category=VALUE, type=Float
      KeADPR_b_ACChargeSystemFaultEn: category=BOOLEAN, type=Boolean
      KeADPR_b_ACChargeSystemFaultVal: category=BOOLEAN, type=Boolean
      KeADPR_b_ACOrDCChargeFullFlagEn: category=BOOLEAN, type=Boolean
      KeADPR_b_ACOrDCChargeFullFlagOvrdVal: category=BOOLEAN, type=Boolean
      KeADPR_b_BattHeatChkCompltOvrdEn: category=BOOLEAN, type=Boolean
      KeADPR_b_BattPreHeatReqOvrdEn: category=BOOLEAN, type=Boolean
      KeADPR_b_CCOvrdEn: category=BOOLEAN, type=Boolean
      KeADPR_b_CCOvrdVal: category=BOOLEAN, type=Boolean
      KeADPR_b_CPOvrdEn: category=BOOLEAN, type=Boolean
      KeADPR_b_CPOvrdVal: category=BOOLEAN, type=Boolean
      KeADPR_b_ChDIschWaitTimeOutOvrdEn: category=BOOLEAN, type=Boolean
      KeADPR_b_ChargeDischReadyOvrdEn: category=BOOLEAN, type=Boolean
      KeADPR_b_ChargeReqOvrdEn: category=BOOLEAN, type=Boolean
      KeADPR_b_ChargeReqOvrdVal: category=BOOLEAN, type=Boolean
      KeADPR_b_ChargeStatusOvrdEn: category=BOOLEAN, type=Boolean
      KeADPR_b_ChrgCurrentRqOvrdEn: category=BOOLEAN, type=Boolean
      KeADPR_b_ChrgElecLockOvrdEn: category=BOOLEAN, type=Boolean
      KeADPR_b_ChrgMaxOutCurrOvrdEn: category=BOOLEAN, type=Boolean
      KeADPR_b_ChrgVoltSetPtOvrdEn: category=BOOLEAN, type=Boolean
      KeADPR_b_DCRelayCheckReqOvrdEn: category=BOOLEAN, type=Boolean
      KeADPR_b_DCRelayStatusfaultEn: category=BOOLEAN, type=Boolean
      KeADPR_b_DCRelayStatusfaultVal: category=BOOLEAN, type=Boolean
      KeADPR_b_DisStopFlagOvrdEn: category=BOOLEAN, type=Boolean
      KeADPR_b_FastChrgSocketTempDetectEn: category=BOOLEAN, type=Boolean
      KeADPR_b_FastChrgSocketTempDetectVal: category=BOOLEAN, type=Boolean
      KeADPR_b_HeatingMethodOvrdEn: category=BOOLEAN, type=Boolean
      KeADPR_b_KeepWarmEn: category=BOOLEAN, type=Boolean
      KeADPR_b_KeepWarmVal: category=BOOLEAN, type=Boolean
      KeADPR_b_OBCMaxOutPowOvrdEn: category=BOOLEAN, type=Boolean
      KeADPR_b_PosAndNegClosedEn: category=BOOLEAN, type=Boolean
      KeADPR_b_ReChDischargeReqOvrdEn: category=BOOLEAN, type=Boolean
      KeADPR_b_S2CommandOvrdEn: category=BOOLEAN, type=Boolean
      KeADPR_b_SendChargingStatusOvrdEn: category=BOOLEAN, type=Boolean
      KeADPR_b_ShutDownEn: category=BOOLEAN, type=Boolean
      KeADPR_b_ShutDownReqOvrdEn: category=BOOLEAN, type=Boolean
      KeADPR_b_ShutDownVal: category=BOOLEAN, type=Boolean
      KeADPR_b_SlowChrgNegSocketTempEn: category=BOOLEAN, type=Boolean
      KeADPR_b_SlowChrgPosSocketTempEn: category=BOOLEAN, type=Boolean
      KeADPR_b_TempLoEnable: category=BOOLEAN, type=Boolean
      KeADPR_b_TempLoOvrd: category=BOOLEAN, type=Boolean
      KeADPR_b_VehicleDischargingStatusOvrdEn: category=BOOLEAN, type=Boolean
      KeADPR_I_ChrgMaxOutCurrOvrdVal: category=VALUE, type=UInt8
      KeADPR_b_BattHeatChkCompltOvrdVal: category=VALUE, type=UInt8
      KeADPR_b_ChrgElecLockOvrdVal: category=VALUE, type=UInt8
      KeADPR_b_DisStopFlagOvrdVal: category=VALUE, type=UInt8
      KeADPR_b_PosAndNegClosedVal: category=VALUE, type=UInt8
      KeADPR_k_BattPreHeatReqOvrdVal: category=VALUE, type=UInt8
      KeADPR_k_ChDIschWaitTimeOutOvrdVal: category=VALUE, type=UInt8
      KeADPR_k_ChargeDischReadyOvrdVal: category=VALUE, type=UInt8
      KeADPR_k_ChargeStatusOvrdVal: category=VALUE, type=UInt8
      KeADPR_k_DCRelayCheckReqOvrdVal: category=VALUE, type=UInt8
      KeADPR_k_HeatingMethodOvrdVal: category=VALUE, type=UInt8
      KeADPR_k_ReChDischargeReqOvrdVal: category=VALUE, type=UInt8
      KeADPR_k_S2CommandOvrdVal: category=VALUE, type=UInt8
      KeADPR_k_SendChargingStatusOvrdVal: category=VALUE, type=UInt8
      KeADPR_k_ShutDownReqOvrdVal: category=VALUE, type=UInt8
      KeADPR_k_VehicleDischargingStatusOvrdVal: category=VALUE, type=UInt8
