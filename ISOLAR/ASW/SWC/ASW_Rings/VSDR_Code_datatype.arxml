AUTOSAR XML (schema 4-0-3)
standard types defined: Float, Boolean, UInt8, UInt16, float32, boolean, uint8, uint16
package /VSDR_Code_pkg/VSDR_Code_dt
  unit NoUnit: factor-si-to-unit=1, offset-si-to-unit=0
  4 x impl type:
    rt_Array_Boolean_96: category=ARRAY
      element rt_Array_Boolean_96: array-size=96, array-size-semantics=FIXED-SIZE, implementation-data-type=Boolean
    rt_Array_Float_2: category=ARRAY
      element rt_Array_Float_2: array-size=2, array-size-semantics=FIXED-SIZE, implementation-data-type=Float
    rt_Array_Boolean_2: category=ARRAY
      element rt_Array_Boolean_2: array-size=2, array-size-semantics=FIXED-SIZE, implementation-data-type=Boolean
    TeHVSR_e_StateMode: category=VALUE, base-type=uint8
  impl type rt_Array_Boolean_8: category=ARRAY
    element rt_Array_Boolean_8: array-size=8, array-size-semantics=FIXED-SIZE, implementation-data-type=Boolean
  impl type TeVSDR_e_CurrentFlowState: category=VALUE, base-type=uint8
  impl type rt_Array_Float_8: category=ARRAY
    element rt_Array_Float_8: array-size=8, array-size-semantics=FIXED-SIZE, implementation-data-type=Float
package /VSDR_Code_pkg/VSDR_Code_dt/ApplDataTypes
  app type Float: category=VALUE, sw-calibration-access=READ-WRITE, compu {identical}, range phys -INF..INF
  app type Boolean: category=BOOLEAN, sw-calibration-access=READ-WRITE, compu {0=FALSE, 1=TRUE}
  application array data type rt_Array_Boolean_96: category=ARRAY, sw-calibration-access=READ-WRITE
    element rt_Array_Boolean_96: category=BOOLEAN, type=Boolean, array-size-semantics=FIXED-SIZE, max-number-of-elements=96
  application array data type rt_Array_Float_2: category=ARRAY, sw-calibration-access=READ-WRITE
    element rt_Array_Float_2: category=VALUE, type=Float, array-size-semantics=FIXED-SIZE, max-number-of-elements=2
  application array data type rt_Array_Boolean_2: category=ARRAY, sw-calibration-access=READ-WRITE
    element rt_Array_Boolean_2: category=BOOLEAN, type=Boolean, array-size-semantics=FIXED-SIZE, max-number-of-elements=2
  app type TeHVSR_e_StateMode:
    category=VALUE
    sw-calibration-access=READ-WRITE
    compu {0=CeHVSR_e_StateModeReserved, 1=CeHVSR_e_StateModeInitial, 2=CeHVSR_e_StateModeStandBy, 3=CeHVSR_e_StateModePrecharge, 4=CeHVSR_e_StateModeNormalDischarge, 5=CeHVSR_e_StateModeWarningPowerReduction, 6=CeHVSR_e_StateModePowerReduction, 7=CeHVSR_e_StateModePreChargeFailed, 8=CeHVSR_e_StateModePowerHoldMode, 9=CeHVSR_e_StateModeShutdown, 10=CeHVSR_e_StateModeServiceMode, 11=CeHVSR_e_StateModeReady, 12=CeHVSR_e_StateModeAC_ChargeMode, 13=CeHVSR_e_StateModeEndOfCharge, 14=CeHVSR_e_StateModeDC_ChargeMode, 15=CeHVSR_e_StateModeSystemErr, 16=CeHVSR_e_StateModeTempChargState, 17=CeHVSR_e_StateModeHeatPreChgState, 18=CeHVSR_e_StateModeHeatingState, 19=CeHVSR_e_StateModeHeatFinishState}
  application array data type rt_Array_Boolean_8: category=ARRAY, sw-calibration-access=READ-WRITE
    element rt_Array_Boolean_8: category=BOOLEAN, type=Boolean, array-size-semantics=FIXED-SIZE, max-number-of-elements=8
  7 x app type, all with sw-calibration-access=READ-WRITE:
    UInt8: category=VALUE, compu {identical}, range phys 0..255
    TeVSDR_e_CurrentFlowState: category=VALUE, compu {0=CeVSDR_e_CurFlowStateInit, 1=CeVSDR_e_CurFlowStateChrg, 2=CeVSDR_e_CurFlowStateDischrg, 3=CeVSDR_e_CurFlowStateInvalid}
    Appl_KtVSDR_k_HallLargeFilterCoef_Table: category=CURVE, sw-calprm-axis-set={sw-axis-index=1, category=COM_AXIS, sw-axis-grouped=Appl_KxVSDR_k_HallLargeFilterCoef}, compu {identical}, range phys -1000000..1000000, sw-record-layout=Cur_f32
    Appl_KxVSDR_k_HallLargeFilterCoef: category=COM_AXIS, sw-calprm-axis-set={sw-axis-index=1, sw-axis-individual={compu {identical}, sw-max-axis-points=8, sw-min-axis-points=8, range phys -1000000..1000000}}, sw-record-layout=Distr_f32_M
    Appl_KtVSDR_k_HallSmallFilterCoef_Table: category=CURVE, sw-calprm-axis-set={sw-axis-index=1, category=COM_AXIS, sw-axis-grouped=Appl_KxVSDR_k_HallSmallFilterCoef}, compu {identical}, range phys -1000000..1000000, sw-record-layout=Cur_f32
    Appl_KxVSDR_k_HallSmallFilterCoef: category=COM_AXIS, sw-calprm-axis-set={sw-axis-index=1, sw-axis-individual={compu {identical}, sw-max-axis-points=8, sw-min-axis-points=8, range phys -1000000..1000000}}, sw-record-layout=Distr_f32_M
    UInt16: category=VALUE, compu {identical}, range phys 0..65535
package /VSDR_Code_pkg/VSDR_Code_dt/ApplDataTypes/RecordLayouts
  sw record layout Cur_f32: sw-record-layout-group={short-label=Cur_f32, category=COLUMN_DIR, sw-record-layout-group-axis=0, sw-record-layout-group-index=X, sw-record-layout-group-from=1, sw-record-layout-group-to=-1, sw-record-layout-v={short-label=Val, base-type=float32, sw-record-layout-v-axis=0, sw-record-layout-v-prop=VALUE, sw-record-layout-v-index=X}}
  sw record layout Distr_f32_M: sw-record-layout-group={short-label=X, category=INDEX_INCR, sw-record-layout-group-axis=1, sw-record-layout-group-from=1, sw-record-layout-group-to=-1, sw-record-layout-v={short-label=VALUE, base-type=float32, sw-record-layout-v-axis=1, sw-record-layout-v-prop=VALUE}}
package /VSDR_Code_pkg/VSDR_Code_dt/DataTypeMappings
  data type mapping set VSDR_CodeDataTypeMappingsSet
    data-type-maps:
      application-data-type=Float, implementation-data-type=Float
      application-data-type=Boolean, implementation-data-type=Boolean
      application-data-type=rt_Array_Boolean_96, implementation-data-type=rt_Array_Boolean_96
      application-data-type=rt_Array_Float_2, implementation-data-type=rt_Array_Float_2
      application-data-type=rt_Array_Boolean_2, implementation-data-type=rt_Array_Boolean_2
      application-data-type=TeHVSR_e_StateMode, implementation-data-type=TeHVSR_e_StateMode
      application-data-type=rt_Array_Boolean_8, implementation-data-type=rt_Array_Boolean_8
      application-data-type=UInt8, implementation-data-type=UInt8
      application-data-type=TeVSDR_e_CurrentFlowState, implementation-data-type=TeVSDR_e_CurrentFlowState
      application-data-type=Appl_KtVSDR_k_HallLargeFilterCoef_Table, implementation-data-type=rt_Array_Float_8
      application-data-type=Appl_KxVSDR_k_HallLargeFilterCoef, implementation-data-type=rt_Array_Float_8
      application-data-type=Appl_KtVSDR_k_HallSmallFilterCoef_Table, implementation-data-type=rt_Array_Float_8
      application-data-type=Appl_KxVSDR_k_HallSmallFilterCoef, implementation-data-type=rt_Array_Float_8
      application-data-type=UInt16, implementation-data-type=UInt16
package /VSDR_Code_pkg/VSDR_Code_dt/Ground
  4 x constant specification:
    KtVSDR_k_HallLargeFilterCoef_Table: value-spec=[0.10000000149011612 0.18000000715255737 0.20000000298023224 0.30000001192092896 0.5 0.6000000238418579 0.800000011920929 1]
    KtVSDR_k_HallSmallFilterCoef_Table: value-spec=[0.10000000149011612 0.18000000715255737 0.20000000298023224 0.30000001192092896 0.5 0.6000000238418579 0.800000011920929 1]
    KxVSDR_k_HallLargeFilterCoef: value-spec=[0 5 10 50 100 150 200 300]
    KxVSDR_k_HallSmallFilterCoef: value-spec=[0 5 10 50 100 150 200 300]
package /VSDR_Code_pkg/VSDR_Code_dt/SwAddrMethods
  sw addr method CODE: section-type=CODE
  sw addr method CONST: section-type=CONST
  sw addr method VAR: section-type=VAR
