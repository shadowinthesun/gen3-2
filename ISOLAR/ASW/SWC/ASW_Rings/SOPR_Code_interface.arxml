AUTOSAR XML (schema 4-0-3)
package /CalibrationComponents
  parameter interface SOPR_if
    78 x parameter data prototype, all with sw-calibration-access=READ-WRITE:
      KeSOPR_I_ChrgCurLmt_Val: category=VALUE, type=Float
      KeSOPR_I_DschgCurLmt_Val: category=VALUE, type=Float
      KeSOPR_kE_InitialTotalChargeEnergy: category=VALUE, type=Float
      KeSOPR_kE_InitialTotalDisChargeEnergy: category=VALUE, type=Float
      KeSOPR_kE_InitialTotalFeedbackEnergy: category=VALUE, type=Float
      KeSOPR_kE_OvrdValue_SingleChargeEnergy: category=VALUE, type=Float
      KeSOPR_kE_OvrdValue_SingleDisChargeEnergy: category=VALUE, type=Float
      KeSOPR_kE_OvrdValue_SingleFeedbackEnergy: category=VALUE, type=Float
      KeSOPR_kE_OvrdValue_TotalChargeEnergy: category=VALUE, type=Float
      KeSOPR_kE_OvrdValue_TotalDisChargeEnergy: category=VALUE, type=Float
      KeSOPR_kE_OvrdValue_TotalFeedbackEnergy: category=VALUE, type=Float
      KeSOPR_kE_SingleChargeEnergy_MaxVal: category=VALUE, type=Float
      KeSOPR_kE_SingleChargeEnergy_minVal: category=VALUE, type=Float
      KeSOPR_kE_SingleDisChargeEnergy_MaxVal: category=VALUE, type=Float
      KeSOPR_kE_SingleDisChargeEnergy_minVal: category=VALUE, type=Float
      KeSOPR_kE_SingleFeedbackEnergy_MaxVal: category=VALUE, type=Float
      KeSOPR_kE_SingleFeedbackEnergy_minVal: category=VALUE, type=Float
      KeSOPR_kE_TotalChargeEnergy_MaxVal: category=VALUE, type=Float
      KeSOPR_kE_TotalChargeEnergy_minVal: category=VALUE, type=Float
      KeSOPR_kE_TotalDisChargeEnergy_MaxVal: category=VALUE, type=Float
      KeSOPR_kE_TotalDisChargeEnergy_minVal: category=VALUE, type=Float
      KeSOPR_kE_TotalFeedbackEnergy_MaxVal: category=VALUE, type=Float
      KeSOPR_kE_TotalFeedbackEnergy_minVal: category=VALUE, type=Float
      KeSOPR_kP_ChrgPwrLmtInst_Val: category=VALUE, type=Float
      KeSOPR_kP_ChrgPwrLmt_MaxVal: category=VALUE, type=Float
      KeSOPR_kP_ChrgPwrLmt_Val: category=VALUE, type=Float
      KeSOPR_kP_ChrgPwrLmt_minVal: category=VALUE, type=Float
      KeSOPR_kP_DschgPwrLmtInst_Val: category=VALUE, type=Float
      KeSOPR_kP_DschgPwrLmt_MaxVal: category=VALUE, type=Float
      KeSOPR_kP_DschgPwrLmt_Val: category=VALUE, type=Float
      KeSOPR_kP_DschgPwrLmt_minVal: category=VALUE, type=Float
      KeSOPR_kP_LimitedSOP_Value: category=VALUE, type=Float
      KeSOPR_kP_OverPower_Reset: category=VALUE, type=Float
      KeSOPR_kP_OverPower_Set: category=VALUE, type=Float
      KeSOPR_kP_PackInstantOutPower_Val: category=VALUE, type=Float
      KeSOPR_kP_PackInstantRecoveryPower_Val: category=VALUE, type=Float
      KeSOPR_kP_PackRealTimePower_Val: category=VALUE, type=Float
      KeSOPR_kP_SlewRateLimitPer20ms: category=VALUE, type=Float
      KeSOPR_k_CoefRatedPower{1..3}_Set: category=VALUE, type=Float
      KeSOPR_k_CoefRatedPower_Reset: category=VALUE, type=Float
      KeSOPR_t_DTCTimer1_Set: category=VALUE, type=Float
      KeSOPR_t_DTCTimer2_Set: category=VALUE, type=Float
      KeSOPR_t_DTCTimer_Reset: category=VALUE, type=Float
      KeSOPR_t_DelayDischarge10Kw: category=VALUE, type=Float
      KeSOPR_t_SR_SOPR: category=VALUE, type=Float
      KeSOPR_b_ChrgCurLmt_Ctrl: category=BOOLEAN, type=Boolean
      KeSOPR_b_ChrgPwrLmtInst_Ctrl: category=BOOLEAN, type=Boolean
      KeSOPR_b_ChrgPwrLmt_Ctrl: category=BOOLEAN, type=Boolean
      KeSOPR_b_DschgCurLmt_Ctrl: category=BOOLEAN, type=Boolean
      KeSOPR_b_DschgPwrLmtInst_Ctrl: category=BOOLEAN, type=Boolean
      KeSOPR_b_DschgPwrLmt_Ctrl: category=BOOLEAN, type=Boolean
      KeSOPR_b_OvrdCond_SingleChargeEnergy: category=BOOLEAN, type=Boolean
      KeSOPR_b_OvrdCond_SingleDisChargeEnergy: category=BOOLEAN, type=Boolean
      KeSOPR_b_OvrdCond_SingleFeedbackEnergy: category=BOOLEAN, type=Boolean
      KeSOPR_b_OvrdCond_TotalChargeEnergy: category=BOOLEAN, type=Boolean
      KeSOPR_b_OvrdCond_TotalDisChargeEnergy: category=BOOLEAN, type=Boolean
      KeSOPR_b_OvrdCond_TotalFeedbackEnergy: category=BOOLEAN, type=Boolean
      KeSOPR_b_PackInstantOutPower_Ctrl: category=BOOLEAN, type=Boolean
      KeSOPR_b_PackInstantRecoveryPower_Ctrl: category=BOOLEAN, type=Boolean
      KeSOPR_b_PackOverChrgPower{1..3}_flt_En: category=BOOLEAN, type=Boolean
      KeSOPR_b_PackOverChrgPower_Rank_CAN_En: category=BOOLEAN, type=Boolean
      KeSOPR_b_PackOverDchrgPower{1..3}_flt_En: category=BOOLEAN, type=Boolean
      KeSOPR_b_PackOverDchrgPower_Rank_CAN_En: category=BOOLEAN, type=Boolean
      KeSOPR_b_PackRealTimePower_Ctrl: category=BOOLEAN, type=Boolean
      KeSOPR_k_PackOverChrgPower{1..3}_flt_Val: category=VALUE, type=UInt8
      KeSOPR_k_PackOverChrgPower_Rank_CAN_Val: category=VALUE, type=UInt8
      KeSOPR_k_PackOverDchrgPower{1..3}_flt_Val: category=VALUE, type=UInt8
      KeSOPR_k_PackOverDchrgPower_Rank_CAN_Val: category=VALUE, type=UInt8
package /SOPR_Code_pkg/SOPR_Code_if
  39 x sender receiver interface:
    VeSOPR_kP_ChrgPwrLmt
      data VeSOPR_kP_ChrgPwrLmt: category=VALUE, sw-calibration-access=READ-ONLY, type=Float
    VeSOPR_kP_DschgPwrLmt
      data VeSOPR_kP_DschgPwrLmt: category=VALUE, sw-calibration-access=READ-ONLY, type=Float
    VeSOPR_kP_ChrgPwrLmtInst
      data VeSOPR_kP_ChrgPwrLmtInst: category=VALUE, sw-calibration-access=READ-ONLY, type=Float
    VeSOPR_kP_DschgPwrLmtInst
      data VeSOPR_kP_DschgPwrLmtInst: category=VALUE, sw-calibration-access=READ-ONLY, type=Float
    VeSOPR_k_PackOverDchrgPower1_flt
      data VeSOPR_k_PackOverDchrgPower1_flt: category=VALUE, sw-calibration-access=READ-ONLY, type=UInt8
    VeSOPR_k_PackOverDchrgPower2_flt
      data VeSOPR_k_PackOverDchrgPower2_flt: category=VALUE, sw-calibration-access=READ-ONLY, type=UInt8
    VeSOPR_k_PackOverDchrgPower3_flt
      data VeSOPR_k_PackOverDchrgPower3_flt: category=VALUE, sw-calibration-access=READ-ONLY, type=UInt8
    VeSOPR_k_PackOverChrgPower1_flt
      data VeSOPR_k_PackOverChrgPower1_flt: category=VALUE, sw-calibration-access=READ-ONLY, type=UInt8
    VeSOPR_k_PackOverChrgPower2_flt
      data VeSOPR_k_PackOverChrgPower2_flt: category=VALUE, sw-calibration-access=READ-ONLY, type=UInt8
    VeSOPR_k_PackOverChrgPower3_flt
      data VeSOPR_k_PackOverChrgPower3_flt: category=VALUE, sw-calibration-access=READ-ONLY, type=UInt8
    VeSOPR_k_PackOverDchrgPower_Rank_CAN
      data VeSOPR_k_PackOverDchrgPower_Rank_CAN: category=VALUE, sw-calibration-access=READ-ONLY, type=UInt8
    VeSOPR_k_PackOverChrgPower_Rank_CAN
      data VeSOPR_k_PackOverChrgPower_Rank_CAN: category=VALUE, sw-calibration-access=READ-ONLY, type=UInt8
    VeSOPR_I_DschgCurLmt
      data VeSOPR_I_DschgCurLmt: category=VALUE, sw-calibration-access=READ-ONLY, type=Float
    VeSOPR_I_ChrgCurLmt
      data VeSOPR_I_ChrgCurLmt: category=VALUE, sw-calibration-access=READ-ONLY, type=Float
    VeSOPR_kP_PackInstantOutPower
      data VeSOPR_kP_PackInstantOutPower: category=VALUE, sw-calibration-access=READ-ONLY, type=Float
    VeSOPR_kP_PackInstantRecoveryPower
      data VeSOPR_kP_PackInstantRecoveryPower: category=VALUE, sw-calibration-access=READ-ONLY, type=Float
    VeSOPR_kE_SingleChargeEnergy
      data VeSOPR_kE_SingleChargeEnergy: category=VALUE, sw-calibration-access=READ-ONLY, type=Float
    VeSOPR_kE_TotalChargeEnergy
      data VeSOPR_kE_TotalChargeEnergy: category=VALUE, sw-calibration-access=READ-ONLY, type=Float
    VeSOPR_kE_SingleDisChargeEnergy
      data VeSOPR_kE_SingleDisChargeEnergy: category=VALUE, sw-calibration-access=READ-ONLY, type=Float
    VeSOPR_kE_TotalDisChargeEnergy
      data VeSOPR_kE_TotalDisChargeEnergy: category=VALUE, sw-calibration-access=READ-ONLY, type=Float
    VeSOPR_kE_SingleFeedbackEnergy
      data VeSOPR_kE_SingleFeedbackEnergy: category=VALUE, sw-calibration-access=READ-ONLY, type=Float
    VeSOPR_kE_TotalFeedbackEnergy
      data VeSOPR_kE_TotalFeedbackEnergy: category=VALUE, sw-calibration-access=READ-ONLY, type=Float
    VeSOPR_kP_PackRealTimePower
      data VeSOPR_kP_PackRealTimePower: category=VALUE, sw-calibration-access=READ-ONLY, type=Float
    VeSOCR_Pct_DisplayPackSOC
      data VeSOCR_Pct_DisplayPackSOC: category=VALUE, type=Float
    VeDHSR_r_RegenSOPFactor
      data VeDHSR_r_RegenSOPFactor: category=VALUE, type=Float
    VeDHSR_r_DischSOPFactor
      data VeDHSR_r_DischSOPFactor: category=VALUE, type=Float
    VeDHSR_b_Discharge10Kw
      data VeDHSR_b_Discharge10Kw: category=BOOLEAN, type=Boolean
    VeCSCR_T_MaxCellTempMod
      data VeCSCR_T_MaxCellTempMod: category=VALUE, type=Float
    VeCSCR_T_MinCellTempMod
      data VeCSCR_T_MinCellTempMod: category=VALUE, type=Float
    VeVSDR_I_HVCurrent
      data VeVSDR_I_HVCurrent: category=VALUE, type=Float
    VeVSDR_U_HighVoltage
      data VeVSDR_U_HighVoltage: category=VALUE, type=Float
    VeLLSR_b_ClearDTC
      data VeLLSR_b_ClearDTC: category=BOOLEAN, type=Boolean
    VeVSDR_e_CurrentFlowState
      data VeVSDR_e_CurrentFlowState: category=VALUE, type=TeVSDR_e_CurrentFlowState
    VeHVSR_e_StateMode
      data VeHVSR_e_StateMode: category=VALUE, type=TeHVSR_e_StateMode
    VeLLSR_b_IntEEP_Invalid
      data VeLLSR_b_IntEEP_Invalid: category=BOOLEAN, type=Boolean
    VeLLSR_b_ExtEEP_Invalid
      data VeLLSR_b_ExtEEP_Invalid: category=BOOLEAN, type=Boolean
    VeLLSR_kE_TotalChargeEnergyExt
      data VeLLSR_kE_TotalChargeEnergyExt: category=VALUE, type=Float
    VeLLSR_kE_TotalDisChargeEnergyExt
      data VeLLSR_kE_TotalDisChargeEnergyExt: category=VALUE, type=Float
    VeLLSR_kE_TotalFeedbackEnergyExt
      data VeLLSR_kE_TotalFeedbackEnergyExt: category=VALUE, type=Float
