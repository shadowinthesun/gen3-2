AUTOSAR XML (schema 4-0-3)
package /HMIR_Code_pkg/HMIR_Code_imp
  swc implementation HMIR_Code: programming-language=C, sw-version=1.294.1, used-code-generator=Embedded Coder 7.2 (R2019a) 23-Nov-2018, vendor-id=0, behavior=HMIR_Code
    code-descriptors:
      code Code
        artifact-descriptors:
          short-label=HMIR_Code_c, category=SWSRC
          short-label=ASW_Types_h, category=SWHDR
          short-label=HMIR_Code_h, category=SWHDR
          short-label=HMIR_Code_private_h, category=SWHDR
          short-label=HMIR_Code_types_h, category=SWHDR
          short-label=rtwtypes_h, category=SWHDR
    resource consumption RsrcCons_HMIR_Code
