AUTOSAR XML (schema 4-0-3)
package /SOHR_Code_datatype_AVS_pkg
  constant specification KtSOHR_r_SOHCoefficient_Table_AVS: value-spec=[1, 0.98000001907348633, 0.949999988079071, 0.89999997615814209, 0.85000002384185791, 0.800000011920929]
  constant specification KxSOHR_r_SOHCoefficient_AVS: value-spec=[0, 18340, 35850, 70730, 93650, 104950]
  constant specification mapping set SOHR_Code_datatype_AVS_MappingSet
    mappings:
      appl-constant=KtSOHR_r_SOHCoefficient_Table, impl-constant=KtSOHR_r_SOHCoefficient_Table_AVS
      appl-constant=KxSOHR_r_SOHCoefficient, impl-constant=KxSOHR_r_SOHCoefficient_AVS
