AUTOSAR XML (schema 4-0-3)
package /SOCR_Code_datatype_AVS_pkg
  4 x constant specification:
    KtSOCR_U_SOCOCV_DE_Table_AVS: value-spec=[3.0529999732971191, 3.06030011177063, 3.0676000118255615, 3.0748999118804932, 3.0822000503540039, 3.0894999504089355, 3.0968000888824463, 3.1040999889373779, 3.1113998889923096, 3.1187000274658203, 3.125999927520752, 3.2355000972747803, 3.4179999828338623, 3.4670000076293945, 3.5160000324249268, 3.5555000305175781, 3.5950000286102295, 3.6159999370574951, 3.63700008392334, 3.6654999256134033, 3.6940000057220459, 3.7455000877380371, 3.7969999313354492, 3.8450000286102295, 3.8929998874664307, 3.9414999485015869, 3.9900000095367432, 4.0390000343322754, 4.0879998207092285, 4.1579999923706055, 4.2280001640319824]
    KtSOCR_U_vMinBasedOnTemp_DE_Table_AVS: value-spec=[3.0399999618530273, 3.2699999809265137, 3.2699999809265137, 3.3199999332427979, 3.3199999332427979, 3.3499999046325684]
    KxSOCR_U_SOCOCV_DE_AVS: value-spec=[0, 0.20000000298023224, 0.40000000596046448, 0.60000002384185791, 0.800000011920929, 1, 1.2000000476837158, 1.3999999761581421, 1.6000000238418579, 1.7999999523162842, 2, 5, 10, 15, 20, 25, 30, 35, 40, 45, 50, 55, 60, 65, 70, 75, 80, 85, 90, 95, 100]
    KxSOCR_U_vMinBasedOnTemp_DE_AVS: value-spec=[-30, -0.0010000000474974513, 0, 9.99899959564209, 10, 55]
  constant specification mapping set SOCR_Code_datatype_AVS_MappingSet
    mappings:
      appl-constant=KtSOCR_U_SOCOCV_DE_Table, impl-constant=KtSOCR_U_SOCOCV_DE_Table_AVS
      appl-constant=KtSOCR_U_vMinBasedOnTemp_DE_Table, impl-constant=KtSOCR_U_vMinBasedOnTemp_DE_Table_AVS
      appl-constant=KxSOCR_U_SOCOCV_DE, impl-constant=KxSOCR_U_SOCOCV_DE_AVS
      appl-constant=KxSOCR_U_vMinBasedOnTemp_DE, impl-constant=KxSOCR_U_vMinBasedOnTemp_DE_AVS
