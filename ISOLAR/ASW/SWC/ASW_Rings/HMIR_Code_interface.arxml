AUTOSAR XML (schema 4-0-3)
package /CalibrationComponents
  parameter interface HMIR_if
    33 x parameter data prototype, all with sw-calibration-access=READ-WRITE:
      KeHMIR_Ah_BattRatedCap: category=VALUE, type=Float
      KeHMIR_Ah_CellCapacity: category=VALUE, type=Float
      KeHMIR_I_MaxChargeCur: category=VALUE, type=Float
      KeHMIR_Pct_PackSocDashHundred: category=VALUE, type=Float
      KeHMIR_Pct_PackSocDashZero: category=VALUE, type=Float
      KeHMIR_U_BattRatedVoltageValue: category=VALUE, type=Float
      KeHMIR_U_CellDischCutVoltage: category=VALUE, type=Float
      KeHMIR_U_MaxChargeVol: category=VALUE, type=Float
      KeHMIR_U_MinChargeVol: category=VALUE, type=Float
      KeHMIR_kE_BattRatedEnergyValue: category=VALUE, type=Float
      KeHMIR_kl_ElectricRangeDTE_Value: category=VALUE, type=Float
      KeHMIR_kl_TotalDrivenBatOvrdVal: category=VALUE, type=Float
      KeHMIR_k_PRTVer: category=VALUE, type=UInt32
      KeHMIR_b_TotalDrivenBatOvrd: category=BOOLEAN, type=Boolean
      KeHMIR_k_BattManucCodeVal: category=VALUE, type=UInt8
      KeHMIR_k_BattNum: category=VALUE, type=UInt8
      KeHMIR_k_BattPackParallel: category=VALUE, type=UInt8
      KeHMIR_k_BattPackSerial: category=VALUE, type=UInt8
      KeHMIR_k_BattSum: category=VALUE, type=UInt8
      KeHMIR_k_BattTypeValue: category=VALUE, type=UInt8
      KeHMIR_k_CellNum: category=VALUE, type=UInt8
      KeHMIR_k_CodeL: category=VALUE, type=UInt8
      KeHMIR_k_FaultSum: category=VALUE, type=UInt8
      KeHMIR_k_HWVer: category=VALUE, type=UInt8
      KeHMIR_k_MaxCellIndex: category=VALUE, type=UInt8
      KeHMIR_k_MaxTNumPack: category=VALUE, type=UInt8
      KeHMIR_k_MaxTempIndex: category=VALUE, type=UInt8
      KeHMIR_k_MaxVNumPack: category=VALUE, type=UInt8
      KeHMIR_k_MinCellIndex: category=VALUE, type=UInt8
      KeHMIR_k_MinTNumPack: category=VALUE, type=UInt8
      KeHMIR_k_MinTempIndex: category=VALUE, type=UInt8
      KeHMIR_k_MinVNumPack: category=VALUE, type=UInt8
      KeHMIR_k_TempNum: category=VALUE, type=UInt8
package /HMIR_Code_pkg/HMIR_Code_if
  38 x sender receiver interface:
    VeHMIR_kl_ElectricRangeDTE
      data VeHMIR_kl_ElectricRangeDTE: category=VALUE, sw-calibration-access=READ-ONLY, type=Float
    VeHMIR_k_BattType
      data VeHMIR_k_BattType: category=VALUE, sw-calibration-access=READ-ONLY, type=UInt8
    VeHMIR_U_BattRatedVoltage
      data VeHMIR_U_BattRatedVoltage: category=VALUE, sw-calibration-access=READ-ONLY, type=Float
    VeHMIR_kE_BattRatedEnergy
      data VeHMIR_kE_BattRatedEnergy: category=VALUE, sw-calibration-access=READ-ONLY, type=Float
    VeHMIR_k_BattManucCode
      data VeHMIR_k_BattManucCode: category=VALUE, sw-calibration-access=READ-ONLY, type=UInt8
    VeHMIR_kl_TotalDrivenBat
      data VeHMIR_kl_TotalDrivenBat: category=VALUE, sw-calibration-access=READ-ONLY, type=Float
    VeHMIR_Pct_BatteryPackSOC
      data VeHMIR_Pct_BatteryPackSOC: category=VALUE, sw-calibration-access=READ-ONLY, type=Float
    VeHMIR_Ah_CellCapacity
      data VeHMIR_Ah_CellCapacity: category=VALUE, sw-calibration-access=READ-ONLY, type=Float
    VeHMIR_U_CellDischCutVoltage
      data VeHMIR_U_CellDischCutVoltage: category=VALUE, sw-calibration-access=READ-ONLY, type=Float
    VeHMIR_k_BattPackParallel
      data VeHMIR_k_BattPackParallel: category=VALUE, sw-calibration-access=READ-ONLY, type=UInt8
    VeHMIR_k_BattPackSerial
      data VeHMIR_k_BattPackSerial: category=VALUE, sw-calibration-access=READ-ONLY, type=UInt8
    VeHMIR_Ah_BattRatedCap
      data VeHMIR_Ah_BattRatedCap: category=VALUE, sw-calibration-access=READ-ONLY, type=Float
    VeHMIR_k_TempNum
      data VeHMIR_k_TempNum: category=VALUE, sw-calibration-access=READ-ONLY, type=UInt8
    VeHMIR_k_CellNum
      data VeHMIR_k_CellNum: category=VALUE, sw-calibration-access=READ-ONLY, type=UInt8
    VeHMIR_k_HWVer
      data VeHMIR_k_HWVer: category=VALUE, sw-calibration-access=READ-ONLY, type=UInt8
    VeHMIR_k_PRTVer
      data VeHMIR_k_PRTVer: category=VALUE, sw-calibration-access=READ-ONLY, type=UInt32
    VeHMIR_k_CodeL
      data VeHMIR_k_CodeL: category=VALUE, sw-calibration-access=READ-ONLY, type=UInt8
    VeHMIR_k_FaultSum
      data VeHMIR_k_FaultSum: category=VALUE, sw-calibration-access=READ-ONLY, type=UInt8
    VeHMIR_k_BattNum
      data VeHMIR_k_BattNum: category=VALUE, sw-calibration-access=READ-ONLY, type=UInt8
    VeHMIR_k_BattSum
      data VeHMIR_k_BattSum: category=VALUE, sw-calibration-access=READ-ONLY, type=UInt8
    VeHMIR_k_MaxCellIndex
      data VeHMIR_k_MaxCellIndex: category=VALUE, sw-calibration-access=READ-ONLY, type=UInt8
    VeHMIR_k_MinCellIndex
      data VeHMIR_k_MinCellIndex: category=VALUE, sw-calibration-access=READ-ONLY, type=UInt8
    VeHMIR_k_MaxTempIndex
      data VeHMIR_k_MaxTempIndex: category=VALUE, sw-calibration-access=READ-ONLY, type=UInt8
    VeHMIR_k_MinTempIndex
      data VeHMIR_k_MinTempIndex: category=VALUE, sw-calibration-access=READ-ONLY, type=UInt8
    VeHMIR_k_MaxVNumPack
      data VeHMIR_k_MaxVNumPack: category=VALUE, sw-calibration-access=READ-ONLY, type=UInt8
    VeHMIR_k_MinTNumPack
      data VeHMIR_k_MinTNumPack: category=VALUE, sw-calibration-access=READ-ONLY, type=UInt8
    VeHMIR_k_MinVNumPack
      data VeHMIR_k_MinVNumPack: category=VALUE, sw-calibration-access=READ-ONLY, type=UInt8
    VeHMIR_k_MaxTNumPack
      data VeHMIR_k_MaxTNumPack: category=VALUE, sw-calibration-access=READ-ONLY, type=UInt8
    VeHMIR_I_MaxChargeCur
      data VeHMIR_I_MaxChargeCur: category=VALUE, sw-calibration-access=READ-ONLY, type=Float
    VeHMIR_U_MaxChargeVol
      data VeHMIR_U_MaxChargeVol: category=VALUE, sw-calibration-access=READ-ONLY, type=Float
    VeHMIR_U_MinChargeVol
      data VeHMIR_U_MinChargeVol: category=VALUE, sw-calibration-access=READ-ONLY, type=Float
    VeSOCR_Pct_DisplayPackSOC
      data VeSOCR_Pct_DisplayPackSOC: category=VALUE, type=Float
    VeLLSR_PPort_Hardware_ResetReason
      data VeLLSR_PPort_Hardware_ResetReason: category=VALUE, type=Float
    VeLLSR_PPort_MaxCPU
      data VeLLSR_PPort_MaxCPU: category=VALUE, type=Float
    VeLLSR_PPort_MinCPU
      data VeLLSR_PPort_MinCPU: category=VALUE, type=Float
    VeLLSR_PPort_Software_ResetReason
      data VeLLSR_PPort_Software_ResetReason: category=VALUE, type=Float
    VeLLSR_PPort_User_Stack
      data VeLLSR_PPort_User_Stack: category=VALUE, type=Float
    VeLLSR_PPort_CSA_Stack
      data VeLLSR_PPort_CSA_Stack: category=VALUE, type=Float
