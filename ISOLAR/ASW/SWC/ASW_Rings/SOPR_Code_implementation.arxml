AUTOSAR XML (schema 4-0-3)
package /SOPR_Code_pkg/SOPR_Code_imp
  swc implementation SOPR_Code: programming-language=C, sw-version=1.295.1, used-code-generator=Embedded Coder 7.2 (R2019a) 23-Nov-2018, vendor-id=0, behavior=SOPR_Code
    code-descriptors:
      code Code
        artifact-descriptors:
          short-label=SOPR_Code_c, category=SWSRC
          short-label=SOPR_Code_data_c, category=SWSRC
          short-label=ref_DTC_c, category=SWSRC
          short-label=ASW_Types_h, category=SWHDR
          short-label=SOPR_Code_h, category=SWHDR
          short-label=SOPR_Code_private_h, category=SWHDR
          short-label=SOPR_Code_types_h, category=SWHDR
          short-label=ref_DTC_h, category=SWHDR
          short-label=ref_DTC_private_h, category=SWHDR
          short-label=ref_DTC_types_h, category=SWHDR
          short-label=rtwtypes_h, category=SWHDR
          short-label=tmwtypes_h, category=SWHDR
    resource consumption RsrcCons_SOPR_Code
