AUTOSAR XML (schema 4-0-3)
package /SOER_Code_datatype_AVS_pkg
  constant specification KtSOER_kE_AvailableEnergy_Table_AVS: value-spec=[14.145000457763672, 15.767999649047852, 16.642999649047852, 17.049999237060547, 17.461000442504883, 17.9060001373291, 18.356000900268555, 18.687000274658203, 19.354999542236328, 19.88800048828125, 20.273000717163086, 20.340000152587891, 20.408000946044922]
  constant specification KxSOER_kE_AvailableEnergy_AVS: value-spec=[-30, -20, -15, -10, -5, 0, 5, 10, 15, 25, 45, 50, 55]
  constant specification mapping set SOER_Code_datatype_AVS_MappingSet
    mappings:
      appl-constant=KtSOER_kE_AvailableEnergy_Table, impl-constant=KtSOER_kE_AvailableEnergy_Table_AVS
      appl-constant=KxSOER_kE_AvailableEnergy, impl-constant=KxSOER_kE_AvailableEnergy_AVS
