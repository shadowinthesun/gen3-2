AUTOSAR XML (schema 4-0-3)
package /CalibrationComponents
  parameter interface VSDR_if
    81 x parameter data prototype, all with sw-calibration-access=READ-WRITE:
      KaVSDR_I_OvrdValue_HallSensorCalOffSet: category=ARRAY, type=rt_Array_Float_2
      KeVSDR_Cnt_MaxSamplesForCurrOffset: category=VALUE, type=Float
      KeVSDR_I_HVOverCurrentThresh: category=VALUE, type=Float
      KeVSDR_I_HallBoundaryLarge: category=VALUE, type=Float
      KeVSDR_I_HallBoundaryLargeCritical: category=VALUE, type=Float
      KeVSDR_I_HallBoundarySmall: category=VALUE, type=Float
      KeVSDR_I_HallCurrent_MaxVal: category=VALUE, type=Float
      KeVSDR_I_HallCurrent_minVal: category=VALUE, type=Float
      KeVSDR_I_HallLargeVolatility: category=VALUE, type=Float
      KeVSDR_I_HallSmallVolatility: category=VALUE, type=Float
      KeVSDR_I_NegCurrentThreshold: category=VALUE, type=Float
      KeVSDR_I_OffsetCurrCAB500Val: category=VALUE, type=Float
      KeVSDR_I_OvrdValue_HallCurrent: category=VALUE, type=Float
      KeVSDR_I_OvrdValue_HallCurrentUnfiltered: category=VALUE, type=Float
      KeVSDR_I_OvrdValue_HallCurrent_Vehicle: category=VALUE, type=Float
      KeVSDR_I_PlausibilityThrshCAB500: category=VALUE, type=Float
      KeVSDR_I_PlausibilityThrshCAB500High: category=VALUE, type=Float
      KeVSDR_I_PlausibilityThrshCAB500Low: category=VALUE, type=Float
      KeVSDR_I_PlausibilityThrshHallSnsCh1: category=VALUE, type=Float
      KeVSDR_I_PlausibilityThrshHallSnsCh2: category=VALUE, type=Float
      KeVSDR_I_PosCurrentThreshold: category=VALUE, type=Float
      KeVSDR_U_OvrdValBusVoltage: category=VALUE, type=Float
      KeVSDR_U_OvrdValue_HighVoltage: category=VALUE, type=Float
      KeVSDR_U_ThrshldDiffVoltPackVmcur: category=VALUE, type=Float
      KeVSDR_U_ThrshldDiffVoltPackVmcur_Pass: category=VALUE, type=Float
      KeVSDR_U_ThrshldDiffVoltSumCellLink: category=VALUE, type=Float
      KeVSDR_U_ThrshldDiffVoltSumCellLink_Pass: category=VALUE, type=Float
      KeVSDR_U_ThrshldDiffVoltSumCellPack: category=VALUE, type=Float
      KeVSDR_U_ThrshldDiffVoltSumCellPack_Pass: category=VALUE, type=Float
      KeVSDR_k_HallLargeFilterSecondD: category=VALUE, type=Float
      KeVSDR_k_HallLargeFltrCoef: category=VALUE, type=Float
      KeVSDR_k_HallSmallFilterSecondD: category=VALUE, type=Float
      KeVSDR_k_HallSmallFltrCoef: category=VALUE, type=Float
      KeVSDR_k_OvrdValue_HallLargeFilter: category=VALUE, type=Float
      KeVSDR_k_OvrdValue_HallSmallFilter: category=VALUE, type=Float
      KeVSDR_q_AccuChgCoulombs_Val: category=VALUE, type=Float
      KeVSDR_q_OvrdValue_AccuCoulombs: category=VALUE, type=Float
      KeVSDR_t_DbncCurrentCloseToZero: category=VALUE, type=Float
      KeVSDR_t_DbncCurrentGreaterThanZero: category=VALUE, type=Float
      KeVSDR_t_DbncCurrentLessThanZero: category=VALUE, type=Float
      KeVSDR_t_DbncHVOverCurrent_flt: category=VALUE, type=Float
      KeVSDR_t_DbncLinkVoltageInRange_flt: category=VALUE, type=Float
      KeVSDR_t_DbncPackVoltageInRange_flt: category=VALUE, type=Float
      KeVSDR_t_Debc_HallBadSignalLarge: category=VALUE, type=Float
      KeVSDR_t_Debc_HallBadSignalSmall: category=VALUE, type=Float
      KeVSDR_t_Debc_HallBoundaryLargeDown: category=VALUE, type=Float
      KeVSDR_t_Debc_HallBoundaryLargeUp: category=VALUE, type=Float
      KeVSDR_t_Debc_HallBoundarySmall: category=VALUE, type=Float
      KeVSDR_t_Debc_HallBoundarySmallDown: category=VALUE, type=Float
      KeVSDR_t_Debc_HallBoundarySmallUp: category=VALUE, type=Float
      KeVSDR_t_HallLargeFilterSecondT: category=VALUE, type=Float
      KeVSDR_t_HallSmallFilterSecondT: category=VALUE, type=Float
      KeVSDR_t_SR_VSDR: category=VALUE, type=Float
      KeVSDR_Cnt_HallBoundarySmall: category=VALUE, type=UInt16
      KeVSDR_e_StateModeStandBy: category=VALUE, type=TeHVSR_e_StateMode
      KeVSDR_e_CurrentFlowStateOvrdVal: category=VALUE, type=TeVSDR_e_CurrentFlowState
      KeVSDR_b_AccuChgCoulombs_Ctrl: category=BOOLEAN, type=Boolean
      KeVSDR_b_CurrSnsCAB500Plausibilty_flt_Ctrl: category=BOOLEAN, type=Boolean
      KeVSDR_b_CurrentFlowStateOvrdCtrl: category=BOOLEAN, type=Boolean
      KeVSDR_b_HallSignal12: category=BOOLEAN, type=Boolean
      KeVSDR_b_HallSnsPlausibiltyCh1FaultOrvd: category=BOOLEAN, type=Boolean
      KeVSDR_b_HallSnsPlausibiltyCh1FaultOrvdCtrl: category=BOOLEAN, type=Boolean
      KeVSDR_b_HallSnsPlausibiltyCh2FaultOrvd: category=BOOLEAN, type=Boolean
      KeVSDR_b_HallSnsPlausibiltyCh2FaultOrvdCtrl: category=BOOLEAN, type=Boolean
      KeVSDR_b_LinkVoltageInRange_flt_Ctrl: category=BOOLEAN, type=Boolean
      KeVSDR_b_OffsetCurrCAB500Ctrl: category=BOOLEAN, type=Boolean
      KeVSDR_b_OvrdCond_AccuCoulombs: category=BOOLEAN, type=Boolean
      KeVSDR_b_OvrdCond_HallCurrent: category=BOOLEAN, type=Boolean
      KeVSDR_b_OvrdCond_HallCurrentUnfiltered: category=BOOLEAN, type=Boolean
      KeVSDR_b_OvrdCond_HallCurrent_Vehicle: category=BOOLEAN, type=Boolean
      KeVSDR_b_OvrdCond_HallLargeFilter: category=BOOLEAN, type=Boolean
      KeVSDR_b_OvrdCond_HallSensorCalOffSet: category=BOOLEAN, type=Boolean
      KeVSDR_b_OvrdCond_HallSmallFilter: category=BOOLEAN, type=Boolean
      KeVSDR_b_OvrdCond_HighVoltage: category=BOOLEAN, type=Boolean
      KeVSDR_b_OvrdCtrlBusVoltage: category=BOOLEAN, type=Boolean
      KeVSDR_b_PackVoltageInRange_flt_Ctrl: category=BOOLEAN, type=Boolean
      KeVSDR_k_CurrSnsCAB500Plausibilty_flt_Val: category=VALUE, type=UInt8
      KeVSDR_k_LinkVoltageInRange_flt_Val: category=VALUE, type=UInt8
      KeVSDR_k_PackVoltageInRange_flt_Val: category=VALUE, type=UInt8
      KeVSDR_k_SnsTypeCAB500: category=VALUE, type=UInt8
      KeVSDR_k_SnsTypeDHAB_S124: category=VALUE, type=UInt8
package /VSDR_Code_pkg/VSDR_Code_if
  44 x sender receiver interface:
    VeVSDR_U_HighVoltage
      data VeVSDR_U_HighVoltage: category=VALUE, sw-calibration-access=READ-ONLY, type=Float
    VeVSDR_I_HVCurrent
      data VeVSDR_I_HVCurrent: category=VALUE, sw-calibration-access=READ-ONLY, type=Float
    VeVSDR_q_AccuCoulombs
      data VeVSDR_q_AccuCoulombs: category=VALUE, sw-calibration-access=READ-ONLY, type=Float
    VeVSDR_b_HallSnsPlausibiltyCh1_flt
      data VeVSDR_b_HallSnsPlausibiltyCh1_flt: category=BOOLEAN, sw-calibration-access=READ-ONLY, type=Boolean
    VeVSDR_b_HallSnsPlausibiltyCh2_flt
      data VeVSDR_b_HallSnsPlausibiltyCh2_flt: category=BOOLEAN, sw-calibration-access=READ-ONLY, type=Boolean
    VeVSDR_e_CurrentFlowState
      data VeVSDR_e_CurrentFlowState: category=VALUE, sw-calibration-access=READ-ONLY, type=TeVSDR_e_CurrentFlowState
    VeVSDR_k_PackVoltageInRange_flt
      data VeVSDR_k_PackVoltageInRange_flt: category=VALUE, sw-calibration-access=READ-ONLY, type=UInt8
    VeVSDR_k_LinkVoltageInRange_flt
      data VeVSDR_k_LinkVoltageInRange_flt: category=VALUE, sw-calibration-access=READ-ONLY, type=UInt8
    VeVSDR_k_CurrSnsCAB500Plausibilty_flt
      data VeVSDR_k_CurrSnsCAB500Plausibilty_flt: category=VALUE, sw-calibration-access=READ-ONLY, type=UInt8
    VeVSDR_q_AccuChgCoulombs
      data VeVSDR_q_AccuChgCoulombs: category=VALUE, sw-calibration-access=READ-ONLY, type=Float
    VeVSDR_k_VoltMCURInRange_flt
      data VeVSDR_k_VoltMCURInRange_flt: category=VALUE, sw-calibration-access=READ-ONLY, type=UInt8
    VeVSDR_k_HVOverCurrent_flt
      data VeVSDR_k_HVOverCurrent_flt: category=VALUE, sw-calibration-access=READ-ONLY, type=UInt8
    VeVSDR_I_HVHeatingCurrent
      data VeVSDR_I_HVHeatingCurrent: category=VALUE, sw-calibration-access=READ-ONLY, type=Float
    VeVSDR_k_VoltMCUFInRange_flt
      data VeVSDR_k_VoltMCUFInRange_flt: category=VALUE, sw-calibration-access=READ-ONLY, type=UInt8
    VeCSCR_U_PackVoltage_out
      data VeCSCR_U_PackVoltage_out: category=VALUE, type=Float
    VeCSCR_b_PackVoltageFltd
      data VeCSCR_b_PackVoltageFltd: category=BOOLEAN, type=Boolean
    VeCSCR_U_SumPackVoltageMod
      data VeCSCR_U_SumPackVoltageMod: category=VALUE, type=Float
    VaCSCR_b_CellVoltageArrayFaulted_out
      data VaCSCR_b_CellVoltageArrayFaulted_out: category=ARRAY, type=rt_Array_Boolean_96
    VeCSCR_U_SumStackVoltages
      data VeCSCR_U_SumStackVoltages: category=VALUE, type=Float
    VaCSCR_I_CellCurrentArray_out
      data VaCSCR_I_CellCurrentArray_out: category=ARRAY, type=rt_Array_Float_2
    VaCSCR_b_CellCurrentArrayFaulted_out
      data VaCSCR_b_CellCurrentArrayFaulted_out: category=ARRAY, type=rt_Array_Boolean_2
    VeCSCR_T_AvgCellTempMod
      data VeCSCR_T_AvgCellTempMod: category=VALUE, type=Float
    VeSOCR_b_AccuCoulombsReset
      data VeSOCR_b_AccuCoulombsReset: category=BOOLEAN, type=Boolean
    VeCANR_U_ActHVMotor
      data VeCANR_U_ActHVMotor: category=VALUE, type=Float
    VeHVSR_e_StateMode
      data VeHVSR_e_StateMode: category=VALUE, type=TeHVSR_e_StateMode
    VaCSCR_b_StackArrayFaulted_out
      data VaCSCR_b_StackArrayFaulted_out: category=ARRAY, type=rt_Array_Boolean_8
    VeCSCR_U_LinkP2PackVolt_out
      data VeCSCR_U_LinkP2PackVolt_out: category=VALUE, type=Float
    VeCFLR_b_EnblGPIOPos_drv
      data VeCFLR_b_EnblGPIOPos_drv: category=BOOLEAN, type=Boolean
    VeCFLR_b_EnblGPIONeg_drv
      data VeCFLR_b_EnblGPIONeg_drv: category=BOOLEAN, type=Boolean
    VeCSCR_I_HVCurrent
      data VeCSCR_I_HVCurrent: category=VALUE, type=Float
    VeCSCR_b_HVCurrentFaulted
      data VeCSCR_b_HVCurrentFaulted: category=BOOLEAN, type=Boolean
    VeCSCR_k_CurSensorType
      data VeCSCR_k_CurSensorType: category=VALUE, type=UInt8
    VeLLSR_b_ClearDTC
      data VeLLSR_b_ClearDTC: category=BOOLEAN, type=Boolean
    VeCANR_U_TMRVoltageHV_out
      data VeCANR_U_TMRVoltageHV_out: category=VALUE, type=Float
    VeCFLR_b_EnblGPIOHeat_drv
      data VeCFLR_b_EnblGPIOHeat_drv: category=BOOLEAN, type=Boolean
    VeCSCR_I_PackShuntCurrent
      data VeCSCR_I_PackShuntCurrent: category=VALUE, type=Float
    VeCSCR_b_PackShuntCurrentFaulted
      data VeCSCR_b_PackShuntCurrentFaulted: category=BOOLEAN, type=Boolean
    VeCANR_U_TMFUdcAct_out
      data VeCANR_U_TMFUdcAct_out: category=VALUE, type=Float
    VeCANR_U_ISGFUdcAct_out
      data VeCANR_U_ISGFUdcAct_out: category=VALUE, type=Float
    VeLLSR_k_KL30UnderVoltage_flt
      data VeLLSR_k_KL30UnderVoltage_flt: category=VALUE, type=UInt8
    VeLLSR_k_KL30OverVoltage_flt
      data VeLLSR_k_KL30OverVoltage_flt: category=VALUE, type=UInt8
    VeLLSR_k_TMFComLoss_flt
      data VeLLSR_k_TMFComLoss_flt: category=VALUE, type=UInt8
    VeLLSR_k_TMRComLoss_flt
      data VeLLSR_k_TMRComLoss_flt: category=VALUE, type=UInt8
    VeLLSR_k_ISGFComLoss_flt
      data VeLLSR_k_ISGFComLoss_flt: category=VALUE, type=UInt8
