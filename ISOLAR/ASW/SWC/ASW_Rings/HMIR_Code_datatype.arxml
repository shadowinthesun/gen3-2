AUTOSAR XML (schema 4-0-3)
standard types defined: Float, UInt8, UInt32, Boolean, float32, uint8, uint32, boolean
package /HMIR_Code_pkg/HMIR_Code_dt
  unit NoUnit: factor-si-to-unit=1, offset-si-to-unit=0
  impl type rt_Array_Float_11: category=ARRAY
    element rt_Array_Float_11: array-size=11, array-size-semantics=FIXED-SIZE, implementation-data-type=Float
package /HMIR_Code_pkg/HMIR_Code_dt/ApplDataTypes
  6 x app type, all with sw-calibration-access=READ-WRITE:
    Float: category=VALUE, compu {identical}, range phys -INF..INF
    UInt8: category=VALUE, compu {identical}, range phys 0..255
    UInt32: category=VALUE, compu {identical}, range phys 0..4294967295
    Appl_KtHMIR_kl_SOC2Range: category=CURVE, sw-calprm-axis-set={sw-axis-index=1, category=COM_AXIS, sw-axis-grouped=Appl_KtHMIR_kl_SOC2}, compu {identical}, range phys -1000000..1000000, sw-record-layout=Cur_f32
    Appl_KtHMIR_kl_SOC2: category=COM_AXIS, sw-calprm-axis-set={sw-axis-index=1, sw-axis-individual={input-variable-type=Float, compu {identical}, sw-max-axis-points=11, sw-min-axis-points=11, range phys -1000000..1000000}}, sw-record-layout=Distr_f32_M
    Boolean: category=BOOLEAN, compu {0=FALSE, 1=TRUE}
package /HMIR_Code_pkg/HMIR_Code_dt/ApplDataTypes/RecordLayouts
  sw record layout Cur_f32: sw-record-layout-group={short-label=Cur_f32, category=COLUMN_DIR, sw-record-layout-group-axis=0, sw-record-layout-group-index=X, sw-record-layout-group-from=1, sw-record-layout-group-to=-1, sw-record-layout-v={short-label=Val, base-type=float32, sw-record-layout-v-axis=0, sw-record-layout-v-prop=VALUE, sw-record-layout-v-index=X}}
  sw record layout Distr_f32_M: sw-record-layout-group={short-label=X, category=INDEX_INCR, sw-record-layout-group-axis=1, sw-record-layout-group-from=1, sw-record-layout-group-to=-1, sw-record-layout-v={short-label=VALUE, base-type=float32, sw-record-layout-v-axis=1, sw-record-layout-v-prop=VALUE}}
package /HMIR_Code_pkg/HMIR_Code_dt/DataTypeMappings
  data type mapping set HMIR_CodeDataTypeMappingsSet
    data-type-maps:
      application-data-type=Float, implementation-data-type=Float
      application-data-type=UInt8, implementation-data-type=UInt8
      application-data-type=UInt32, implementation-data-type=UInt32
      application-data-type=Appl_KtHMIR_kl_SOC2Range, implementation-data-type=rt_Array_Float_11
      application-data-type=Appl_KtHMIR_kl_SOC2, implementation-data-type=rt_Array_Float_11
      application-data-type=Boolean, implementation-data-type=Boolean
package /HMIR_Code_pkg/HMIR_Code_dt/Ground
  constant specification KtHMIR_kl_SOC2: value-spec=[5 10 20 30 40 50 60 70 80 90 100]
  constant specification KtHMIR_kl_SOC2Range: value-spec=[0 1 8 13 28 45 63 70 75 83 100]
package /HMIR_Code_pkg/HMIR_Code_dt/SwAddrMethods
  sw addr method CODE: section-type=CODE
  sw addr method CONST: section-type=CONST
  sw addr method VAR: section-type=VAR
