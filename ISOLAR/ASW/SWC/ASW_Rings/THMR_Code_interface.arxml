AUTOSAR XML (schema 4-0-3)
package /CalibrationComponents
  parameter interface THMR_if
    85 x parameter data prototype, all with sw-calibration-access=READ-WRITE:
      KeTHMR_I_HeatingOverCurrt_Val: category=VALUE, type=Float
      KeTHMR_T_ACChrgCoolReqInletTempThld: category=VALUE, type=Float
      KeTHMR_T_AlwPreHeatTempDiffThld: category=VALUE, type=Float
      KeTHMR_T_DefaultReqInletTempThld: category=VALUE, type=Float
      KeTHMR_T_DrvCoolFlowRateMaxTempT10: category=VALUE, type=Float
      KeTHMR_T_DrvCoolFlowRateMaxTempT12: category=VALUE, type=Float
      KeTHMR_T_DrvCoolInletTempThld{3..6}: category=VALUE, type=Float
      KeTHMR_T_ForbidPreHeatTempDiffThld: category=VALUE, type=Float
      KeTHMR_T_InACBalanceDeltaCellTemp: category=VALUE, type=Float
      KeTHMR_T_InACChrgCoolTempThld: category=VALUE, type=Float
      KeTHMR_T_InACChrgPreHeatTempThld: category=VALUE, type=Float
      KeTHMR_T_InDriveCoolTempThld: category=VALUE, type=Float
      KeTHMR_T_InDrvBalanceDeltaCellTemp: category=VALUE, type=Float
      KeTHMR_T_OutACBalanceDeltaCellTemp: category=VALUE, type=Float
      KeTHMR_T_OutACChrgBalanceMaxCellTemp: category=VALUE, type=Float
      KeTHMR_T_OutACChrgCoolTempThld: category=VALUE, type=Float
      KeTHMR_T_OutACChrgPreHeatTempThld: category=VALUE, type=Float
      KeTHMR_T_OutDriveCoolTempThld: category=VALUE, type=Float
      KeTHMR_T_OutDrvBalanceDeltaCellTemp: category=VALUE, type=Float
      KeTHMR_T_OutDrvBalanceMaxCellTemp: category=VALUE, type=Float
      KeTHMR_T_TargetInletWaterTemp_Val: category=VALUE, type=Float
      KeTHMR_T_TempRiseFastFlt_Val: category=VALUE, type=Float
      KeTHMR_T_TempRiseFastRelease_Val: category=VALUE, type=Float
      KeTHMR_T_TempRiseSlowFlt_Val: category=VALUE, type=Float
      KeTHMR_T_TempRiseSlowRelease_Val: category=VALUE, type=Float
      KeTHMR_T_WaterTempChangeRateReq: category=VALUE, type=Float
      KeTHMR_T_WaterTempChangeRateReq_Val: category=VALUE, type=Float
      KeTHMR_T_WaterTempChangeRateReset: category=VALUE, type=Float
      KeTHMR_kP_PackHeatPowerFactor: category=VALUE, type=Float
      KeTHMR_kP_PackHeatPowerReq_Val: category=VALUE, type=Float
      KeTHMR_kP_PackHeatPowerReset: category=VALUE, type=Float
      KeTHMR_t_ACChrgCoolOffThld: category=VALUE, type=Float
      KeTHMR_t_ACChrgCoolOff_Ts: category=VALUE, type=Float
      KeTHMR_t_ACChrgCoolOnThld: category=VALUE, type=Float
      KeTHMR_t_ACChrgCoolOn_Ts: category=VALUE, type=Float
      KeTHMR_t_ACChrgHeatOffThld: category=VALUE, type=Float
      KeTHMR_t_ACChrgHeatOff_Ts: category=VALUE, type=Float
      KeTHMR_t_ACChrgHeatOnThld: category=VALUE, type=Float
      KeTHMR_t_ACChrgHeatOn_Ts: category=VALUE, type=Float
      KeTHMR_t_BHeatCloseDeb: category=VALUE, type=Float
      KeTHMR_t_DriveCoolOffThld: category=VALUE, type=Float
      KeTHMR_t_DriveCoolOff_Ts: category=VALUE, type=Float
      KeTHMR_t_DriveCoolOnThld: category=VALUE, type=Float
      KeTHMR_t_DriveCoolOn_Ts: category=VALUE, type=Float
      KeTHMR_t_HeatingOverCurrtTime_Val: category=VALUE, type=Float
      KeTHMR_t_HeatingOverCurrt_Ts: category=VALUE, type=Float
      KeTHMR_t_InletWaterTempFltSet_Val: category=VALUE, type=Float
      KeTHMR_t_InletWaterTempRelease_Val: category=VALUE, type=Float
      KeTHMR_t_InletWaterTempTime_Val: category=VALUE, type=Float
      KeTHMR_t_InletWaterTemp_Ts: category=VALUE, type=Float
      KeTHMR_t_TempOver_Ts: category=VALUE, type=Float
      KeTHMR_t_TempRelease_Ts: category=VALUE, type=Float
      KeTHMR_t_TempSlowOver_Ts: category=VALUE, type=Float
      KeTHMR_t_TempSlowRelease_Ts: category=VALUE, type=Float
      KeTHMR_t_Temp_Ts: category=VALUE, type=Float
      KeTHMR_b_BatteryCooling_flt_En: category=BOOLEAN, type=Boolean
      KeTHMR_b_HeatReqFromCHMR: category=BOOLEAN, type=Boolean
      KeTHMR_b_HeatTempRiseFast_flt_En: category=BOOLEAN, type=Boolean
      KeTHMR_b_HeatTempRiseSlow_flt_En: category=BOOLEAN, type=Boolean
      KeTHMR_b_HeatingOverCurrt_flt_En: category=BOOLEAN, type=Boolean
      KeTHMR_b_PackHeatPowerReq_En: category=BOOLEAN, type=Boolean
      KeTHMR_b_PackHeatReq_En: category=BOOLEAN, type=Boolean
      KeTHMR_b_PreHeatSwitchDefaultVal: category=BOOLEAN, type=Boolean
      KeTHMR_b_TargetInletWaterTemp_En: category=BOOLEAN, type=Boolean
      KeTHMR_b_ThermalFlowRateReq_En: category=BOOLEAN, type=Boolean
      KeTHMR_b_ThermalManageReq_En: category=BOOLEAN, type=Boolean
      KeTHMR_b_WaterTempChangeRateReq_En: category=BOOLEAN, type=Boolean
      KeTHMR_k_ACChrgBalanceFlowRateReqVal: category=VALUE, type=UInt8
      KeTHMR_k_ACChrgCoolFlowRateReqV4: category=VALUE, type=UInt8
      KeTHMR_k_BatteryCooling_flt_Val: category=VALUE, type=UInt8
      KeTHMR_k_DefaultFlowRateReqThld: category=VALUE, type=UInt8
      KeTHMR_k_DrvCoolFlowRateReqV{1..3}: category=VALUE, type=UInt8
      KeTHMR_k_HeatTempRiseFast_flt_Val: category=VALUE, type=UInt8
      KeTHMR_k_HeatTempRiseSlow_flt_Val: category=VALUE, type=UInt8
      KeTHMR_k_HeatingOverCurrt_flt_Val: category=VALUE, type=UInt8
      KeTHMR_k_NumberOfWaterThermistors: category=VALUE, type=UInt8
      KeTHMR_k_PackHeatReq_Val: category=VALUE, type=UInt8
      KeTHMR_k_TempNumber: category=VALUE, type=UInt8
      KeTHMR_k_ThermalFlowRateReq_Val: category=VALUE, type=UInt8
      KeTHMR_k_ThermalManageReq_Val: category=VALUE, type=UInt8
package /THMR_Code_pkg/THMR_Code_if
  31 x sender receiver interface:
    VeTHMR_T_TargetInletWaterTemp
      data VeTHMR_T_TargetInletWaterTemp: category=VALUE, sw-calibration-access=READ-ONLY, type=Float
    VeTHMR_kP_PackHeatPowerReq
      data VeTHMR_kP_PackHeatPowerReq: category=VALUE, sw-calibration-access=READ-ONLY, type=Float
    VeTHMR_k_TmemalFlowRateReq
      data VeTHMR_k_TmemalFlowRateReq: category=VALUE, sw-calibration-access=READ-ONLY, type=UInt8
    VeTHMR_k_ThermalManageReq
      data VeTHMR_k_ThermalManageReq: category=VALUE, sw-calibration-access=READ-ONLY, type=UInt8
    VeTHMR_T_WaterTempChangeRateReq
      data VeTHMR_T_WaterTempChangeRateReq: category=VALUE, sw-calibration-access=READ-ONLY, type=Float
    VeTHMR_b_PackHeatReq
      data VeTHMR_b_PackHeatReq: category=BOOLEAN, sw-calibration-access=READ-ONLY, type=Boolean
    VeTHMR_k_HeatTempRiseFast_flt
      data VeTHMR_k_HeatTempRiseFast_flt: category=VALUE, sw-calibration-access=READ-ONLY, type=UInt8
    VeTHMR_k_HeatTempRiseSlow_flt
      data VeTHMR_k_HeatTempRiseSlow_flt: category=VALUE, sw-calibration-access=READ-ONLY, type=UInt8
    VeTHMR_k_BatteryHeatingOverCurrt_flt
      data VeTHMR_k_BatteryHeatingOverCurrt_flt: category=VALUE, sw-calibration-access=READ-ONLY, type=UInt8
    VeTHMR_k_BatteryCooling_flt
      data VeTHMR_k_BatteryCooling_flt: category=VALUE, sw-calibration-access=READ-ONLY, type=UInt8
    VeHVSR_e_StateMode
      data VeHVSR_e_StateMode: category=VALUE, type=TeHVSR_e_StateMode
    VeADPR_b_ACChConnect
      data VeADPR_b_ACChConnect: category=BOOLEAN, type=Boolean
    VeCANR_k_VCUHvPowerCtrl
      data VeCANR_k_VCUHvPowerCtrl: category=VALUE, type=UInt8
    VeCANR_k_VCUAllowToCharge
      data VeCANR_k_VCUAllowToCharge: category=VALUE, type=UInt8
    VeSOCR_Pct_DisplayPackSOC
      data VeSOCR_Pct_DisplayPackSOC: category=VALUE, type=Float
    VeCSCR_T_MaxCellTempMod
      data VeCSCR_T_MaxCellTempMod: category=VALUE, type=Float
    VeCSCR_T_MinCellTempMod
      data VeCSCR_T_MinCellTempMod: category=VALUE, type=Float
    VeCSCR_T_DeltaCellTemp
      data VeCSCR_T_DeltaCellTemp: category=VALUE, type=Float
    VeCSCR_U_PackVoltage_out
      data VeCSCR_U_PackVoltage_out: category=VALUE, type=Float
    VeCSCR_U_LinkVoltage_out
      data VeCSCR_U_LinkVoltage_out: category=VALUE, type=Float
    VeLLSR_U_Heat2LinkVoltage
      data VeLLSR_U_Heat2LinkVoltage: category=VALUE, type=Float
    VeDHSR_b_NoHeat
      data VeDHSR_b_NoHeat: category=BOOLEAN, type=Boolean
    VeADPR_e_ChargerEnable
      data VeADPR_e_ChargerEnable: category=VALUE, type=TeCHMR_e_OBC_ChrgEnable
    VeADPR_U_ChrgVoltSetPt
      data VeADPR_U_ChrgVoltSetPt: category=VALUE, type=Float
    VeADPR_I_ChrgCurrentRq
      data VeADPR_I_ChrgCurrentRq: category=VALUE, type=Float
    VaCSCR_T_CellTempArray_out
      data VaCSCR_T_CellTempArray_out: category=ARRAY, type=rt_Array_Float_16
    VaLLSR_b_CellTemp_Inv
      data VaLLSR_b_CellTemp_Inv: category=ARRAY, type=rt_Array_Boolean_16
    VeCFLR_b_HeatContactor
      data VeCFLR_b_HeatContactor: category=BOOLEAN, type=Boolean
    VeVSDR_I_HVHeatingCurrent
      data VeVSDR_I_HVHeatingCurrent: category=VALUE, type=Float
    VaCSCR_T_WaterTempArray
      data VaCSCR_T_WaterTempArray: category=ARRAY, type=rt_Array_Float_2
    VeCSCR_n_WaterTemp_flt_CAN
      data VeCSCR_n_WaterTemp_flt_CAN: category=VALUE, type=UInt8
