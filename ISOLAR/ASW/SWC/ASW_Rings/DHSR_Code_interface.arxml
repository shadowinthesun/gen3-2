AUTOSAR XML (schema 4-0-3)
package /CalibrationComponents
  parameter interface DHSR_if
    27 x parameter data prototype, all with sw-calibration-access=READ-WRITE:
      KeDHSR_kmh_VehSpeedProgAlwd: category=VALUE, type=Float
      KeDHSR_r_ChrgFactor_Val: category=VALUE, type=Float
      KeDHSR_r_RegenFactor_Val: category=VALUE, type=Float
      KeDHSR_r_SOPFactor_Val: category=VALUE, type=Float
      KeDHSR_t_BPOdbnc{1..4}: category=VALUE, type=Float
      KeDHSR_b_BattPowerOff_En: category=BOOLEAN, type=Boolean
      KeDHSR_b_BattPowerOff_Val: category=BOOLEAN, type=Boolean
      KeDHSR_b_ChrgFactor_En: category=BOOLEAN, type=Boolean
      KeDHSR_b_Discharge10Kw_En: category=BOOLEAN, type=Boolean
      KeDHSR_b_Discharge10Kw_Val: category=BOOLEAN, type=Boolean
      KeDHSR_b_FaultLamp_En: category=BOOLEAN, type=Boolean
      KeDHSR_b_FaultLamp_Val: category=BOOLEAN, type=Boolean
      KeDHSR_b_NoCellBalance_En: category=BOOLEAN, type=Boolean
      KeDHSR_b_NoCellBalance_Val: category=BOOLEAN, type=Boolean
      KeDHSR_b_NoHeat_En: category=BOOLEAN, type=Boolean
      KeDHSR_b_NoHeat_Val: category=BOOLEAN, type=Boolean
      KeDHSR_b_NoPrecharge_En: category=BOOLEAN, type=Boolean
      KeDHSR_b_NoPrecharge_Val: category=BOOLEAN, type=Boolean
      KeDHSR_b_RegenFactor_En: category=BOOLEAN, type=Boolean
      KeDHSR_b_ReqPowerOff_En: category=BOOLEAN, type=Boolean
      KeDHSR_b_ReqPowerOff_Val: category=BOOLEAN, type=Boolean
      KeDHSR_b_SOCTo0_En: category=BOOLEAN, type=Boolean
      KeDHSR_b_SOPFactor_En: category=BOOLEAN, type=Boolean
      KeDHSR_b_SOCTo0_Val: category=VALUE, type=UInt8
package /DHSR_Code_pkg/DHSR_Code_if
  130 x sender receiver interface:
    VeDHSR_k_ChrgFaultLvl
      data VeDHSR_k_ChrgFaultLvl: category=VALUE, sw-calibration-access=READ-ONLY, type=UInt8
    VeDHSR_k_DisChFaultLvl
      data VeDHSR_k_DisChFaultLvl: category=VALUE, sw-calibration-access=READ-ONLY, type=UInt8
    VeDHSR_b_NoCellBalance
      data VeDHSR_b_NoCellBalance: category=BOOLEAN, sw-calibration-access=READ-ONLY, type=Boolean
    VeDHSR_b_NoHeat
      data VeDHSR_b_NoHeat: category=BOOLEAN, sw-calibration-access=READ-ONLY, type=Boolean
    VeDHSR_b_FaultLamp
      data VeDHSR_b_FaultLamp: category=BOOLEAN, sw-calibration-access=READ-ONLY, type=Boolean
    VeDHSR_r_RegenSOPFactor
      data VeDHSR_r_RegenSOPFactor: category=VALUE, sw-calibration-access=READ-ONLY, type=Float
    VeDHSR_r_ChrgFactor
      data VeDHSR_r_ChrgFactor: category=VALUE, sw-calibration-access=READ-ONLY, type=Float
    VeDHSR_r_DischSOPFactor
      data VeDHSR_r_DischSOPFactor: category=VALUE, sw-calibration-access=READ-ONLY, type=Float
    VeDHSR_k_SOCTo0
      data VeDHSR_k_SOCTo0: category=VALUE, sw-calibration-access=READ-ONLY, type=UInt8
    VeDHSR_b_Discharge10Kw
      data VeDHSR_b_Discharge10Kw: category=BOOLEAN, sw-calibration-access=READ-ONLY, type=Boolean
    VeDHSR_b_ReqPowerOff
      data VeDHSR_b_ReqPowerOff: category=BOOLEAN, sw-calibration-access=READ-ONLY, type=Boolean
    VeDHSR_b_BattPowerOff
      data VeDHSR_b_BattPowerOff: category=BOOLEAN, sw-calibration-access=READ-ONLY, type=Boolean
    VeDHSR_b_ProgModeAllow
      data VeDHSR_b_ProgModeAllow: category=BOOLEAN, sw-calibration-access=READ-ONLY, type=Boolean
    VeDHSR_b_NoPrecharge
      data VeDHSR_b_NoPrecharge: category=BOOLEAN, sw-calibration-access=READ-ONLY, type=Boolean
    VeDHSR_b_FaultLamp_Rank_CAN
      data VeDHSR_b_FaultLamp_Rank_CAN: category=BOOLEAN, sw-calibration-access=READ-ONLY, type=Boolean
    VeDHSR_k_FaultLvl
      data VeDHSR_k_FaultLvl: category=VALUE, sw-calibration-access=READ-ONLY, type=UInt8
    VeDHSR_b_StoredEnergySys_CAN
      data VeDHSR_b_StoredEnergySys_CAN: category=BOOLEAN, sw-calibration-access=READ-ONLY, type=Boolean
    VeDHSR_k_TempFaultLight
      data VeDHSR_k_TempFaultLight: category=VALUE, sw-calibration-access=READ-ONLY, type=UInt8
    VaDHSR_k_FaultList_CAN
      data VaDHSR_k_FaultList_CAN: category=ARRAY, sw-calibration-access=READ-ONLY, type=rt_Array_UInt8_15
    VeDHSR_b_BattPerfomTest_Fault
      data VeDHSR_b_BattPerfomTest_Fault: category=BOOLEAN, sw-calibration-access=READ-ONLY, type=Boolean
    VeDHSR_k_BMSHardware_flt
      data VeDHSR_k_BMSHardware_flt: category=VALUE, sw-calibration-access=READ-ONLY, type=UInt8
    VeHVSR_e_StateMode
      data VeHVSR_e_StateMode: category=VALUE, type=TeHVSR_e_StateMode
    VeCANR_kmh_VehicleSpeed
      data VeCANR_kmh_VehicleSpeed: category=VALUE, type=Float
    VeCANR_b_NegContCmd
      data VeCANR_b_NegContCmd: category=BOOLEAN, type=Boolean
    VeHVSR_k_EnableContactors
      data VeHVSR_k_EnableContactors: category=VALUE, type=UInt8
    VeADPR_b_ACChConnect
      data VeADPR_b_ACChConnect: category=BOOLEAN, type=Boolean
    VeCPLR_k_OverCV_L1_flt
      data VeCPLR_k_OverCV_L1_flt: category=VALUE, type=UInt8
    VeCPLR_k_OverCV_L3_flt
      data VeCPLR_k_OverCV_L3_flt: category=VALUE, type=UInt8
    VeCPLR_k_OverCV_L4_flt
      data VeCPLR_k_OverCV_L4_flt: category=VALUE, type=UInt8
    VeCPLR_k_UnderCV_L2_flt
      data VeCPLR_k_UnderCV_L2_flt: category=VALUE, type=UInt8
    VeCPLR_k_UnderCV_L3_flt
      data VeCPLR_k_UnderCV_L3_flt: category=VALUE, type=UInt8
    VeCPLR_k_UnderCV_L4_flt
      data VeCPLR_k_UnderCV_L4_flt: category=VALUE, type=UInt8
    VeCPLR_k_DeltaCV_L1_flt
      data VeCPLR_k_DeltaCV_L1_flt: category=VALUE, type=UInt8
    VeCPLR_k_DeltaCV_L2_flt
      data VeCPLR_k_DeltaCV_L2_flt: category=VALUE, type=UInt8
    VeCPLR_k_DeltaCV_L3_flt
      data VeCPLR_k_DeltaCV_L3_flt: category=VALUE, type=UInt8
    VeCPLR_k_PackOverVolt_L1_flt
      data VeCPLR_k_PackOverVolt_L1_flt: category=VALUE, type=UInt8
    VeCPLR_k_PackOverVolt_L3_flt
      data VeCPLR_k_PackOverVolt_L3_flt: category=VALUE, type=UInt8
    VeCPLR_k_PackUnderVolt_L2_flt
      data VeCPLR_k_PackUnderVolt_L2_flt: category=VALUE, type=UInt8
    VeCPLR_k_PackUnderVolt_L3_flt
      data VeCPLR_k_PackUnderVolt_L3_flt: category=VALUE, type=UInt8
    VeCPLR_k_OverCT_L1_flt
      data VeCPLR_k_OverCT_L1_flt: category=VALUE, type=UInt8
    VeCPLR_k_OverCT_L3_flt
      data VeCPLR_k_OverCT_L3_flt: category=VALUE, type=UInt8
    VeCPLR_k_OverCT_L4_flt
      data VeCPLR_k_OverCT_L4_flt: category=VALUE, type=UInt8
    VeCPLR_k_UnderCT_L1_flt
      data VeCPLR_k_UnderCT_L1_flt: category=VALUE, type=UInt8
    VeCPLR_k_UnderCT_L3_flt
      data VeCPLR_k_UnderCT_L3_flt: category=VALUE, type=UInt8
    VeCPLR_k_UnderCT_L4_flt
      data VeCPLR_k_UnderCT_L4_flt: category=VALUE, type=UInt8
    VeCPLR_k_DeltaCT_L1_flt
      data VeCPLR_k_DeltaCT_L1_flt: category=VALUE, type=UInt8
    VeCPLR_k_DeltaCT_L2_flt
      data VeCPLR_k_DeltaCT_L2_flt: category=VALUE, type=UInt8
    VeCPLR_k_DeltaCT_L3_flt
      data VeCPLR_k_DeltaCT_L3_flt: category=VALUE, type=UInt8
    VeSOPR_k_PackOverDchrgPower1_flt
      data VeSOPR_k_PackOverDchrgPower1_flt: category=VALUE, type=UInt8
    VeSOPR_k_PackOverDchrgPower2_flt
      data VeSOPR_k_PackOverDchrgPower2_flt: category=VALUE, type=UInt8
    VeSOPR_k_PackOverDchrgPower3_flt
      data VeSOPR_k_PackOverDchrgPower3_flt: category=VALUE, type=UInt8
    VeSOPR_k_PackOverChrgPower1_flt
      data VeSOPR_k_PackOverChrgPower1_flt: category=VALUE, type=UInt8
    VeSOPR_k_PackOverChrgPower2_flt
      data VeSOPR_k_PackOverChrgPower2_flt: category=VALUE, type=UInt8
    VeSOPR_k_PackOverChrgPower3_flt
      data VeSOPR_k_PackOverChrgPower3_flt: category=VALUE, type=UInt8
    VeCHMR_k_ChrgOverCurr_level3_flt
      data VeCHMR_k_ChrgOverCurr_level3_flt: category=VALUE, type=UInt8
    VeSOCR_k_SOC_low1_flt
      data VeSOCR_k_SOC_low1_flt: category=VALUE, type=UInt8
    VeSOCR_k_SOC_low2_flt
      data VeSOCR_k_SOC_low2_flt: category=VALUE, type=UInt8
    VeSOCR_k_SOC_low3_flt
      data VeSOCR_k_SOC_low3_flt: category=VALUE, type=UInt8
    VeSOHR_k_LowSOH_flt
      data VeSOHR_k_LowSOH_flt: category=VALUE, type=UInt8
    VeSOCR_k_SOCJumpWarn_flt
      data VeSOCR_k_SOCJumpWarn_flt: category=VALUE, type=UInt8
    VeSOCR_k_SOCOverWarn_flt
      data VeSOCR_k_SOCOverWarn_flt: category=VALUE, type=UInt8
    VeISLR_k_Isolation_L1_flt
      data VeISLR_k_Isolation_L1_flt: category=VALUE, type=UInt8
    VeISLR_k_Isolation_L2_flt
      data VeISLR_k_Isolation_L2_flt: category=VALUE, type=UInt8
    VeLLSR_k_BMS_CrashOutputSts
      data VeLLSR_k_BMS_CrashOutputSts: category=VALUE, type=UInt8
    VeLLSR_k_BalOverTemp_flt
      data VeLLSR_k_BalOverTemp_flt: category=VALUE, type=UInt8
    VeCPLR_k_PCBOverTemp_flt
      data VeCPLR_k_PCBOverTemp_flt: category=VALUE, type=UInt8
    VeCPLR_k_ThermalRunaway_flt
      data VeCPLR_k_ThermalRunaway_flt: category=VALUE, type=UInt8
    VeTHMR_k_HeatTempRiseFast_flt
      data VeTHMR_k_HeatTempRiseFast_flt: category=VALUE, type=UInt8
    VeTHMR_k_HeatTempRiseSlow_flt
      data VeTHMR_k_HeatTempRiseSlow_flt: category=VALUE, type=UInt8
    VeTHMR_k_BatteryHeatingOverCurrt_flt
      data VeTHMR_k_BatteryHeatingOverCurrt_flt: category=VALUE, type=UInt8
    VeTHMR_k_BatteryCooling_flt
      data VeTHMR_k_BatteryCooling_flt: category=VALUE, type=UInt8
    VeVSDR_k_HVOverCurrent_flt
      data VeVSDR_k_HVOverCurrent_flt: category=VALUE, type=UInt8
    VeCFLR_k_RelayOverLoad_flt
      data VeCFLR_k_RelayOverLoad_flt: category=VALUE, type=UInt8
    VeCFLR_k_PositiveStuckClose_flt
      data VeCFLR_k_PositiveStuckClose_flt: category=VALUE, type=UInt8
    VeCFLR_k_PositiveStuckOpen_flt
      data VeCFLR_k_PositiveStuckOpen_flt: category=VALUE, type=UInt8
    VeCFLR_k_NegativeStuckClose_flt
      data VeCFLR_k_NegativeStuckClose_flt: category=VALUE, type=UInt8
    VeCFLR_k_NegativeStuckOpen_flt
      data VeCFLR_k_NegativeStuckOpen_flt: category=VALUE, type=UInt8
    VeCFLR_k_PrechargeStuckClose_flt
      data VeCFLR_k_PrechargeStuckClose_flt: category=VALUE, type=UInt8
    VeCFLR_k_PrechargeStuckOpen_flt
      data VeCFLR_k_PrechargeStuckOpen_flt: category=VALUE, type=UInt8
    VeCFLR_k_MainFuse1Open_flt
      data VeCFLR_k_MainFuse1Open_flt: category=VALUE, type=UInt8
    VeCFLR_k_MainFuse2Open_flt
      data VeCFLR_k_MainFuse2Open_flt: category=VALUE, type=UInt8
    VeHVIR_k_MainHVIL2_flt
      data VeHVIR_k_MainHVIL2_flt: category=VALUE, type=UInt8
    VeHVIR_k_MainHVIL_flt
      data VeHVIR_k_MainHVIL_flt: category=VALUE, type=UInt8
    VeISLR_InterIsolation_flt
      data VeISLR_InterIsolation_flt: category=VALUE, type=UInt8
    VeISLR_ExterIsolation_flt
      data VeISLR_ExterIsolation_flt: category=VALUE, type=UInt8
    VeCFLR_k_PreResistorStuckOpen_flt
      data VeCFLR_k_PreResistorStuckOpen_flt: category=VALUE, type=UInt8
    VeCFLR_k_PreChargeFail_flt
      data VeCFLR_k_PreChargeFail_flt: category=VALUE, type=UInt8
    VeCFLR_k_PreChargeOvCur_flt
      data VeCFLR_k_PreChargeOvCur_flt: category=VALUE, type=UInt8
    VeCFLR_k_PassiveMcuDischarge_flt
      data VeCFLR_k_PassiveMcuDischarge_flt: category=VALUE, type=UInt8
    VeCFLR_k_ConDrvPosCircuit_flt
      data VeCFLR_k_ConDrvPosCircuit_flt: category=VALUE, type=UInt8
    VeCFLR_k_ConDrvNegCircuit_flt
      data VeCFLR_k_ConDrvNegCircuit_flt: category=VALUE, type=UInt8
    VeCFLR_k_ConDrvPreCircuit_flt
      data VeCFLR_k_ConDrvPreCircuit_flt: category=VALUE, type=UInt8
    VeVSDR_k_LinkVoltageInRange_flt
      data VeVSDR_k_LinkVoltageInRange_flt: category=VALUE, type=UInt8
    VeVSDR_k_PackVoltageInRange_flt
      data VeVSDR_k_PackVoltageInRange_flt: category=VALUE, type=UInt8
    VeVSDR_k_VoltMCUFInRange_flt
      data VeVSDR_k_VoltMCUFInRange_flt: category=VALUE, type=UInt8
    VeVSDR_k_VoltMCURInRange_flt
      data VeVSDR_k_VoltMCURInRange_flt: category=VALUE, type=UInt8
    VeCSCR_k_CellCircuit_flt
      data VeCSCR_k_CellCircuit_flt: category=VALUE, type=UInt8
    VeCSCR_k_StackCircuit_flt
      data VeCSCR_k_StackCircuit_flt: category=VALUE, type=UInt8
    VeCSCR_k_TempArray_flt
      data VeCSCR_k_TempArray_flt: category=VALUE, type=UInt8
    VeCSCR_k_PackVolt_flt
      data VeCSCR_k_PackVolt_flt: category=VALUE, type=UInt8
    VeCSCR_k_LinkPVolt_flt
      data VeCSCR_k_LinkPVolt_flt: category=VALUE, type=UInt8
    VeCSCR_k_HeatVolt_flt
      data VeCSCR_k_HeatVolt_flt: category=VALUE, type=UInt8
    VeCSCR_k_LinkNVolt_flt
      data VeCSCR_k_LinkNVolt_flt: category=VALUE, type=UInt8
    VeLLSR_k_CrashCircuit_flt
      data VeLLSR_k_CrashCircuit_flt: category=VALUE, type=UInt8
    VeLLSR_k_PackCrntCircuit_flt
      data VeLLSR_k_PackCrntCircuit_flt: category=VALUE, type=UInt8
    VeCSCR_k_CBCircuit_flt
      data VeCSCR_k_CBCircuit_flt: category=VALUE, type=UInt8
    VeCSCR_k_PCBTempInv_Flt
      data VeCSCR_k_PCBTempInv_Flt: category=VALUE, type=UInt8
    VeHVIR_k_MainHVILCircuit_flt
      data VeHVIR_k_MainHVILCircuit_flt: category=VALUE, type=UInt8
    VeHVIR_k_MainHVILCircuit2_flt
      data VeHVIR_k_MainHVILCircuit2_flt: category=VALUE, type=UInt8
    VeLLSR_k_IntEEP_flt
      data VeLLSR_k_IntEEP_flt: category=VALUE, type=UInt8
    VeLLSR_k_ExtEEP_flt
      data VeLLSR_k_ExtEEP_flt: category=VALUE, type=UInt8
    VeLLSR_k_DaisyCom_flt
      data VeLLSR_k_DaisyCom_flt: category=VALUE, type=UInt8
    VeLLSR_k_VCUComLoss_flt
      data VeLLSR_k_VCUComLoss_flt: category=VALUE, type=UInt8
    VeLLSR_k_OBCComLoss_flt
      data VeLLSR_k_OBCComLoss_flt: category=VALUE, type=UInt8
    VeLLSR_k_TMFComLoss_flt
      data VeLLSR_k_TMFComLoss_flt: category=VALUE, type=UInt8
    VeLLSR_k_TMRComLoss_flt
      data VeLLSR_k_TMRComLoss_flt: category=VALUE, type=UInt8
    VeLLSR_k_ISGFComLoss_flt
      data VeLLSR_k_ISGFComLoss_flt: category=VALUE, type=UInt8
    VeLLSR_k_CDUComLoss_flt
      data VeLLSR_k_CDUComLoss_flt: category=VALUE, type=UInt8
    VeLLSR_k_CLMComLoss_flt
      data VeLLSR_k_CLMComLoss_flt: category=VALUE, type=UInt8
    VeLLSR_k_ABMComLoss_flt
      data VeLLSR_k_ABMComLoss_flt: category=VALUE, type=UInt8
    VeLLSR_k_ICMComLoss_flt
      data VeLLSR_k_ICMComLoss_flt: category=VALUE, type=UInt8
    VeLLSR_k_TBOXComLoss_flt
      data VeLLSR_k_TBOXComLoss_flt: category=VALUE, type=UInt8
    VeLLSR_k_BSMComLoss_flt
      data VeLLSR_k_BSMComLoss_flt: category=VALUE, type=UInt8
    VeLLSR_k_EMSComLoss_flt
      data VeLLSR_k_EMSComLoss_flt: category=VALUE, type=UInt8
    VeLLSR_k_VehCANBusOff_flt
      data VeLLSR_k_VehCANBusOff_flt: category=VALUE, type=UInt8
    VeLLSR_k_KL30UnderVoltage_flt
      data VeLLSR_k_KL30UnderVoltage_flt: category=VALUE, type=UInt8
    VeLLSR_k_KL30OverVoltage_flt
      data VeLLSR_k_KL30OverVoltage_flt: category=VALUE, type=UInt8
    VeLLSR_k_KL30AccidentalPowerOff_flt
      data VeLLSR_k_KL30AccidentalPowerOff_flt: category=VALUE, type=UInt8
    VeCFLR_k_UnexpectedContOpen_flt
      data VeCFLR_k_UnexpectedContOpen_flt: category=VALUE, type=UInt8
    VeLLSR_k_AbnormalShutdownDetected
      data VeLLSR_k_AbnormalShutdownDetected: category=VALUE, type=UInt8
