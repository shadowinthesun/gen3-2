AUTOSAR XML (schema 4-0-3)
package /VSDR_Code_datatype_AVS_pkg
  4 x constant specification:
    KtVSDR_k_HallLargeFilterCoef_Table_AVS: value-spec=[0.10000000149011612, 0.18000000715255737, 0.20000000298023224, 0.30000001192092896, 0.5, 0.60000002384185791, 0.800000011920929, 1]
    KtVSDR_k_HallSmallFilterCoef_Table_AVS: value-spec=[0.10000000149011612, 0.18000000715255737, 0.20000000298023224, 0.30000001192092896, 0.5, 0.60000002384185791, 0.800000011920929, 1]
    KxVSDR_k_HallLargeFilterCoef_AVS: value-spec=[0, 5, 10, 50, 100, 150, 200, 300]
    KxVSDR_k_HallSmallFilterCoef_AVS: value-spec=[0, 5, 10, 50, 100, 150, 200, 300]
  constant specification mapping set VSDR_Code_datatype_AVS_MappingSet
    mappings:
      appl-constant=KtVSDR_k_HallLargeFilterCoef_Table, impl-constant=KtVSDR_k_HallLargeFilterCoef_Table_AVS
      appl-constant=KtVSDR_k_HallSmallFilterCoef_Table, impl-constant=KtVSDR_k_HallSmallFilterCoef_Table_AVS
      appl-constant=KxVSDR_k_HallLargeFilterCoef, impl-constant=KxVSDR_k_HallLargeFilterCoef_AVS
      appl-constant=KxVSDR_k_HallSmallFilterCoef, impl-constant=KxVSDR_k_HallSmallFilterCoef_AVS
