AUTOSAR XML (schema 4-0-3)
package /CalibrationComponents
  parameter interface SOCR_if
    154 x parameter data prototype, all with sw-calibration-access=READ-WRITE:
      KaSOCR_Ah_OvrdValue_CellCapacityCharge: category=ARRAY, type=rt_Array_Float_96
      KaSOCR_Ah_OvrdValue_CellCapacityDischarge: category=ARRAY, type=rt_Array_Float_96
      KaSOCR_Pct_OvrdValue_CellSOCArray_new: category=ARRAY, type=rt_Array_Float_96
      KaSOCR_Pct_SOCini: category=ARRAY, type=rt_Array_Float_96
      KeSOCR_Ah_BatteryCellsCap: category=VALUE, type=Float
      KeSOCR_Ah_MinCellCapacityCharge_Val: category=VALUE, type=Float
      KeSOCR_Ah_MinCellCapacityDischarge_Val: category=VALUE, type=Float
      KeSOCR_Ah_OvrdValue_BatteryPackCapacity: category=VALUE, type=Float
      KeSOCR_Ah_PackCapacityCharge_MaxVal: category=VALUE, type=Float
      KeSOCR_Ah_PackCapacityCharge_Val: category=VALUE, type=Float
      KeSOCR_Ah_PackCapacityCharge_minVal: category=VALUE, type=Float
      KeSOCR_Ah_PackCapacityDischarge_MaxVal: category=VALUE, type=Float
      KeSOCR_Ah_PackCapacityDischarge_Val: category=VALUE, type=Float
      KeSOCR_Ah_PackCapacityDischarge_minVal: category=VALUE, type=Float
      KeSOCR_Cnt_NumberOfCellParal: category=VALUE, type=Float
      KeSOCR_I_CoseToZero: category=VALUE, type=Float
      KeSOCR_I_CoulombsCSC: category=VALUE, type=Float
      KeSOCR_I_CurrForCalcTTC_NoCharge: category=VALUE, type=Float
      KeSOCR_I_LowCurrent: category=VALUE, type=Float
      KeSOCR_I_SOCFixLowCurrent: category=VALUE, type=Float
      KeSOCR_I_ThrshldCorrSOCConvrg: category=VALUE, type=Float
      KeSOCR_I_ThrshldLowCurrent: category=VALUE, type=Float
      KeSOCR_I_ThrshldSOCCorrection_DE: category=VALUE, type=Float
      KeSOCR_I_ThrshldZeroCurrent: category=VALUE, type=Float
      KeSOCR_Pct_AC_ChgPctCoeff: category=VALUE, type=Float
      KeSOCR_Pct_CloseToZeroThreshold: category=VALUE, type=Float
      KeSOCR_Pct_CorrectedPackSOC_Val: category=VALUE, type=Float
      KeSOCR_Pct_CorrectedPackSOC_ini: category=VALUE, type=Float
      KeSOCR_Pct_CorrectedScaledSOC_ToCAN: category=VALUE, type=Float
      KeSOCR_Pct_CustomerPackSOC_MaxVal: category=VALUE, type=Float
      KeSOCR_Pct_CustomerPackSOC_Val: category=VALUE, type=Float
      KeSOCR_Pct_CustomerPackSOC_minVal: category=VALUE, type=Float
      KeSOCR_Pct_CustomerRealScaledSOC_ToCAN: category=VALUE, type=Float
      KeSOCR_Pct_DispSOC_Val: category=VALUE, type=Float
      KeSOCR_Pct_DisplayPackSOC_MaxVal: category=VALUE, type=Float
      KeSOCR_Pct_DisplayPackSOC_ini: category=VALUE, type=Float
      KeSOCR_Pct_DisplayPackSOC_minVal: category=VALUE, type=Float
      KeSOCR_Pct_LowSOC1_Reset: category=VALUE, type=Float
      KeSOCR_Pct_LowSOC1_Set: category=VALUE, type=Float
      KeSOCR_Pct_LowSOC2_Reset: category=VALUE, type=Float
      KeSOCR_Pct_LowSOC2_Set: category=VALUE, type=Float
      KeSOCR_Pct_LowSOC3_Reset: category=VALUE, type=Float
      KeSOCR_Pct_LowSOC3_Set: category=VALUE, type=Float
      KeSOCR_Pct_MaxBalDrain: category=VALUE, type=Float
      KeSOCR_Pct_MaxSOCBeforeVCU_ChrgComplete: category=VALUE, type=Float
      KeSOCR_Pct_MaxSlewRateLimitPer100msCorrSOC: category=VALUE, type=Float
      KeSOCR_Pct_OvrdValue_BatteryPackSOC: category=VALUE, type=Float
      KeSOCR_Pct_OvrdValue_DisplayPackSOC: category=VALUE, type=Float
      KeSOCR_Pct_OvrdValue_MaxSOC: category=VALUE, type=Float
      KeSOCR_Pct_OvrdValue_MinSOC: category=VALUE, type=Float
      KeSOCR_Pct_PackSOCDiff_Val: category=VALUE, type=Float
      KeSOCR_Pct_PackSOCDiff_ini: category=VALUE, type=Float
      KeSOCR_Pct_SOCChangeThreshold: category=VALUE, type=Float
      KeSOCR_Pct_SOCJumpWarn_Reset: category=VALUE, type=Float
      KeSOCR_Pct_SOCJumpWarn_Set: category=VALUE, type=Float
      KeSOCR_Pct_SOCOverWarn_Reset: category=VALUE, type=Float
      KeSOCR_Pct_SOCOverWarn_Set: category=VALUE, type=Float
      KeSOCR_Pct_SOC_SetPointUDS31010F15: category=VALUE, type=Float
      KeSOCR_Pct_SOC_ThresholdTTC: category=VALUE, type=Float
      KeSOCR_Pct_SlewRateLimitFbackDriving: category=VALUE, type=Float
      KeSOCR_Pct_SlewRateLimitPer100msAC: category=VALUE, type=Float
      KeSOCR_Pct_SlewRateLimitPer100msCorrSOC: category=VALUE, type=Float
      KeSOCR_Pct_SlewRateLimitPer100msDC: category=VALUE, type=Float
      KeSOCR_Pct_SlewRateLimitPer100msDriving: category=VALUE, type=Float
      KeSOCR_Pct_ThrshldCorrSOC: category=VALUE, type=Float
      KeSOCR_Pct_TsigBatteryPackSOC_Val: category=VALUE, type=Float
      KeSOCR_R_CSCBalancingR: category=VALUE, type=Float
      KeSOCR_T_HighTemprChgEnd_DC: category=VALUE, type=Float
      KeSOCR_U_100PctVoltage: category=VALUE, type=Float
      KeSOCR_U_CloseToEndOfCharge_AC: category=VALUE, type=Float
      KeSOCR_U_CloseToEndOfCharge_DC_1: category=VALUE, type=Float
      KeSOCR_U_CloseToEndOfCharge_DC_2: category=VALUE, type=Float
      KeSOCR_U_FullSOCVoltage_Reset: category=VALUE, type=Float
      KeSOCR_U_FullSOCVoltage_Set: category=VALUE, type=Float
      KeSOCR_U_TTC_StrategyThrshld: category=VALUE, type=Float
      KeSOCR_k_AccelCoeffAC_ChgSteadySt: category=VALUE, type=Float
      KeSOCR_k_Coeff1_AC: category=VALUE, type=Float
      KeSOCR_k_Coeff1_DC: category=VALUE, type=Float
      KeSOCR_k_Coeff2_AC: category=VALUE, type=Float
      KeSOCR_k_Coeff2_DC: category=VALUE, type=Float
      KeSOCR_k_CoeffBias: category=VALUE, type=Float
      KeSOCR_k_CoeffTMax: category=VALUE, type=Float
      KeSOCR_k_CoeffTMin: category=VALUE, type=Float
      KeSOCR_k_ContractDiffCorrSOC: category=VALUE, type=Float
      KeSOCR_k_ContractionCoeff: category=VALUE, type=Float
      KeSOCR_k_DutyCycleCompensation: category=VALUE, type=Float
      KeSOCR_k_MaxAccelCoeffAC_Chg: category=VALUE, type=Float
      KeSOCR_k_NumOf100msIn30Sec: category=VALUE, type=Float
      KeSOCR_min_InitTTC: category=VALUE, type=Float
      KeSOCR_min_TTC_Offset: category=VALUE, type=Float
      KeSOCR_min_TimeToCharge_Val: category=VALUE, type=Float
      KeSOCR_q_NomAccuCoulombs100ms: category=VALUE, type=Float
      KeSOCR_q_TsigAccuCoulombs_Val: category=VALUE, type=Float
      KeSOCR_r_CoulombEfficiency: category=VALUE, type=Float
      KeSOCR_r_RCGain_DE: category=VALUE, type=Float
      KeSOCR_r_SOCGainScale_DE: category=VALUE, type=Float
      KeSOCR_r_SOCGain_DE: category=VALUE, type=Float
      KeSOCR_r_maxSOCGain_DE: category=VALUE, type=Float
      KeSOCR_t_FullSOCVoltage_Timer: category=VALUE, type=Float
      KeSOCR_t_LowSOC_DTCTimer: category=VALUE, type=Float
      KeSOCR_t_SOCJumpWarn_DTCTimer: category=VALUE, type=Float
      KeSOCR_t_SOCOverWarn_DTCTimer: category=VALUE, type=Float
      KeSOCR_t_SR_SOC: category=VALUE, type=Float
      KeSOCR_Cnt_CalcInitSOCWithDefaultVals: category=VALUE, type=UInt16
      KeSOCR_k_ExtendNsamplesAck: category=VALUE, type=UInt16
      KeSOCR_k_ExtendSaveToExtEEP: category=VALUE, type=UInt16
      KeSOCR_n_DebncCloseToEndOfCharge: category=VALUE, type=UInt16
      KeSOCR_n_DebncDoSlewRateCorrSOC: category=VALUE, type=UInt16
      KeSOCR_n_Num100msInOneMinLess1: category=VALUE, type=UInt16
      KeSOCR_n_vMinDebounceTime_DE: category=VALUE, type=UInt16
      KeSOCR_b_CorrectedPackSOC_Ctrl: category=BOOLEAN, type=Boolean
      KeSOCR_b_CustomerPackSOC_Ctrl: category=BOOLEAN, type=Boolean
      KeSOCR_b_DispSOC_En: category=BOOLEAN, type=Boolean
      KeSOCR_b_MinCellCapacityCharge_Ctrl: category=BOOLEAN, type=Boolean
      KeSOCR_b_MinCellCapacityDischarge_Ctrl: category=BOOLEAN, type=Boolean
      KeSOCR_b_NVMEnable_CellSOC_ini: category=BOOLEAN, type=Boolean
      KeSOCR_b_OCV_Disable: category=BOOLEAN, type=Boolean
      KeSOCR_b_OvrdCond_AccuCoulombsReset: category=BOOLEAN, type=Boolean
      KeSOCR_b_OvrdCond_BatteryPackCapacity: category=BOOLEAN, type=Boolean
      KeSOCR_b_OvrdCond_BatteryPackSOC: category=BOOLEAN, type=Boolean
      KeSOCR_b_OvrdCond_CellCapacityCharge: category=BOOLEAN, type=Boolean
      KeSOCR_b_OvrdCond_CellCapacityDischarge: category=BOOLEAN, type=Boolean
      KeSOCR_b_OvrdCond_CellSOCArray_new: category=BOOLEAN, type=Boolean
      KeSOCR_b_OvrdCond_DisplayPackSOC: category=BOOLEAN, type=Boolean
      KeSOCR_b_OvrdCond_MaxSOC: category=BOOLEAN, type=Boolean
      KeSOCR_b_OvrdCond_MinSOC: category=BOOLEAN, type=Boolean
      KeSOCR_b_OvrdValue_AccuCoulombsReset: category=BOOLEAN, type=Boolean
      KeSOCR_b_PackCapacityCharge_En: category=BOOLEAN, type=Boolean
      KeSOCR_b_PackCapacityDischarge_En: category=BOOLEAN, type=Boolean
      KeSOCR_b_PackSOCDiff_Ctrl: category=BOOLEAN, type=Boolean
      KeSOCR_b_SOCJumpWarn_Rank_CAN_En: category=BOOLEAN, type=Boolean
      KeSOCR_b_SOCJumpWarn_flt_En: category=BOOLEAN, type=Boolean
      KeSOCR_b_SOCLow_Rank_CAN_En: category=BOOLEAN, type=Boolean
      KeSOCR_b_SOCOverWarn_Rank_CAN_En: category=BOOLEAN, type=Boolean
      KeSOCR_b_SOCOverWarn_flt_En: category=BOOLEAN, type=Boolean
      KeSOCR_b_SOC_SetpointOverrideAck_Ctrl: category=BOOLEAN, type=Boolean
      KeSOCR_b_SOC_SetpointOverrideAck_Val: category=BOOLEAN, type=Boolean
      KeSOCR_b_SOC_low{1..3}_flt_En: category=BOOLEAN, type=Boolean
      KeSOCR_b_SaveSOCInExtEEP_Ctrl: category=BOOLEAN, type=Boolean
      KeSOCR_b_SaveSOCInExtEEP_Val: category=BOOLEAN, type=Boolean
      KeSOCR_b_TimeToCharge_Ctrl: category=BOOLEAN, type=Boolean
      KeSOCR_b_TsigAccuCoulombs_Ctrl: category=BOOLEAN, type=Boolean
      KeSOCR_b_TsigBatteryPackSOC_Ctrl: category=BOOLEAN, type=Boolean
      KeSOCR_b_enable_DE: category=BOOLEAN, type=Boolean
      KeSOCR_k_SOCJumpWarn_Rank_CAN_Val: category=VALUE, type=UInt8
      KeSOCR_k_SOCJumpWarn_flt_Val: category=VALUE, type=UInt8
      KeSOCR_k_SOCLow_Rank_CAN_Val: category=VALUE, type=UInt8
      KeSOCR_k_SOCOverWarn_Rank_CAN_Val: category=VALUE, type=UInt8
      KeSOCR_k_SOCOverWarn_flt_Val: category=VALUE, type=UInt8
      KeSOCR_k_SOC_low{1..3}_flt_Val: category=VALUE, type=UInt8
package /SOCR_Code_pkg/SOCR_Code_if
  63 x sender receiver interface:
    VaSOCR_Ah_CellCapacityDischarge
      data VaSOCR_Ah_CellCapacityDischarge: category=ARRAY, sw-calibration-access=READ-ONLY, type=rt_Array_Float_96
    VaSOCR_Ah_CellCapacityCharge
      data VaSOCR_Ah_CellCapacityCharge: category=ARRAY, sw-calibration-access=READ-ONLY, type=rt_Array_Float_96
    VeSOCR_Pct_BatteryPackSOC
      data VeSOCR_Pct_BatteryPackSOC: category=VALUE, sw-calibration-access=READ-ONLY, type=Float
    VeSOCR_Pct_DisplayPackSOC
      data VeSOCR_Pct_DisplayPackSOC: category=VALUE, sw-calibration-access=READ-ONLY, type=Float
    VeSOCR_Ah_BatteryPackCapacity
      data VeSOCR_Ah_BatteryPackCapacity: category=VALUE, sw-calibration-access=READ-ONLY, type=Float
    VaSOCR_Pct_CellSOC
      data VaSOCR_Pct_CellSOC: category=ARRAY, sw-calibration-access=READ-ONLY, type=rt_Array_Float_96
    VeSOCR_b_AccuCoulombsReset
      data VeSOCR_b_AccuCoulombsReset: category=BOOLEAN, sw-calibration-access=READ-ONLY, type=Boolean
    VeSOCR_Pct_MaxSOC
      data VeSOCR_Pct_MaxSOC: category=VALUE, sw-calibration-access=READ-ONLY, type=Float
    VeSOCR_Pct_MinSOC
      data VeSOCR_Pct_MinSOC: category=VALUE, sw-calibration-access=READ-ONLY, type=Float
    VeSOCR_Ah_PackCapacityCharge
      data VeSOCR_Ah_PackCapacityCharge: category=VALUE, sw-calibration-access=READ-ONLY, type=Float
    VeSOCR_Ah_PackCapacityDischarge
      data VeSOCR_Ah_PackCapacityDischarge: category=VALUE, sw-calibration-access=READ-ONLY, type=Float
    VeSOCR_Pct_CorrectedPackSOC
      data VeSOCR_Pct_CorrectedPackSOC: category=VALUE, sw-calibration-access=READ-ONLY, type=Float
    VeSOCR_Ah_MinCellCapacityDischarge
      data VeSOCR_Ah_MinCellCapacityDischarge: category=VALUE, sw-calibration-access=READ-ONLY, type=Float
    VeSOCR_Ah_MinCellCapacityCharge
      data VeSOCR_Ah_MinCellCapacityCharge: category=VALUE, sw-calibration-access=READ-ONLY, type=Float
    VeSOCR_b_SOC_SetpointOverrideAck
      data VeSOCR_b_SOC_SetpointOverrideAck: category=BOOLEAN, sw-calibration-access=READ-ONLY, type=Boolean
    VeSOCR_Pct_CustomerPackSOC
      data VeSOCR_Pct_CustomerPackSOC: category=VALUE, sw-calibration-access=READ-ONLY, type=Float
    VeSOCR_min_TimeToCharge
      data VeSOCR_min_TimeToCharge: category=VALUE, sw-calibration-access=READ-ONLY, type=Float
    VeSOCR_b_TriggerSaveExtEEP
      data VeSOCR_b_TriggerSaveExtEEP: category=BOOLEAN, sw-calibration-access=READ-ONLY, type=Boolean
    VeSOCR_Pct_PackSOCDiff
      data VeSOCR_Pct_PackSOCDiff: category=VALUE, sw-calibration-access=READ-ONLY, type=Float
    VeSOCR_k_SOC_low1_flt
      data VeSOCR_k_SOC_low1_flt: category=VALUE, sw-calibration-access=READ-ONLY, type=UInt8
    VeSOCR_k_SOC_low2_flt
      data VeSOCR_k_SOC_low2_flt: category=VALUE, sw-calibration-access=READ-ONLY, type=UInt8
    VeSOCR_k_SOCJumpWarn_flt
      data VeSOCR_k_SOCJumpWarn_flt: category=VALUE, sw-calibration-access=READ-ONLY, type=UInt8
    VeSOCR_k_SOCOverWarn_flt
      data VeSOCR_k_SOCOverWarn_flt: category=VALUE, sw-calibration-access=READ-ONLY, type=UInt8
    VeSOCR_k_SOCLow_Rank_CAN
      data VeSOCR_k_SOCLow_Rank_CAN: category=VALUE, sw-calibration-access=READ-ONLY, type=UInt8
    VeSOCR_k_SOCOverWarn_Rank_CAN
      data VeSOCR_k_SOCOverWarn_Rank_CAN: category=VALUE, sw-calibration-access=READ-ONLY, type=UInt8
    VeSOCR_k_SOCJumpWarn_Rank_CAN
      data VeSOCR_k_SOCJumpWarn_Rank_CAN: category=VALUE, sw-calibration-access=READ-ONLY, type=UInt8
    VeSOCR_k_SOC_low3_flt
      data VeSOCR_k_SOC_low3_flt: category=VALUE, sw-calibration-access=READ-ONLY, type=UInt8
    VaCSCR_U_CellVoltageArray_out
      data VaCSCR_U_CellVoltageArray_out: category=ARRAY, type=rt_Array_Float_96
    VeVSDR_q_AccuCoulombs
      data VeVSDR_q_AccuCoulombs: category=VALUE, type=Float
    VaCLBR_b_ActivateBalancing
      data VaCLBR_b_ActivateBalancing: category=ARRAY, type=rt_Array_Boolean_96
    VeCSCR_T_AvgCellTempMod
      data VeCSCR_T_AvgCellTempMod: category=VALUE, type=Float
    VeLLSR_t_SleepTime
      data VeLLSR_t_SleepTime: category=VALUE, type=Float
    VeCANR_kl_TotalOdometer
      data VeCANR_kl_TotalOdometer: category=VALUE, type=Float
    VeCSCR_U_AvgCellVoltageMod
      data VeCSCR_U_AvgCellVoltageMod: category=VALUE, type=Float
    VeLLSR_b_SleepTimeReady
      data VeLLSR_b_SleepTimeReady: category=BOOLEAN, type=Boolean
    VeHVSR_e_StateMode
      data VeHVSR_e_StateMode: category=VALUE, type=TeHVSR_e_StateMode
    VeFCMR_b_FC_ChargeComplete
      data VeFCMR_b_FC_ChargeComplete: category=BOOLEAN, type=Boolean
    VeCHMR_b_ChrgComplete
      data VeCHMR_b_ChrgComplete: category=BOOLEAN, type=Boolean
    VeLLSR_b_KL30Loss
      data VeLLSR_b_KL30Loss: category=BOOLEAN, type=Boolean
    VeCSCR_b_AveTempReady
      data VeCSCR_b_AveTempReady: category=BOOLEAN, type=Boolean
    VeCPLR_k_UnderCV_L2_flt
      data VeCPLR_k_UnderCV_L2_flt: category=VALUE, type=UInt8
    VeCPLR_k_UnderCV_L3_flt
      data VeCPLR_k_UnderCV_L3_flt: category=VALUE, type=UInt8
    VeCPLR_k_UnderCV_L4_flt
      data VeCPLR_k_UnderCV_L4_flt: category=VALUE, type=UInt8
    VeCPLR_k_PackUnderVolt_L2_flt
      data VeCPLR_k_PackUnderVolt_L2_flt: category=VALUE, type=UInt8
    VeCPLR_k_PackUnderVolt_L3_flt
      data VeCPLR_k_PackUnderVolt_L3_flt: category=VALUE, type=UInt8
    VeVSDR_e_CurrentFlowState
      data VeVSDR_e_CurrentFlowState: category=VALUE, type=TeVSDR_e_CurrentFlowState
    VeSOHR_Ah_AvailableCapacity
      data VeSOHR_Ah_AvailableCapacity: category=VALUE, type=Float
    VeLLSR_b_AbnormalShutdn
      data VeLLSR_b_AbnormalShutdn: category=BOOLEAN, type=Boolean
    VeLLSR_Pct_EepBatteryPackSOC
      data VeLLSR_Pct_EepBatteryPackSOC: category=VALUE, type=Float
    VeLLSR_Pct_EepCorrectedPackSOC
      data VeLLSR_Pct_EepCorrectedPackSOC: category=VALUE, type=Float
    VeLLSR_Pct_EepDisplayPackSOC
      data VeLLSR_Pct_EepDisplayPackSOC: category=VALUE, type=Float
    VeLLSR_b_IntEEP_Invalid
      data VeLLSR_b_IntEEP_Invalid: category=BOOLEAN, type=Boolean
    VeLLSR_b_ExtEEP_Invalid
      data VeLLSR_b_ExtEEP_Invalid: category=BOOLEAN, type=Boolean
    VaCLBR_b_BalCmdFromEEP
      data VaCLBR_b_BalCmdFromEEP: category=ARRAY, type=rt_Array_Boolean_96
    VeCSCR_b_CellUArrayReady
      data VeCSCR_b_CellUArrayReady: category=BOOLEAN, type=Boolean
    VeLLSR_k_SOC_SetpointOverride
      data VeLLSR_k_SOC_SetpointOverride: category=VALUE, type=UInt32
    VeCSCR_U_MaxCellVoltageMod
      data VeCSCR_U_MaxCellVoltageMod: category=VALUE, type=Float
    VeVSDR_I_HVCurrent
      data VeVSDR_I_HVCurrent: category=VALUE, type=Float
    VeCSCR_T_MaxCellTempMod
      data VeCSCR_T_MaxCellTempMod: category=VALUE, type=Float
    VeCSCR_T_MinCellTempMod
      data VeCSCR_T_MinCellTempMod: category=VALUE, type=Float
    VeCSCR_U_MinCellVoltageMod
      data VeCSCR_U_MinCellVoltageMod: category=VALUE, type=Float
    VeLLSR_Pct_ExtEepPackSOCDiff
      data VeLLSR_Pct_ExtEepPackSOCDiff: category=VALUE, type=Float
    VeLLSR_b_ClearDTC
      data VeLLSR_b_ClearDTC: category=BOOLEAN, type=Boolean
