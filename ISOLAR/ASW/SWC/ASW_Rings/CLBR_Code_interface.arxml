AUTOSAR XML (schema 4-0-3)
package /CLBR_Code_pkg/CLBR_Code_if
  16 x sender receiver interface:
    VaCLBR_b_ActivateBalancing
      data VaCLBR_b_ActivateBalancing: category=ARRAY, sw-calibration-access=READ-ONLY, type=rt_Array_Boolean_96
    VeCLBR_b_Balancing_flt
      data VeCLBR_b_Balancing_flt: category=BOOLEAN, sw-calibration-access=READ-ONLY, type=Boolean
    VeCLBR_t_TimeToWakeup_drv
      data VeCLBR_t_TimeToWakeup_drv: category=VALUE, sw-calibration-access=READ-ONLY, type=Float
    VaCLBR_n_BalancingBitfield_drv
      data VaCLBR_n_BalancingBitfield_drv: category=ARRAY, sw-calibration-access=READ-ONLY, type=rt_Array_UInt8_14
    VeCLBR_b_BalReadyToSleep
      data VeCLBR_b_BalReadyToSleep: category=BOOLEAN, sw-calibration-access=READ-ONLY, type=Boolean
    VeCLBR_b_BalancingActive
      data VeCLBR_b_BalancingActive: category=BOOLEAN, sw-calibration-access=READ-ONLY, type=Boolean
    VaCLBR_b_BalCmdFromEEP
      data VaCLBR_b_BalCmdFromEEP: category=ARRAY, sw-calibration-access=READ-ONLY, type=rt_Array_Boolean_96
    VaCLBR_n_CSCActivatedNum
      data VaCLBR_n_CSCActivatedNum: category=ARRAY, sw-calibration-access=READ-ONLY, type=rt_Array_UInt8_8
    VeDHSR_b_NoCellBalance
      data VeDHSR_b_NoCellBalance: category=BOOLEAN, type=Boolean
    VaSOCR_Pct_CellSOC
      data VaSOCR_Pct_CellSOC: category=ARRAY, type=rt_Array_Float_96
    VaLLSR_n_BalancingBitfield
      data VaLLSR_n_BalancingBitfield: category=ARRAY, type=rt_Array_UInt8_14
    VeCSCR_U_MinCellVoltageMod
      data VeCSCR_U_MinCellVoltageMod: category=VALUE, type=Float
    VeCSCR_T_MaxPCBTemp
      data VeCSCR_T_MaxPCBTemp: category=VALUE, type=Float
    VeCSCR_T_MaxCellTempMod
      data VeCSCR_T_MaxCellTempMod: category=VALUE, type=Float
    VeHVSR_e_StateMode
      data VeHVSR_e_StateMode: category=VALUE, type=TeHVSR_e_StateMode
    VaLLSR_n_ExtEepBalancingBitfield
      data VaLLSR_n_ExtEepBalancingBitfield: category=ARRAY, type=rt_Array_UInt8_14
package /CalibrationComponents
  parameter interface CLBR_if
    23 x parameter data prototype, all with sw-calibration-access=READ-WRITE:
      KeCLBR_Pct_DiffSOCThresholdCompletedCLB: category=VALUE, type=Float
      KeCLBR_Pct_DiffSOCThresholdForCLB: category=VALUE, type=Float
      KeCLBR_T_ThresholdMaxTemprCSC: category=VALUE, type=Float
      KeCLBR_T_ThresholdMaxTemprCell: category=VALUE, type=Float
      KeCLBR_U_NoCLB_Threshold: category=VALUE, type=Float
      KeCLBR_t_BalReEvalDone: category=VALUE, type=Float
      KeCLBR_t_DbncCLBR: category=VALUE, type=Float
      KeCLBR_t_DbncCompletedCLBR: category=VALUE, type=Float
      KeCLBR_t_OvrdValTTW: category=VALUE, type=Float
      KeCLBR_t_SR_CLBR: category=VALUE, type=Float
      KeCLBR_t_TimeToWakeupRTC: category=VALUE, type=Float
      KeCLBR_b_EnableCLBR: category=BOOLEAN, type=Boolean
      KeCLBR_b_OvrdCtrlBalBitfield: category=BOOLEAN, type=Boolean
      KeCLBR_b_OvrdCtrlBalReadyToSleep: category=BOOLEAN, type=Boolean
      KeCLBR_b_OvrdCtrlBalancingActive: category=BOOLEAN, type=Boolean
      KeCLBR_b_OvrdCtrlBalancingFlt: category=BOOLEAN, type=Boolean
      KeCLBR_b_OvrdCtrlTTW: category=BOOLEAN, type=Boolean
      KeCLBR_b_OvrdValBalReadyToSleep: category=BOOLEAN, type=Boolean
      KeCLBR_b_OvrdValBalancingActive: category=BOOLEAN, type=Boolean
      KeCLBR_b_OvrdValBalancingFlt: category=BOOLEAN, type=Boolean
      KaCLBR_n_OvrdValBalBitfield: category=ARRAY, type=rt_Array_UInt8_14
      KaCLBR_n_TurnOffBalBitfield: category=ARRAY, type=rt_Array_UInt8_14
      KeCLBR_Cnt_BitFieldByteLength: category=VALUE, type=UInt8
