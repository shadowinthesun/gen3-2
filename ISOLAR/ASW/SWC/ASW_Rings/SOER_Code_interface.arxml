AUTOSAR XML (schema 4-0-3)
package /CalibrationComponents
  parameter interface SOER_if
    4 x parameter data prototype, all with sw-calibration-access=READ-WRITE:
      KeSOER_kE_BattRmngEnergy_MaxVal: category=VALUE, type=Float
      KeSOER_kE_BattRmngEnergy_minVal: category=VALUE, type=Float
      KeSOER_kE_OvrdValue_BattRmngEnergy: category=VALUE, type=Float
      KeSOER_b_OvrdCond_BattRmngEnergy: category=BOOLEAN, type=Boolean
package /SOER_Code_pkg/SOER_Code_if
  4 x sender receiver interface:
    VeSOER_kE_BattRmngEnergy
      data VeSOER_kE_BattRmngEnergy: category=VALUE, sw-calibration-access=READ-ONLY, type=Float
    VeCSCR_T_MinCellTempMod
      data VeCSCR_T_MinCellTempMod: category=VALUE, type=Float
    VeSOCR_Pct_DisplayPackSOC
      data VeSOCR_Pct_DisplayPackSOC: category=VALUE, type=Float
    VeSOHR_Pct_BatteryPackSOH
      data VeSOHR_Pct_BatteryPackSOH: category=VALUE, type=Float
