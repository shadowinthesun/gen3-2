AUTOSAR XML (schema 4-0-3)
standard types defined: Float, Boolean, float32, boolean
package /SOER_Code_pkg/SOER_Code_dt
  unit NoUnit: factor-si-to-unit=1, offset-si-to-unit=0
  impl type rt_Array_Float_13: category=ARRAY
    element rt_Array_Float_13: array-size=13, array-size-semantics=FIXED-SIZE, implementation-data-type=Float
package /SOER_Code_pkg/SOER_Code_dt/ApplDataTypes
  4 x app type, all with sw-calibration-access=READ-WRITE:
    Float: category=VALUE, compu {identical}, range phys -INF..INF
    Appl_KtSOER_kE_AvailableEnergy_Table: category=CURVE, sw-calprm-axis-set={sw-axis-index=1, category=COM_AXIS, sw-axis-grouped=Appl_KxSOER_kE_AvailableEnergy}, compu {identical}, range phys -1000000..1000000, sw-record-layout=Cur_f32
    Appl_KxSOER_kE_AvailableEnergy: category=COM_AXIS, sw-calprm-axis-set={sw-axis-index=1, sw-axis-individual={input-variable-type=Float, compu {identical}, sw-max-axis-points=13, sw-min-axis-points=13, range phys -1000000..1000000}}, sw-record-layout=Distr_f32_M
    Boolean: category=BOOLEAN, compu {0=FALSE, 1=TRUE}
package /SOER_Code_pkg/SOER_Code_dt/ApplDataTypes/RecordLayouts
  sw record layout Cur_f32: sw-record-layout-group={short-label=Cur_f32, category=COLUMN_DIR, sw-record-layout-group-axis=0, sw-record-layout-group-index=X, sw-record-layout-group-from=1, sw-record-layout-group-to=-1, sw-record-layout-v={short-label=Val, base-type=float32, sw-record-layout-v-axis=0, sw-record-layout-v-prop=VALUE, sw-record-layout-v-index=X}}
  sw record layout Distr_f32_M: sw-record-layout-group={short-label=X, category=INDEX_INCR, sw-record-layout-group-axis=1, sw-record-layout-group-from=1, sw-record-layout-group-to=-1, sw-record-layout-v={short-label=VALUE, base-type=float32, sw-record-layout-v-axis=1, sw-record-layout-v-prop=VALUE}}
package /SOER_Code_pkg/SOER_Code_dt/DataTypeMappings
  data type mapping set SOER_CodeDataTypeMappingsSet
    data-type-maps:
      application-data-type=Float, implementation-data-type=Float
      application-data-type=Appl_KtSOER_kE_AvailableEnergy_Table, implementation-data-type=rt_Array_Float_13
      application-data-type=Appl_KxSOER_kE_AvailableEnergy, implementation-data-type=rt_Array_Float_13
      application-data-type=Boolean, implementation-data-type=Boolean
package /SOER_Code_pkg/SOER_Code_dt/Ground
  constant specification KtSOER_kE_AvailableEnergy_Table: value-spec=[14.145000457763672 15.767999649047852 16.64299964904785 17.049999237060547 17.461000442504883 17.9060001373291 18.356000900268555 18.687000274658203 19.354999542236328 19.88800048828125 20.273000717163086 20.34000015258789 20.408000946044922]
  constant specification KxSOER_kE_AvailableEnergy: value-spec=[-30 -20 -15 -10 -5 0 5 10 15 25 45 50 55]
package /SOER_Code_pkg/SOER_Code_dt/SwAddrMethods
  sw addr method CODE: section-type=CODE
  sw addr method CONST: section-type=CONST
  sw addr method VAR: section-type=VAR
