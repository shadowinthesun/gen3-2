AUTOSAR XML (schema 4-0-3)
standard types defined: Float, Boolean, UInt8, float32, uint8, boolean
package /CHMR_Code_pkg/CHMR_Code_dt
  unit NoUnit: factor-si-to-unit=1, offset-si-to-unit=0
  impl type TeCHMR_e_ChrgOnbrdFailStatus: category=VALUE, base-type=uint8
  impl type TeCHMR_e_ChrgMode: category=VALUE, base-type=uint8
  impl type TeCHMR_e_OBC_ChrgEnable: category=VALUE, base-type=uint8
  impl type TeHVSR_e_StateMode: category=VALUE, base-type=uint8
  impl type TeCHMR_e_VCU_ChargeRequest: category=VALUE, base-type=uint8
  impl type TeCHMR_e_BookChargeSetResponse: category=VALUE, base-type=uint8
  impl type TeCHMR_e_BookChgStaCheckReponse: category=VALUE, base-type=uint8
  impl type TeCHMR_e_OBC_ChrgLEDCntrol: category=VALUE, base-type=uint8
  impl type TeCHMR_e_ChargingStateMachine: category=VALUE, base-type=uint8
  impl type rt_Array_Float_154: category=ARRAY
    element rt_Array_Float_154: array-size=154, array-size-semantics=FIXED-SIZE, implementation-data-type=Float
  impl type rt_Array_Float_11: category=ARRAY
    element rt_Array_Float_11: array-size=11, array-size-semantics=FIXED-SIZE, implementation-data-type=Float
  impl type rt_Array_Float_14: category=ARRAY
    element rt_Array_Float_14: array-size=14, array-size-semantics=FIXED-SIZE, implementation-data-type=Float
package /CHMR_Code_pkg/CHMR_Code_dt/ApplDataTypes
  15 x app type, all with sw-calibration-access=READ-WRITE:
    Float: category=VALUE, compu {identical}, range phys -INF..INF
    TeCHMR_e_ChrgOnbrdFailStatus: category=VALUE, compu {0=CeCHMR_e_ChargerNoError, 1=CeCHMR_e_ChargerLimitFai, 2=CeCHMR_e_ChargerFaiDisable, 3=CeCHMR_e_ChargerShutdown}
    TeCHMR_e_ChrgMode: category=VALUE, compu {0=CeCHMR_e_ChrgModeReserved1, 1=CeCHMR_e_ChrgModeInit, 2=CeCHMR_e_ChrgModeStandby, 3=CeCHMR_e_ChrgModeReqDischrg, 4=CeCHMR_e_ChrgModeCharging, 5=CeCHMR_e_ChrgModeDischarging, 6=CeCHMR_e_ChrgModeHndlCheck, 7=CeCHMR_e_ChrgModeDelChrgCheck, 8=CeCHMR_e_ChrgModeFault, 9=CeCHMR_e_ChrgModeDerating, 10=CeCHMR_e_ChrgModeReserved2, 11=CeCHMR_e_ChrgModeShutdown, 12=CeCHMR_e_ChrgModeOff}
    Boolean: category=BOOLEAN, compu {0=FALSE, 1=TRUE}
    UInt8: category=VALUE, compu {identical}, range phys 0..255
    TeCHMR_e_OBC_ChrgEnable: category=VALUE, compu {0=CeCHMR_e_OBC_ChrgEnblDefault, 1=CeCHMR_e_OBC_ChrgEnableReserved1, 2=CeCHMR_e_OBC_ChrgEnableReserved2, 3=CeCHMR_e_OBC_ChrgEnableReserved3, 4=CeCHMR_e_OBC_ChrgEnblAlwCharge, 5=CeCHMR_e_OBC_ChrgEnblAlwDischarge, 6=CeCHMR_e_OBC_ChrgEnblChrgBattHeating, 7=CeCHMR_e_OBC_ChrgEnblBatteryCooling, 8=CeCHMR_e_OBC_ChrgEnableReserved4, 9=CeCHMR_e_OBC_ChrgEnableReserved5, 10=CeCHMR_e_OBC_ChrgEnblDischNotAllow, 11=CeCHMR_e_OBC_ChrgEnblEndOfChrg, 12=CeCHMR_e_OBC_ChrgEnblReserved, 13=CeCHMR_e_OBC_ChrgEnblAlwVTOLDischarge, 14=CeCHMR_e_OBC_ChrgEnblAlwVTOVDischarge}
    TeHVSR_e_StateMode: category=VALUE, compu {0=CeHVSR_e_StateModeReserved, 1=CeHVSR_e_StateModeInitial, 2=CeHVSR_e_StateModeStandBy, 3=CeHVSR_e_StateModePrecharge, 4=CeHVSR_e_StateModeNormalDischarge, 5=CeHVSR_e_StateModeWarningPowerReduction, 6=CeHVSR_e_StateModePowerReduction, 7=CeHVSR_e_StateModePreChargeFailed, 8=CeHVSR_e_StateModePowerHoldMode, 9=CeHVSR_e_StateModeShutdown, 10=CeHVSR_e_StateModeServiceMode, 11=CeHVSR_e_StateModeReady, 12=CeHVSR_e_StateModeAC_ChargeMode, 13=CeHVSR_e_StateModeEndOfCharge, 14=CeHVSR_e_StateModeDC_ChargeMode, 15=CeHVSR_e_StateModeSystemErr, 16=CeHVSR_e_StateModeTempChargState, 17=CeHVSR_e_StateModeHeatPreChgState, 18=CeHVSR_e_StateModeHeatingState, 19=CeHVSR_e_StateModeHeatFinishState}
    TeCHMR_e_VCU_ChargeRequest: category=VALUE, compu {0=CeCHMR_e_VCU_ChargeRequestDflt, 1=CeCHMR_e_VCU_ChargeRequestOn, 2=CeCHMR_e_VCU_ChargeRequestOff, 3=CeCHMR_e_VCU_ChargeRequestInvalid}
    TeCHMR_e_BookChargeSetResponse: category=VALUE, compu {0=CeCHMR_e_BookChargeDflt, 1=CeCHMR_e_BookChargeSucceed, 2=CeCHMR_e_BookChargeSetFailure, 3=CeCHMR_e_BookChargeCancelSucceed, 4=CeCHMR_e_BookChargeCancelFailure, 5=CeCHMR_e_BookChargeReserved1, 6=CeCHMR_e_BookChargeReserved2, 7=CeCHMR_e_BookChargeReserved3}
    TeCHMR_e_BookChgStaCheckReponse: category=VALUE, compu {0=CeCHMR_e_NoAppointmentMade, 1=CeCHMR_e_AppointementMade, 2=CeCHMR_e_AppointementExecuted, 3=CeCHMR_e_BookChgStaCheckReponseRsvrd}
    TeCHMR_e_OBC_ChrgLEDCntrol: category=VALUE, compu {0=CeCHMR_e_OBC_ChrgLEDCntroDflt, 1=CeCHMR_e_OBC_ChrgLEDCntroCharging, 2=CeCHMR_e_OBC_ChrgLEDCntroChrgFinished, 3=CeCHMR_e_OBC_ChrgLEDCntroChargeFlt, 4=CeCHMR_e_OBC_ChrgLEDCntroHeating, 5=CeCHMR_e_OBC_ChrgLEDCntroFailSilent, 6=CeCHMR_e_OBC_ChrgLEDCntroSchedChrgComp, 7=CeCHMR_e_OBC_ChrgLEDCntroSchedChrgWair}
    TeCHMR_e_ChargingStateMachine: category=VALUE, compu {0=CeCHMR_e_ChargingSM_Off, 1=CeCHMR_e_ChargingSM_Init, 2=CeCHMR_e_ChargingSM_Normal, 3=CeCHMR_e_ChargingSM_Derating, 4=CeCHMR_e_ChargingSM_Heating, 5=CeCHMR_e_ChargingSM_Cooling, 6=CeCHMR_e_ChargingSM_Interrupt, 7=CeCHMR_e_ChargingSM_Shutdown, 8=CeCHMR_e_ChargingSM_Mode_Select, 9=CeCHMR_e_ChargingSM_Discharge, 10=CeCHMR_e_ChargingSM_ChargeWait, 11=CeCHMR_e_ChargingSM_VTOLDischarge, 12=CeCHMR_e_ChargingSM_VTOVDischarge}
    Appl_CzCHMR_I_MaxChrgCurrent_data: category=MAP, sw-calprm-axis-set=[{sw-axis-index=1, category=COM_AXIS, sw-axis-grouped=Appl_CtCHMR_I_MaxChrgCurrent}, {sw-axis-index=2, category=COM_AXIS, sw-axis-grouped=Appl_CxCHMR_I_MaxChrgCurrent}], compu {identical}, range phys -INF..INF, sw-record-layout=Map_f32
    Appl_CxCHMR_I_MaxChrgCurrent: category=COM_AXIS, sw-calprm-axis-set={sw-axis-index=2, sw-axis-individual={compu {identical}, sw-max-axis-points=14, sw-min-axis-points=14, range phys -1000000..1000000}}, sw-record-layout=Distr_f32_M
    Appl_CtCHMR_I_MaxChrgCurrent: category=COM_AXIS, sw-calprm-axis-set={sw-axis-index=1, sw-axis-individual={compu {identical}, sw-max-axis-points=11, sw-min-axis-points=11, range phys -1000000..1000000}}, sw-record-layout=Distr_f32_M
package /CHMR_Code_pkg/CHMR_Code_dt/ApplDataTypes/RecordLayouts
  sw record layout Map_f32: sw-record-layout-group={short-label=Map_f32, sw-record-layout-group={short-label=Val, category=COLUMN_DIR, sw-record-layout-group-axis=1, sw-record-layout-group-index=X, sw-record-layout-group-from=1, sw-record-layout-group-to=-1, sw-record-layout-group={short-label=Val, sw-record-layout-group-axis=2, sw-record-layout-group-index=Y, sw-record-layout-group-from=1, sw-record-layout-group-to=-1, sw-record-layout-v={short-label=Val, base-type=float32, sw-record-layout-v-axis=0, sw-record-layout-v-prop=VALUE, sw-record-layout-v-index=X Y}}}}
  sw record layout Distr_f32_M: sw-record-layout-group={short-label=Y, category=INDEX_INCR, sw-record-layout-group-axis=1, sw-record-layout-group-from=1, sw-record-layout-group-to=-1, sw-record-layout-v={short-label=VALUE, base-type=float32, sw-record-layout-v-axis=1, sw-record-layout-v-prop=VALUE}}
package /CHMR_Code_pkg/CHMR_Code_dt/DataTypeMappings
  data type mapping set CHMR_CodeDataTypeMappingsSet
    data-type-maps:
      application-data-type=Float, implementation-data-type=Float
      application-data-type=TeCHMR_e_ChrgOnbrdFailStatus, implementation-data-type=TeCHMR_e_ChrgOnbrdFailStatus
      application-data-type=TeCHMR_e_ChrgMode, implementation-data-type=TeCHMR_e_ChrgMode
      application-data-type=Boolean, implementation-data-type=Boolean
      application-data-type=UInt8, implementation-data-type=UInt8
      application-data-type=TeCHMR_e_OBC_ChrgEnable, implementation-data-type=TeCHMR_e_OBC_ChrgEnable
      application-data-type=TeHVSR_e_StateMode, implementation-data-type=TeHVSR_e_StateMode
      application-data-type=TeCHMR_e_VCU_ChargeRequest, implementation-data-type=TeCHMR_e_VCU_ChargeRequest
      application-data-type=TeCHMR_e_BookChargeSetResponse, implementation-data-type=TeCHMR_e_BookChargeSetResponse
      application-data-type=TeCHMR_e_BookChgStaCheckReponse, implementation-data-type=TeCHMR_e_BookChgStaCheckReponse
      application-data-type=TeCHMR_e_OBC_ChrgLEDCntrol, implementation-data-type=TeCHMR_e_OBC_ChrgLEDCntrol
      application-data-type=TeCHMR_e_ChargingStateMachine, implementation-data-type=TeCHMR_e_ChargingStateMachine
      application-data-type=Appl_CzCHMR_I_MaxChrgCurrent_data, implementation-data-type=rt_Array_Float_154
      application-data-type=Appl_CtCHMR_I_MaxChrgCurrent, implementation-data-type=rt_Array_Float_11
      application-data-type=Appl_CxCHMR_I_MaxChrgCurrent, implementation-data-type=rt_Array_Float_14
package /CHMR_Code_pkg/CHMR_Code_dt/Ground
  constant specification CtCHMR_I_MaxChrgCurrent: value-spec=[2.700000047683716 2.799999952316284 3.4000000953674316 3.684999942779541 3.690000057220459 3.819999933242798 3.8499999046325684 3.869999885559082 4.099999904632568 4.170000076293945 4.25]
  constant specification CxCHMR_I_MaxChrgCurrent: value-spec=[-25 -20 -10 0 10 15 20 25 30 35 40 45 50 55]
  constant specification CzCHMR_I_MaxChrgCurrent_data: value-spec=[0 0 0 0 0 0 0 0 0 0 0 0 0 0 0 0.07500000298023224 0.15000000596046448 0.33000001311302185 0.33000001311302185 0.33000001311302185 0.33000001311302185 0.33000001311302185 0.33000001311302185 0.33000001311302185 0.33000001311302185 0.33000001311302185 0.33000001311302185 0 0 0.07500000298023224 0.15000000596046448 0.33000001311302185 0.33000001311302185 0.33000001311302185 0.33000001311302185 0.33000001311302185 0.33000001311302185 0.33000001311302185 0.33000001311302185 0.33000001311302185 0.33000001311302185 0 0 0.07500000298023224 0.125 0.33000001311302185 0.33000001311302185 0.33000001311302185 0.33000001311302185 0.33000001311302185 0.33000001311302185 0.33000001311302185 0.33000001311302185 0.33000001311302185 0.33000001311302185 0 0 0.05000000074505806 0.125 0.33000001311302185 0.33000001311302185 0.33000001311302185 0.33000001311302185 0.33000001311302185 0.33000001311302185 0.33000001311302185 0.33000001311302185 0.33000001311302185 0.33000001311302185 0 0 0.05000000074505806 0.07500000298023224 0.33000001311302185 0.33000001311302185 0.33000001311302185 0.33000001311302185 0.33000001311302185 0.33000001311302185 0.33000001311302185 0.33000001311302185 0.33000001311302185 0.33000001311302185 0 0 0.02500000037252903 0.07500000298023224 0.33000001311302185 0.33000001311302185 0.33000001311302185 0.33000001311302185 0.33000001311302185 0.33000001311302185 0.33000001311302185 0.33000001311302185 0.33000001311302185 0.33000001311302185 0 0 0.02500000037252903 0.07500000298023224 0.20000000298023224 0.33000001311302185 0.33000001311302185 0.33000001311302185 0.33000001311302185 0.33000001311302185 0.33000001311302185 0.33000001311302185 0.33000001311302185 0.33000001311302185 0 0 0.009999999776482582 0.02500000037252903 0.05000000074505806 0.33000001311302185 0.33000001311302185 0.33000001311302185 0.33000001311302185 0.33000001311302185 0.33000001311302185 0.33000001311302185 0.33000001311302185 0.33000001311302185 0 0 0.009999999776482582 0.02500000037252903 0.05000000074505806 0.10000000149011612 0.10000000149011612 0.10000000149011612 0.10000000149011612 0.10000000149011612 0.10000000149011612 0.10000000149011612 0.10000000149011612 0.10000000149011612 0 0 0 0 0 0 0 0 0 0 0 0 0 0 0]
package /CHMR_Code_pkg/CHMR_Code_dt/SwAddrMethods
  sw addr method CODE: section-type=CODE
  sw addr method CONST: section-type=CONST
  sw addr method VAR: section-type=VAR
