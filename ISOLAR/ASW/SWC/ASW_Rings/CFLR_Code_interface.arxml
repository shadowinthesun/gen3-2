AUTOSAR XML (schema 4-0-3)
package /CFLR_Code_pkg/CFLR_Code_if
  95 x sender receiver interface:
    VeCFLR_Pct_ContctrPWM_Pos_drv
      data VeCFLR_Pct_ContctrPWM_Pos_drv: category=VALUE, sw-calibration-access=READ-ONLY, type=Float
    VeCFLR_Pct_ContctrPWM_Pre_drv
      data VeCFLR_Pct_ContctrPWM_Pre_drv: category=VALUE, sw-calibration-access=READ-ONLY, type=Float
    VeCFLR_b_EnblGPIOPre_drv
      data VeCFLR_b_EnblGPIOPre_drv: category=BOOLEAN, sw-calibration-access=READ-ONLY, type=Boolean
    VeCFLR_b_EnblGPIOPos_drv
      data VeCFLR_b_EnblGPIOPos_drv: category=BOOLEAN, sw-calibration-access=READ-ONLY, type=Boolean
    VeCFLR_b_MainPositive
      data VeCFLR_b_MainPositive: category=BOOLEAN, sw-calibration-access=READ-ONLY, type=Boolean
    VeCFLR_b_MainNegative
      data VeCFLR_b_MainNegative: category=BOOLEAN, sw-calibration-access=READ-ONLY, type=Boolean
    VeCFLR_b_MainPrecharge
      data VeCFLR_b_MainPrecharge: category=BOOLEAN, sw-calibration-access=READ-ONLY, type=Boolean
    VeCFLR_k_NegativeStuckOpen_flt
      data VeCFLR_k_NegativeStuckOpen_flt: category=VALUE, sw-calibration-access=READ-ONLY, type=UInt8
    VeCFLR_k_NegativeStuckClose_flt
      data VeCFLR_k_NegativeStuckClose_flt: category=VALUE, sw-calibration-access=READ-ONLY, type=UInt8
    VeCFLR_k_PositiveStuckOpen_flt
      data VeCFLR_k_PositiveStuckOpen_flt: category=VALUE, sw-calibration-access=READ-ONLY, type=UInt8
    VeCFLR_b_ContactorsClosed
      data VeCFLR_b_ContactorsClosed: category=BOOLEAN, sw-calibration-access=READ-ONLY, type=Boolean
    VeCFLR_b_StartReadPackToLinkV_drv
      data VeCFLR_b_StartReadPackToLinkV_drv: category=BOOLEAN, sw-calibration-access=READ-ONLY, type=Boolean
    VeCFLR_k_PositiveStuckClose_flt
      data VeCFLR_k_PositiveStuckClose_flt: category=VALUE, sw-calibration-access=READ-ONLY, type=UInt8
    VeCFLR_k_DiagCounter
      data VeCFLR_k_DiagCounter: category=VALUE, sw-calibration-access=READ-ONLY, type=UInt8
    VeCFLR_k_PrechargeStuckClose_flt
      data VeCFLR_k_PrechargeStuckClose_flt: category=VALUE, sw-calibration-access=READ-ONLY, type=UInt8
    VeCFLR_k_PrechargeStuckOpen_flt
      data VeCFLR_k_PrechargeStuckOpen_flt: category=VALUE, sw-calibration-access=READ-ONLY, type=UInt8
    VeCFLR_k_MSDOpen_flt
      data VeCFLR_k_MSDOpen_flt: category=VALUE, sw-calibration-access=READ-ONLY, type=UInt8
    VeCFLR_k_PreResistorStuckOpen_flt
      data VeCFLR_k_PreResistorStuckOpen_flt: category=VALUE, sw-calibration-access=READ-ONLY, type=UInt8
    VeCFLR_k_PreChargeFail_flt
      data VeCFLR_k_PreChargeFail_flt: category=VALUE, sw-calibration-access=READ-ONLY, type=UInt8
    VeCFLR_k_UnexpectedContOpen_flt
      data VeCFLR_k_UnexpectedContOpen_flt: category=VALUE, sw-calibration-access=READ-ONLY, type=UInt8
    VeCFLR_k_ConDrvPreCircuit_flt
      data VeCFLR_k_ConDrvPreCircuit_flt: category=VALUE, sw-calibration-access=READ-ONLY, type=UInt8
    VeCFLR_k_ConDrvPosCircuit_flt
      data VeCFLR_k_ConDrvPosCircuit_flt: category=VALUE, sw-calibration-access=READ-ONLY, type=UInt8
    VeCFLR_Pct_ContctrPWM_Heat_drv
      data VeCFLR_Pct_ContctrPWM_Heat_drv: category=VALUE, sw-calibration-access=READ-ONLY, type=Float
    VeCFLR_b_EnblGPIOHeat_drv
      data VeCFLR_b_EnblGPIOHeat_drv: category=BOOLEAN, sw-calibration-access=READ-ONLY, type=Boolean
    VeCFLR_Pct_ContctrPWM_Neg_drv
      data VeCFLR_Pct_ContctrPWM_Neg_drv: category=VALUE, sw-calibration-access=READ-ONLY, type=Float
    VeCFLR_b_EnblGPIONeg_drv
      data VeCFLR_b_EnblGPIONeg_drv: category=BOOLEAN, sw-calibration-access=READ-ONLY, type=Boolean
    VeCFLR_k_NegativeFlt_CAN
      data VeCFLR_k_NegativeFlt_CAN: category=VALUE, sw-calibration-access=READ-ONLY, type=UInt8
    VeCFLR_k_PositiveFlt_CAN
      data VeCFLR_k_PositiveFlt_CAN: category=VALUE, sw-calibration-access=READ-ONLY, type=UInt8
    VeCFLR_k_PrechargeFlt_CAN
      data VeCFLR_k_PrechargeFlt_CAN: category=VALUE, sw-calibration-access=READ-ONLY, type=UInt8
    VeCFLR_b_HeatContactor
      data VeCFLR_b_HeatContactor: category=BOOLEAN, sw-calibration-access=READ-ONLY, type=Boolean
    VeCFLR_k_HVClosingReq
      data VeCFLR_k_HVClosingReq: category=VALUE, sw-calibration-access=READ-ONLY, type=UInt8
    VeCFLR_k_ConDrvHeatCircuit_flt
      data VeCFLR_k_ConDrvHeatCircuit_flt: category=VALUE, sw-calibration-access=READ-ONLY, type=UInt8
    VeCFLR_k_ConDrvNegCircuit_flt
      data VeCFLR_k_ConDrvNegCircuit_flt: category=VALUE, sw-calibration-access=READ-ONLY, type=UInt8
    VeCFLR_k_PreChargeOvCur_flt
      data VeCFLR_k_PreChargeOvCur_flt: category=VALUE, sw-calibration-access=READ-ONLY, type=UInt8
    VeCFLR_k_HeatStuckClose_flt
      data VeCFLR_k_HeatStuckClose_flt: category=VALUE, sw-calibration-access=READ-ONLY, type=UInt8
    VeCFLR_k_HeatStuckOpen_flt
      data VeCFLR_k_HeatStuckOpen_flt: category=VALUE, sw-calibration-access=READ-ONLY, type=UInt8
    VeCFLR_b_HVFaultReady
      data VeCFLR_b_HVFaultReady: category=BOOLEAN, sw-calibration-access=READ-ONLY, type=Boolean
    VeCFLR_k_HeatCntctr1_OverrideAck
      data VeCFLR_k_HeatCntctr1_OverrideAck: category=VALUE, sw-calibration-access=READ-ONLY, type=UInt8
    VeCFLR_k_MainFuse1Open_flt
      data VeCFLR_k_MainFuse1Open_flt: category=VALUE, sw-calibration-access=READ-ONLY, type=UInt8
    VeCFLR_k_MainFuse2Open_flt
      data VeCFLR_k_MainFuse2Open_flt: category=VALUE, sw-calibration-access=READ-ONLY, type=UInt8
    VeCFLR_e_PrechgSt
      data VeCFLR_e_PrechgSt: category=VALUE, sw-calibration-access=READ-ONLY, type=TeCFLR_e_PrechgSt
    VeCFLR_b_HeatClosed
      data VeCFLR_b_HeatClosed: category=BOOLEAN, sw-calibration-access=READ-ONLY, type=Boolean
    VeCFLR_k_ActiveMcuDischarge_flt
      data VeCFLR_k_ActiveMcuDischarge_flt: category=VALUE, sw-calibration-access=READ-ONLY, type=UInt8
    VeCFLR_k_PassiveMcuDischarge_flt
      data VeCFLR_k_PassiveMcuDischarge_flt: category=VALUE, sw-calibration-access=READ-ONLY, type=UInt8
    VeCFLR_k_RelayOverLoad_flt
      data VeCFLR_k_RelayOverLoad_flt: category=VALUE, sw-calibration-access=READ-ONLY, type=UInt8
    VeHVSR_k_EnableContactors
      data VeHVSR_k_EnableContactors: category=VALUE, type=UInt8
    VeVSDR_I_HVCurrent
      data VeVSDR_I_HVCurrent: category=VALUE, type=Float
    VeLLSR_U_KL30Volt
      data VeLLSR_U_KL30Volt: category=VALUE, type=Float
    VeCSCR_U_PackVoltage_out
      data VeCSCR_U_PackVoltage_out: category=VALUE, type=Float
    VeCSCR_U_LinkP2PackVolt_out
      data VeCSCR_U_LinkP2PackVolt_out: category=VALUE, type=Float
    VeLLSR_U_LS_OSMNeg
      data VeLLSR_U_LS_OSMNeg: category=VALUE, type=Float
    VeLLSR_b_LS_OSMNeg_Inv
      data VeLLSR_b_LS_OSMNeg_Inv: category=BOOLEAN, type=Boolean
    VeLLSR_U_HS_OSMPre
      data VeLLSR_U_HS_OSMPre: category=VALUE, type=Float
    VeLLSR_b_HS_OSMPre_Inv
      data VeLLSR_b_HS_OSMPre_Inv: category=BOOLEAN, type=Boolean
    VeLLSR_U_LS_OSMPre
      data VeLLSR_U_LS_OSMPre: category=VALUE, type=Float
    VeLLSR_b_LS_OSMPre_Inv
      data VeLLSR_b_LS_OSMPre_Inv: category=BOOLEAN, type=Boolean
    VeLLSR_I_ShuntCurrPre
      data VeLLSR_I_ShuntCurrPre: category=VALUE, type=Float
    VeLLSR_b_ConDrvPreCircuit_flt
      data VeLLSR_b_ConDrvPreCircuit_flt: category=BOOLEAN, type=Boolean
    VeLLSR_I_ShuntCurrNeg
      data VeLLSR_I_ShuntCurrNeg: category=VALUE, type=Float
    VeLLSR_b_ShuntCurrNeg_Inv
      data VeLLSR_b_ShuntCurrNeg_Inv: category=BOOLEAN, type=Boolean
    VeLLSR_U_HS_OSMNeg
      data VeLLSR_U_HS_OSMNeg: category=VALUE, type=Float
    VeLLSR_b_HS_OSMNeg_Inv
      data VeLLSR_b_HS_OSMNeg_Inv: category=BOOLEAN, type=Boolean
    VeLLSR_I_ShuntCurrPos
      data VeLLSR_I_ShuntCurrPos: category=VALUE, type=Float
    VeLLSR_b_ConDrvPosCircuit_flt
      data VeLLSR_b_ConDrvPosCircuit_flt: category=BOOLEAN, type=Boolean
    VeLLSR_U_LS_OSMPos
      data VeLLSR_U_LS_OSMPos: category=VALUE, type=Float
    VeLLSR_b_LS_OSMPos_Inv
      data VeLLSR_b_LS_OSMPos_Inv: category=BOOLEAN, type=Boolean
    VeLLSR_U_HS_OSMPos
      data VeLLSR_U_HS_OSMPos: category=VALUE, type=Float
    VeLLSR_b_HS_OSMPos_Inv
      data VeLLSR_b_HS_OSMPos_Inv: category=BOOLEAN, type=Boolean
    VeLLSR_b_HeatFlmVoltage_Inv
      data VeLLSR_b_HeatFlmVoltage_Inv: category=BOOLEAN, type=Boolean
    VeCSCR_U_LinkN2PackVolt_out
      data VeCSCR_U_LinkN2PackVolt_out: category=VALUE, type=Float
    VeCSCR_k_LinkN2PackVolt_flt
      data VeCSCR_k_LinkN2PackVolt_flt: category=VALUE, type=UInt8
    VeCSCR_k_PackVoltage_flt
      data VeCSCR_k_PackVoltage_flt: category=VALUE, type=UInt8
    VeCSCR_k_LinkP2PackVolt_flt
      data VeCSCR_k_LinkP2PackVolt_flt: category=VALUE, type=UInt8
    VeDHSR_b_NoPrecharge
      data VeDHSR_b_NoPrecharge: category=BOOLEAN, type=Boolean
    VeLLSR_b_ClearDTC
      data VeLLSR_b_ClearDTC: category=BOOLEAN, type=Boolean
    VeLLSR_t_SleepTime
      data VeLLSR_t_SleepTime: category=VALUE, type=Float
    VeLLSR_b_SleepTimeReady
      data VeLLSR_b_SleepTimeReady: category=BOOLEAN, type=Boolean
    VeLLSR_U_LS_OSMHeat
      data VeLLSR_U_LS_OSMHeat: category=VALUE, type=Float
    VeLLSR_U_HS_OSMHeat
      data VeLLSR_U_HS_OSMHeat: category=VALUE, type=Float
    VeLLSR_I_ShuntCurrHeat
      data VeLLSR_I_ShuntCurrHeat: category=VALUE, type=Float
    VeLLSR_b_ConDrvHeatCircuit_flt
      data VeLLSR_b_ConDrvHeatCircuit_flt: category=BOOLEAN, type=Boolean
    VeLLSR_b_ConDrvNegCircuit_flt
      data VeLLSR_b_ConDrvNegCircuit_flt: category=BOOLEAN, type=Boolean
    VeCSCR_U_Heat2PackVolt_out
      data VeCSCR_U_Heat2PackVolt_out: category=VALUE, type=Float
    VeCSCR_k_Heat2PackVolt_flt
      data VeCSCR_k_Heat2PackVolt_flt: category=VALUE, type=UInt8
    VeCANR_U_TMFUdcAct_out
      data VeCANR_U_TMFUdcAct_out: category=VALUE, type=Float
    VeCANR_U_ISGFUdcAct_out
      data VeCANR_U_ISGFUdcAct_out: category=VALUE, type=Float
    VeCANR_U_TMRVoltageHV_out
      data VeCANR_U_TMRVoltageHV_out: category=VALUE, type=Float
    VeLLSR_k_HeatCntctr1_Override
      data VeLLSR_k_HeatCntctr1_Override: category=VALUE, type=UInt8
    VeHVSR_e_StateMode
      data VeHVSR_e_StateMode: category=VALUE, type=TeHVSR_e_StateMode
    VeHVSR_k_EnableHeatCircuitContactors
      data VeHVSR_k_EnableHeatCircuitContactors: category=VALUE, type=UInt8
    VeLLSR_b_MainNeg_Inv
      data VeLLSR_b_MainNeg_Inv: category=BOOLEAN, type=Boolean
    VeLLSR_b_MainNeg_Status
      data VeLLSR_b_MainNeg_Status: category=BOOLEAN, type=Boolean
    VeLLSR_b_MainNeg_Flt
      data VeLLSR_b_MainNeg_Flt: category=BOOLEAN, type=Boolean
    VeLLSR_k_TMFComLoss_flt
      data VeLLSR_k_TMFComLoss_flt: category=VALUE, type=UInt8
    VeLLSR_k_TMRComLoss_flt
      data VeLLSR_k_TMRComLoss_flt: category=VALUE, type=UInt8
package /CalibrationComponents
  parameter interface CFLR_if
    192 x parameter data prototype, all with sw-calibration-access=READ-WRITE:
      KaCFLR_t_PreChTimer: category=ARRAY, type=rt_Array_Float_5
      KeCFLR_I_CntctrCurrHoldHeat: category=VALUE, type=Float
      KeCFLR_I_CntctrCurrHoldNeg: category=VALUE, type=Float
      KeCFLR_I_CntctrCurrHoldPos: category=VALUE, type=Float
      KeCFLR_I_CntctrCurrHoldPre: category=VALUE, type=Float
      KeCFLR_I_MaxCurrOpenCntctr: category=VALUE, type=Float
      KeCFLR_I_MaxR3Current: category=VALUE, type=Float
      KeCFLR_I_MinCurrOpenCntctr: category=VALUE, type=Float
      KeCFLR_I_MinR3Current: category=VALUE, type=Float
      KeCFLR_I_OverCurrentThresh: category=VALUE, type=Float
      KeCFLR_I_PowDownCurrentThresh: category=VALUE, type=Float
      KeCFLR_I_ZeroCurrentThreshholdLw: category=VALUE, type=Float
      KeCFLR_I_ZeroCurrentThreshholdUp: category=VALUE, type=Float
      KeCFLR_K_KL30VoltageFactorLower: category=VALUE, type=Float
      KeCFLR_K_KL30VoltageFactorUpper: category=VALUE, type=Float
      KeCFLR_Pct_ContctrPWM_Fsp_drv_Val: category=VALUE, type=Float
      KeCFLR_Pct_ContctrPWM_Neg_drv_Val: category=VALUE, type=Float
      KeCFLR_Pct_ContctrPWM_Pre_drv_Val: category=VALUE, type=Float
      KeCFLR_Pct_SetContctrPWM_PIDPos_Val: category=VALUE, type=Float
      KeCFLR_R_PosResistanceLowLim: category=VALUE, type=Float
      KeCFLR_R_PosResistanceUpLim: category=VALUE, type=Float
      KeCFLR_R_PreResistanceLowLim: category=VALUE, type=Float
      KeCFLR_R_PreResistanceUpLim: category=VALUE, type=Float
      KeCFLR_U_GroundVoltageHigh: category=VALUE, type=Float
      KeCFLR_U_GroundVoltageLow: category=VALUE, type=Float
      KeCFLR_U_LinkLessThanPack: category=VALUE, type=Float
      KeCFLR_U_MaxOSM_Voltage: category=VALUE, type=Float
      KeCFLR_U_MaxVolt4HS_OSMPos: category=VALUE, type=Float
      KeCFLR_U_MaxVolt4HS_OSMPre: category=VALUE, type=Float
      KeCFLR_U_MaxVolt4LS_OSMPos: category=VALUE, type=Float
      KeCFLR_U_MaxVolt4LS_OSMPre: category=VALUE, type=Float
      KeCFLR_U_McuDischgThreshhold: category=VALUE, type=Float
      KeCFLR_U_MinCoilVoltageAllowed: category=VALUE, type=Float
      KeCFLR_U_MinOSM_Voltage: category=VALUE, type=Float
      KeCFLR_U_MinVolt4HS_OSMPos: category=VALUE, type=Float
      KeCFLR_U_MinVolt4HS_OSMPre: category=VALUE, type=Float
      KeCFLR_U_MinVolt4LS_OSMPos: category=VALUE, type=Float
      KeCFLR_U_MinVolt4LS_OSMPre: category=VALUE, type=Float
      KeCFLR_U_NegConClosedThreshhold: category=VALUE, type=Float
      KeCFLR_U_PowerdiffThreshhold: category=VALUE, type=Float
      KeCFLR_U_withPowerThreshhold: category=VALUE, type=Float
      KeCFLR_r_PrechargeTrGain: category=VALUE, type=Float
      KeCFLR_t_ActuatorWaitTime: category=VALUE, type=Float
      KeCFLR_t_CoilVoltageDebouce: category=VALUE, type=Float
      KeCFLR_t_ContactorBasicDiffDebounceOffTime: category=VALUE, type=Float
      KeCFLR_t_ContactorBasicDiffDebounceOnTime: category=VALUE, type=Float
      KeCFLR_t_ContactorDRV_Ts: category=VALUE, type=Float
      KeCFLR_t_ContactorDiagFncCallRate: category=VALUE, type=Float
      KeCFLR_t_ContactorDrivePIDCatchup: category=VALUE, type=Float
      KeCFLR_t_ContactorStateMachineTimeout{1..5}: category=VALUE, type=Float
      KeCFLR_t_ContctrErrorDbnc: category=VALUE, type=Float
      KeCFLR_t_DebounceTimeforCurrValidity: category=VALUE, type=Float
      KeCFLR_t_InitW8Time: category=VALUE, type=Float
      KeCFLR_t_MaxTimeB4ContactForcedOpen: category=VALUE, type=Float
      KeCFLR_t_MaxTimeCurrCheck: category=VALUE, type=Float
      KeCFLR_t_MaxTimeInitState: category=VALUE, type=Float
      KeCFLR_t_MaxTimeVoltCheck: category=VALUE, type=Float
      KeCFLR_t_MaxTimeVoltDiffCheck: category=VALUE, type=Float
      KeCFLR_t_MaxWaitTimeNegConOpn: category=VALUE, type=Float
      KeCFLR_t_MaxWaitTimePosConClos: category=VALUE, type=Float
      KeCFLR_t_MaxWaitTimePosConOpn: category=VALUE, type=Float
      KeCFLR_t_MinTimeAlwdB4CurrCheck: category=VALUE, type=Float
      KeCFLR_t_MinTimeInitState: category=VALUE, type=Float
      KeCFLR_t_MinTimeinGPIO_State: category=VALUE, type=Float
      KeCFLR_t_PreChFaulRst: category=VALUE, type=Float
      KeCFLR_t_PreChFaulSet: category=VALUE, type=Float
      KeCFLR_t_PreChOverCurrDebounceOnTime: category=VALUE, type=Float
      KeCFLR_t_SM_Timer: category=VALUE, type=Float
      KeCFLR_t_Test1MaxWait: category=VALUE, type=Float
      KeCFLR_t_Test1MinWait: category=VALUE, type=Float
      KeCFLR_t_Test21MaxWait: category=VALUE, type=Float
      KeCFLR_t_Test21MinWait: category=VALUE, type=Float
      KeCFLR_t_Test22MaxWait: category=VALUE, type=Float
      KeCFLR_t_Test22MinWait: category=VALUE, type=Float
      KeCFLR_t_Test2MaxWait: category=VALUE, type=Float
      KeCFLR_t_Test2MinWait: category=VALUE, type=Float
      KeCFLR_t_Test31MaxWait: category=VALUE, type=Float
      KeCFLR_t_Test31MinWait: category=VALUE, type=Float
      KeCFLR_t_Test32MaxWait: category=VALUE, type=Float
      KeCFLR_t_Test32MinWait: category=VALUE, type=Float
      KeCFLR_t_Test33MaxWait: category=VALUE, type=Float
      KeCFLR_t_Test33MinWait: category=VALUE, type=Float
      KeCFLR_t_Test41MaxWait: category=VALUE, type=Float
      KeCFLR_t_Test41MinWait: category=VALUE, type=Float
      KeCFLR_t_Test42MaxWait: category=VALUE, type=Float
      KeCFLR_Cnt_ClrPrechgProtectTime1: category=VALUE, type=UInt16
      KeCFLR_Cnt_ClrPrechgProtectTime2: category=VALUE, type=UInt16
      KeCFLR_Cnt_PowDownTimeThresh: category=VALUE, type=UInt16
      KeCFLR_e_PrechgSt_Val: category=VALUE, type=TeCFLR_e_PrechgSt
      KeCFLR_Pct_ContctrPWM_Pre_drv_En: category=BOOLEAN, type=Boolean
      KeCFLR_Pct_SetContctrPWM_PIDPos_En: category=BOOLEAN, type=Boolean
      KeCFLR_b_ActiveMcuDischarge_En: category=BOOLEAN, type=Boolean
      KeCFLR_b_CloseHeat_En: category=BOOLEAN, type=Boolean
      KeCFLR_b_CloseHeat_Val: category=BOOLEAN, type=Boolean
      KeCFLR_b_CloseNeg_En: category=BOOLEAN, type=Boolean
      KeCFLR_b_CloseNeg_Val: category=BOOLEAN, type=Boolean
      KeCFLR_b_ClosePos_En: category=BOOLEAN, type=Boolean
      KeCFLR_b_ClosePos_Val: category=BOOLEAN, type=Boolean
      KeCFLR_b_ClosePre_En: category=BOOLEAN, type=Boolean
      KeCFLR_b_ClosePre_Val: category=BOOLEAN, type=Boolean
      KeCFLR_b_ConDrvHeatCircuit_flt_En: category=BOOLEAN, type=Boolean
      KeCFLR_b_ConDrvNegCircuit_flt_En: category=BOOLEAN, type=Boolean
      KeCFLR_b_ConDrvPosCircuit_flt_En: category=BOOLEAN, type=Boolean
      KeCFLR_b_ConDrvPreCircuit_flt_En: category=BOOLEAN, type=Boolean
      KeCFLR_b_ContactorsClosed_En: category=BOOLEAN, type=Boolean
      KeCFLR_b_ContactorsClosed_Val: category=BOOLEAN, type=Boolean
      KeCFLR_b_ContctrPWM_Fsp_drv_En: category=BOOLEAN, type=Boolean
      KeCFLR_b_ContctrPWM_Neg_drv_En: category=BOOLEAN, type=Boolean
      KeCFLR_b_EnableContactorsDiag_En: category=BOOLEAN, type=Boolean
      KeCFLR_b_EnableContactorsDiag_Val: category=BOOLEAN, type=Boolean
      KeCFLR_b_EnblGPIOHeat_drv_En: category=BOOLEAN, type=Boolean
      KeCFLR_b_EnblGPIOHeat_drv_Val: category=BOOLEAN, type=Boolean
      KeCFLR_b_EnblGPIONeg_drv_En: category=BOOLEAN, type=Boolean
      KeCFLR_b_EnblGPIONeg_drv_Val: category=BOOLEAN, type=Boolean
      KeCFLR_b_EnblGPIOPos_drv_En: category=BOOLEAN, type=Boolean
      KeCFLR_b_EnblGPIOPos_drv_Val: category=BOOLEAN, type=Boolean
      KeCFLR_b_EnblGPIOPre_drv_En: category=BOOLEAN, type=Boolean
      KeCFLR_b_EnblGPIOPre_drv_Val: category=BOOLEAN, type=Boolean
      KeCFLR_b_Force2InitNeg: category=BOOLEAN, type=Boolean
      KeCFLR_b_ForceOpenContactors: category=BOOLEAN, type=Boolean
      KeCFLR_b_HVClosingReq_En: category=BOOLEAN, type=Boolean
      KeCFLR_b_HVFaultReady_En: category=BOOLEAN, type=Boolean
      KeCFLR_b_HVFaultReady_Val: category=BOOLEAN, type=Boolean
      KeCFLR_b_HeatClosed_En: category=BOOLEAN, type=Boolean
      KeCFLR_b_HeatClosed_Val: category=BOOLEAN, type=Boolean
      KeCFLR_b_HeatCntctr1_OverrideAck_En: category=BOOLEAN, type=Boolean
      KeCFLR_b_HeatConClosed_En: category=BOOLEAN, type=Boolean
      KeCFLR_b_HeatConClosed_Val: category=BOOLEAN, type=Boolean
      KeCFLR_b_HeatStuckClose_flt_En: category=BOOLEAN, type=Boolean
      KeCFLR_b_HeatStuckOpen_flt_En: category=BOOLEAN, type=Boolean
      KeCFLR_b_MSDOpenFlt_En: category=BOOLEAN, type=Boolean
      KeCFLR_b_MainFuse1Open_En: category=BOOLEAN, type=Boolean
      KeCFLR_b_MainFuse2Open_En: category=BOOLEAN, type=Boolean
      KeCFLR_b_MainNegative_En: category=BOOLEAN, type=Boolean
      KeCFLR_b_MainNegative_Val: category=BOOLEAN, type=Boolean
      KeCFLR_b_MainPositive_En: category=BOOLEAN, type=Boolean
      KeCFLR_b_MainPositive_Val: category=BOOLEAN, type=Boolean
      KeCFLR_b_MainPrecharge_En: category=BOOLEAN, type=Boolean
      KeCFLR_b_MainPrecharge_Val: category=BOOLEAN, type=Boolean
      KeCFLR_b_NegativeFlt_CAN_En: category=BOOLEAN, type=Boolean
      KeCFLR_b_NegativeStuckCloseFlt_En: category=BOOLEAN, type=Boolean
      KeCFLR_b_NegativeStuckOpenFlt_En: category=BOOLEAN, type=Boolean
      KeCFLR_b_PassiveMcuDischarge_En: category=BOOLEAN, type=Boolean
      KeCFLR_b_PositiveFlt_CAN_En: category=BOOLEAN, type=Boolean
      KeCFLR_b_PositiveStuckCloseFlt_En: category=BOOLEAN, type=Boolean
      KeCFLR_b_PositiveStuckOpenFlt_En: category=BOOLEAN, type=Boolean
      KeCFLR_b_PreChargeFailFlt_En: category=BOOLEAN, type=Boolean
      KeCFLR_b_PreChargeOvCur_flt_En: category=BOOLEAN, type=Boolean
      KeCFLR_b_PreResistorStuckOpenFlt_En: category=BOOLEAN, type=Boolean
      KeCFLR_b_PrechargeFlt_CAN_En: category=BOOLEAN, type=Boolean
      KeCFLR_b_PrechargeStuckCloseFlt_En: category=BOOLEAN, type=Boolean
      KeCFLR_b_PrechargeStuckOpenFlt_En: category=BOOLEAN, type=Boolean
      KeCFLR_b_RelayOverLoad_En: category=BOOLEAN, type=Boolean
      KeCFLR_b_StartReadPackToLinkV_drv_En: category=BOOLEAN, type=Boolean
      KeCFLR_b_StartReadPackToLinkV_drv_Val: category=BOOLEAN, type=Boolean
      KeCFLR_b_UnexpectedContOpen_flt_En: category=BOOLEAN, type=Boolean
      KeCFLR_e_PrechgSt_En: category=BOOLEAN, type=Boolean
      KeCFLR_k_DiagCounterCmd_En: category=BOOLEAN, type=Boolean
      KeCFLR_Cnt_PreChgProtect: category=VALUE, type=UInt8
      KeCFLR_k_ActiveMcuDischarge_Val: category=VALUE, type=UInt8
      KeCFLR_k_ConDrvHeatCircuit_flt_Val: category=VALUE, type=UInt8
      KeCFLR_k_ConDrvNegCircuit_flt_Val: category=VALUE, type=UInt8
      KeCFLR_k_ConDrvPosCircuit_flt_Val: category=VALUE, type=UInt8
      KeCFLR_k_ConDrvPreCircuit_flt_Val: category=VALUE, type=UInt8
      KeCFLR_k_DiagCounterCmd_Val: category=VALUE, type=UInt8
      KeCFLR_k_HVClosingReq_Val: category=VALUE, type=UInt8
      KeCFLR_k_HeatCntctr1_OverrideAck_Val: category=VALUE, type=UInt8
      KeCFLR_k_HeatStuckClose_flt_Val: category=VALUE, type=UInt8
      KeCFLR_k_HeatStuckOpen_flt_Val: category=VALUE, type=UInt8
      KeCFLR_k_MSDOpenFlt_Val: category=VALUE, type=UInt8
      KeCFLR_k_MainFuse1Open_Val: category=VALUE, type=UInt8
      KeCFLR_k_MainFuse2Open_Val: category=VALUE, type=UInt8
      KeCFLR_k_NegativeFlt_CAN_Val: category=VALUE, type=UInt8
      KeCFLR_k_NegativeStuckCloseFlt_Val: category=VALUE, type=UInt8
      KeCFLR_k_NegativeStuckOpenFlt_Val: category=VALUE, type=UInt8
      KeCFLR_k_PassiveMcuDischarge_Val: category=VALUE, type=UInt8
      KeCFLR_k_PositiveFlt_CAN_Val: category=VALUE, type=UInt8
      KeCFLR_k_PositiveStuckCloseFlt_Val: category=VALUE, type=UInt8
      KeCFLR_k_PositiveStuckOpenFlt_Val: category=VALUE, type=UInt8
      KeCFLR_k_PreChargeFailFlt_Val: category=VALUE, type=UInt8
      KeCFLR_k_PreChargeOvCur_flt_Val: category=VALUE, type=UInt8
      KeCFLR_k_PreResistorStuckOpenFlt_Val: category=VALUE, type=UInt8
      KeCFLR_k_PrechargeFlt_CAN_Val: category=VALUE, type=UInt8
      KeCFLR_k_PrechargeStuckCloseFlt_Val: category=VALUE, type=UInt8
      KeCFLR_k_PrechargeStuckOpenFlt_Val: category=VALUE, type=UInt8
      KeCFLR_k_RelayOverLoad_Val: category=VALUE, type=UInt8
      KeCFLR_k_UnexpectedContOpen_flt_Val: category=VALUE, type=UInt8
      KeCFLR_n_NumofFails: category=VALUE, type=UInt8
