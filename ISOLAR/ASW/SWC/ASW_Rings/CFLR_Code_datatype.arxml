AUTOSAR XML (schema 4-0-3)
standard types defined: UInt8, Float, Boolean, UInt16, uint8, float32, boolean, uint16
package /CFLR_Code_pkg/CFLR_Code_dt
  unit NoUnit: factor-si-to-unit=1, offset-si-to-unit=0
  impl type TeHVSR_e_StateMode: category=VALUE, base-type=uint8
  impl type TeCFLR_e_PrechgSt: category=VALUE, base-type=uint8
  impl type rt_Array_Float_5: category=ARRAY
    element rt_Array_Float_5: array-size=5, array-size-semantics=FIXED-SIZE, implementation-data-type=Float
  impl type TeCFLR_e_Contactor_SystemSts: category=VALUE, base-type=uint8
package /CFLR_Code_pkg/CFLR_Code_dt/ApplDataTypes
  5 x app type, all with sw-calibration-access=READ-WRITE:
    UInt8: category=VALUE, compu {identical}, range phys 0..255
    Float: category=VALUE, compu {identical}, range phys -INF..INF
    Boolean: category=BOOLEAN, compu {0=FALSE, 1=TRUE}
    TeHVSR_e_StateMode: category=VALUE, compu {0=CeHVSR_e_StateModeReserved, 1=CeHVSR_e_StateModeInitial, 2=CeHVSR_e_StateModeStandBy, 3=CeHVSR_e_StateModePrecharge, 4=CeHVSR_e_StateModeNormalDischarge, 5=CeHVSR_e_StateModeWarningPowerReduction, 6=CeHVSR_e_StateModePowerReduction, 7=CeHVSR_e_StateModePreChargeFailed, 8=CeHVSR_e_StateModePowerHoldMode, 9=CeHVSR_e_StateModeShutdown, 10=CeHVSR_e_StateModeServiceMode, 11=CeHVSR_e_StateModeReady, 12=CeHVSR_e_StateModeAC_ChargeMode, 13=CeHVSR_e_StateModeEndOfCharge, 14=CeHVSR_e_StateModeDC_ChargeMode, 15=CeHVSR_e_StateModeSystemErr, 16=CeHVSR_e_StateModeTempChargState, 17=CeHVSR_e_StateModeHeatPreChgState, 18=CeHVSR_e_StateModeHeatingState, 19=CeHVSR_e_StateModeHeatFinishState}
    TeCFLR_e_PrechgSt: category=VALUE, compu {0=CeCFLR_e_PrechgDefault, 1=CeCFLR_e_Prechging, 2=CeCFLR_e_PrechgSuceed, 3=CeCFLR_e_PrechgFail, 4=CeCFLR_e_PrechgLocked}
  application array data type rt_Array_Float_5: category=ARRAY, sw-calibration-access=READ-WRITE
    element rt_Array_Float_5: category=VALUE, type=Float, array-size-semantics=FIXED-SIZE, max-number-of-elements=5
  app type UInt16: category=VALUE, sw-calibration-access=READ-WRITE, compu {identical}, range phys 0..65535
  app type TeCFLR_e_Contactor_SystemSts:
    category=VALUE
    sw-calibration-access=READ-WRITE
    compu {0=CeCFLR_e_ContStsDefault, 1=CeCFLR_e_ContStsGPIO_Control, 2=CeCFLR_e_CntctrVoltCheck, 3=CeCFLR_e_ContStatePWM_Set1, 4=CeCFLR_e_ContStatePWM_Set2, 5=CeCFLR_e_ErrorDetected, 6=CeCFLR_e_ContactorClosed, 7=CeCFLR_e_CoilVoltage, 8=CeCFLR_e_CurrentValidityTemp, 9=CeCFLR_e_CurrentValidity, 10=CeCFLR_e_ContactorOpen, 11=CeCFLR_e_FaultOpen, 12=CeCFLR_e_NormalOpen}
package /CFLR_Code_pkg/CFLR_Code_dt/DataTypeMappings
  data type mapping set CFLR_CodeDataTypeMappingsSet
    data-type-maps:
      application-data-type=UInt8, implementation-data-type=UInt8
      application-data-type=Float, implementation-data-type=Float
      application-data-type=Boolean, implementation-data-type=Boolean
      application-data-type=TeHVSR_e_StateMode, implementation-data-type=TeHVSR_e_StateMode
      application-data-type=TeCFLR_e_PrechgSt, implementation-data-type=TeCFLR_e_PrechgSt
      application-data-type=rt_Array_Float_5, implementation-data-type=rt_Array_Float_5
      application-data-type=UInt16, implementation-data-type=UInt16
      application-data-type=TeCFLR_e_Contactor_SystemSts, implementation-data-type=TeCFLR_e_Contactor_SystemSts
package /CFLR_Code_pkg/CFLR_Code_dt/SwAddrMethods
  sw addr method CODE: section-type=CODE
  sw addr method CONST: section-type=CONST
  sw addr method VAR: section-type=VAR
