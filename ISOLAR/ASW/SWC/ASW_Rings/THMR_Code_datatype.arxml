AUTOSAR XML (schema 4-0-3)
standard types defined: Boolean, UInt8, Float, uint8, boolean, float32
package /THMR_Code_pkg/THMR_Code_dt
  impl type TeHVSR_e_StateMode: category=VALUE, base-type=uint8
  unit NoUnit: factor-si-to-unit=1, offset-si-to-unit=0
  impl type TeCHMR_e_OBC_ChrgEnable: category=VALUE, base-type=uint8
  impl type rt_Array_Float_16: category=ARRAY
    element rt_Array_Float_16: array-size=16, array-size-semantics=FIXED-SIZE, implementation-data-type=Float
  impl type rt_Array_Boolean_16: category=ARRAY
    element rt_Array_Boolean_16: array-size=16, array-size-semantics=FIXED-SIZE, implementation-data-type=Boolean
  impl type rt_Array_Float_2: category=ARRAY
    element rt_Array_Float_2: array-size=2, array-size-semantics=FIXED-SIZE, implementation-data-type=Float
package /THMR_Code_pkg/THMR_Code_dt/ApplDataTypes
  5 x app type, all with sw-calibration-access=READ-WRITE:
    TeHVSR_e_StateMode: category=VALUE, compu {0=CeHVSR_e_StateModeReserved, 1=CeHVSR_e_StateModeInitial, 2=CeHVSR_e_StateModeStandBy, 3=CeHVSR_e_StateModePrecharge, 4=CeHVSR_e_StateModeNormalDischarge, 5=CeHVSR_e_StateModeWarningPowerReduction, 6=CeHVSR_e_StateModePowerReduction, 7=CeHVSR_e_StateModePreChargeFailed, 8=CeHVSR_e_StateModePowerHoldMode, 9=CeHVSR_e_StateModeShutdown, 10=CeHVSR_e_StateModeServiceMode, 11=CeHVSR_e_StateModeReady, 12=CeHVSR_e_StateModeAC_ChargeMode, 13=CeHVSR_e_StateModeEndOfCharge, 14=CeHVSR_e_StateModeDC_ChargeMode, 15=CeHVSR_e_StateModeSystemErr, 16=CeHVSR_e_StateModeTempChargState, 17=CeHVSR_e_StateModeHeatPreChgState, 18=CeHVSR_e_StateModeHeatingState, 19=CeHVSR_e_StateModeHeatFinishState}
    Boolean: category=BOOLEAN, compu {0=FALSE, 1=TRUE}
    UInt8: category=VALUE, compu {identical}, range phys 0..255
    Float: category=VALUE, compu {identical}, range phys -INF..INF
    TeCHMR_e_OBC_ChrgEnable: category=VALUE, compu {0=CeCHMR_e_OBC_ChrgEnblDefault, 1=CeCHMR_e_OBC_ChrgEnableReserved1, 2=CeCHMR_e_OBC_ChrgEnableReserved2, 3=CeCHMR_e_OBC_ChrgEnableReserved3, 4=CeCHMR_e_OBC_ChrgEnblAlwCharge, 5=CeCHMR_e_OBC_ChrgEnblAlwDischarge, 6=CeCHMR_e_OBC_ChrgEnblChrgBattHeating, 7=CeCHMR_e_OBC_ChrgEnblBatteryCooling, 8=CeCHMR_e_OBC_ChrgEnableReserved4, 9=CeCHMR_e_OBC_ChrgEnableReserved5, 10=CeCHMR_e_OBC_ChrgEnblDischNotAllow, 11=CeCHMR_e_OBC_ChrgEnblEndOfChrg, 12=CeCHMR_e_OBC_ChrgEnblReserved, 13=CeCHMR_e_OBC_ChrgEnblAlwVTOLDischarge, 14=CeCHMR_e_OBC_ChrgEnblAlwVTOVDischarge}
  application array data type rt_Array_Float_16: category=ARRAY, sw-calibration-access=READ-WRITE
    element rt_Array_Float_16: category=VALUE, type=Float, array-size-semantics=FIXED-SIZE, max-number-of-elements=16
  application array data type rt_Array_Boolean_16: category=ARRAY, sw-calibration-access=READ-WRITE
    element rt_Array_Boolean_16: category=BOOLEAN, type=Boolean, array-size-semantics=FIXED-SIZE, max-number-of-elements=16
  application array data type rt_Array_Float_2: category=ARRAY, sw-calibration-access=READ-WRITE
    element rt_Array_Float_2: category=VALUE, type=Float, array-size-semantics=FIXED-SIZE, max-number-of-elements=2
package /THMR_Code_pkg/THMR_Code_dt/DataTypeMappings
  data type mapping set THMR_CodeDataTypeMappingsSet
    data-type-maps:
      application-data-type=TeHVSR_e_StateMode, implementation-data-type=TeHVSR_e_StateMode
      application-data-type=Boolean, implementation-data-type=Boolean
      application-data-type=UInt8, implementation-data-type=UInt8
      application-data-type=Float, implementation-data-type=Float
      application-data-type=TeCHMR_e_OBC_ChrgEnable, implementation-data-type=TeCHMR_e_OBC_ChrgEnable
      application-data-type=rt_Array_Float_16, implementation-data-type=rt_Array_Float_16
      application-data-type=rt_Array_Boolean_16, implementation-data-type=rt_Array_Boolean_16
      application-data-type=rt_Array_Float_2, implementation-data-type=rt_Array_Float_2
package /THMR_Code_pkg/THMR_Code_dt/SwAddrMethods
  sw addr method CODE: section-type=CODE
  sw addr method CONST: section-type=CONST
  sw addr method VAR: section-type=VAR
