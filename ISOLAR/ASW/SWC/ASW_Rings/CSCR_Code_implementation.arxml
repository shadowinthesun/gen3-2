AUTOSAR XML (schema 4-0-3)
package /CSCR_Code_pkg/CSCR_Code_imp
  swc implementation CSCR_Code: programming-language=C, sw-version=1.295.1, used-code-generator=Embedded Coder 7.2 (R2019a) 23-Nov-2018, vendor-id=0, behavior=CSCR_Code
    code-descriptors:
      code Code
        artifact-descriptors:
          short-label=CSCR_Code_c, category=SWSRC
          short-label=ASW_Types_h, category=SWHDR
          short-label=ASW_Types_template_h, category=SWHDR
          short-label=CSCR_Code_h, category=SWHDR
          short-label=CSCR_Code_private_h, category=SWHDR
          short-label=CSCR_Code_types_h, category=SWHDR
          short-label=MatlabDataArray_hpp, category=SWHDR
          short-label=MatlabEngine_hpp, category=SWHDR
          short-label=MatlabExecutionInterface_hpp, category=SWHDR
          short-label=bio_sig_h, category=SWHDR
          short-label=blas_h, category=SWHDR
          short-label=blascompat32_h, category=SWHDR
          short-label=cg_matrx_h, category=SWHDR
          short-label=cg_sfun_h, category=SWHDR
          short-label=cgxert_h, category=SWHDR
          short-label=covrt_h, category=SWHDR
          short-label=dt_info_h, category=SWHDR
          short-label=emlrt_h, category=SWHDR
          short-label=engine_h, category=SWHDR
          short-label=ext_share_h, category=SWHDR
          short-label=ext_svr_h, category=SWHDR
          short-label=ext_svr_transport_h, category=SWHDR
          short-label=ext_test_h, category=SWHDR
          short-label=ext_types_h, category=SWHDR
          short-label=ext_work_h, category=SWHDR
          short-label=fintrf_h, category=SWHDR
          short-label=fixedpoint_h, category=SWHDR
          short-label=fixpoint_spec_h, category=SWHDR
          short-label=io64_h, category=SWHDR
          short-label=lapack_h, category=SWHDR
          short-label=lapacke_h, category=SWHDR
          short-label=lapacke_config_h, category=SWHDR
          short-label=libmwjpegreader_h, category=SWHDR
          short-label=libmwrgb2gray_tbb_h, category=SWHDR
          short-label=libmwrgb2hsv_tbb_h, category=SWHDR
          short-label=mat_h, category=SWHDR
          short-label=matrix_h, category=SWHDR
          short-label=mdl_info_h, category=SWHDR
          short-label=mem_mgr_h, category=SWHDR
          short-label=mex_h, category=SWHDR
          short-label=mex_hpp, category=SWHDR
          short-label=mexAdapter_hpp, category=SWHDR
          short-label=mwmathutil_h, category=SWHDR
          short-label=mwstringutil_h, category=SWHDR
          short-label=odesup_h, category=SWHDR
          short-label=polygonBoolean_h, category=SWHDR
          short-label=pt_info_h, category=SWHDR
          short-label=rt_logging_h, category=SWHDR
          short-label=rt_logging_mmi_h, category=SWHDR
          short-label=rt_math_h, category=SWHDR
          short-label=rt_matrx_h, category=SWHDR
          short-label=rt_mxclassid_h, category=SWHDR
          short-label=rt_sim_h, category=SWHDR
          short-label=rtmcmacros_h, category=SWHDR
          short-label=rtmmacros_h, category=SWHDR
          short-label=rtsplntypes_h, category=SWHDR
          short-label=rtw_capi_h, category=SWHDR
          short-label=rtw_capi_examples_h, category=SWHDR
          short-label=rtw_continuous_h, category=SWHDR
          short-label=rtw_extmode_h, category=SWHDR
          short-label=rtw_linux_h, category=SWHDR
          short-label=rtw_linux_mac_h, category=SWHDR
          short-label=rtw_matlogging_h, category=SWHDR
          short-label=rtw_modelmap_h, category=SWHDR
          short-label=rtw_modelmap_logging_h, category=SWHDR
          short-label=rtw_msvc_lshift_h, category=SWHDR
          short-label=rtw_solver_h, category=SWHDR
          short-label=rtw_windows_h, category=SWHDR
          short-label=rtwtypes_h, category=SWHDR
          short-label=sfcn_bridge_h, category=SWHDR
          short-label=sfcn_loader_c_api_h, category=SWHDR
          short-label=sfun_rtwcg_hpp, category=SWHDR
          short-label=sigmapdef_sfcn_h, category=SWHDR
          short-label=sigregdef_h, category=SWHDR
          short-label=sigstream_rtw_h, category=SWHDR
          short-label=simlogCIntrf_h, category=SWHDR
          short-label=simstruc_h, category=SWHDR
          short-label=simstruc_compcond_h, category=SWHDR
          short-label=simstruc_debug_h, category=SWHDR
          short-label=simstruc_def_h, category=SWHDR
          short-label=simstruc_implement_h, category=SWHDR
          short-label=simstruc_internal_h, category=SWHDR
          short-label=simstruc_types_h, category=SWHDR
          short-label=simulink_h, category=SWHDR
          short-label=simulink2_h, category=SWHDR
          short-label=simulink_solver_api_h, category=SWHDR
          short-label=sl_common_types_def_h, category=SWHDR
          short-label=sl_datatype_access_h, category=SWHDR
          short-label=sl_fileio_rtw_h, category=SWHDR
          short-label=sl_fixpt_h, category=SWHDR
          short-label=sl_prodhwdevicetype_h, category=SWHDR
          short-label=sl_report_types_h, category=SWHDR
          short-label=sl_sample_time_defs_h, category=SWHDR
          short-label=sl_sfcn_st_api_h, category=SWHDR
          short-label=sl_solver_rtw_h, category=SWHDR
          short-label=sl_types_def_h, category=SWHDR
          short-label=slexec_block_runtime_service_h, category=SWHDR
          short-label=slexec_parallel_h, category=SWHDR
          short-label=slexec_simbridge_h, category=SWHDR
          short-label=slexec_simstruct_bridge_h, category=SWHDR
          short-label=slexec_vm_lookup_functions_h, category=SWHDR
          short-label=slexec_vm_rt_functions_h, category=SWHDR
          short-label=slexec_vm_simstruct_bridge_h, category=SWHDR
          short-label=slexec_vm_zc_functions_h, category=SWHDR
          short-label=slsv_diagnostic_codegen_c_api_h, category=SWHDR
          short-label=slsv_diagnostic_logger_type_h, category=SWHDR
          short-label=slsv_mexhelper_h, category=SWHDR
          short-label=solver_zc_h, category=SWHDR
          short-label=sysran_types_h, category=SWHDR
          short-label=tmwtypes_h, category=SWHDR
          short-label=updown_h, category=SWHDR
          short-label=updown_util_h, category=SWHDR
          short-label=upsup_public_h, category=SWHDR
    resource consumption RsrcCons_CSCR_Code
