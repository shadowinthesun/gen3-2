AUTOSAR XML (schema 4-0-3)
standard types defined: Float, Boolean, UInt8, UInt32, UInt16, float32, boolean, uint8, uint32, uint16
package /SOCR_Code_pkg/SOCR_Code_dt
  unit NoUnit: factor-si-to-unit=1, offset-si-to-unit=0
  impl type rt_Array_Float_96: category=ARRAY
    element rt_Array_Float_96: array-size=96, array-size-semantics=FIXED-SIZE, implementation-data-type=Float
  impl type rt_Array_Boolean_96: category=ARRAY
    element rt_Array_Boolean_96: array-size=96, array-size-semantics=FIXED-SIZE, implementation-data-type=Boolean
  impl type TeHVSR_e_StateMode: category=VALUE, base-type=uint8
  impl type TeVSDR_e_CurrentFlowState: category=VALUE, base-type=uint8
  6 x impl type, all with category=ARRAY:
    rt_Array_Float_720
      element rt_Array_Float_720: array-size=720, array-size-semantics=FIXED-SIZE, implementation-data-type=Float
    rt_Array_Float_10
      element rt_Array_Float_10: array-size=10, array-size-semantics=FIXED-SIZE, implementation-data-type=Float
    rt_Array_Float_72
      element rt_Array_Float_72: array-size=72, array-size-semantics=FIXED-SIZE, implementation-data-type=Float
    rt_Array_Float_8
      element rt_Array_Float_8: array-size=8, array-size-semantics=FIXED-SIZE, implementation-data-type=Float
    rt_Array_Float_31
      element rt_Array_Float_31: array-size=31, array-size-semantics=FIXED-SIZE, implementation-data-type=Float
    rt_Array_Float_6
      element rt_Array_Float_6: array-size=6, array-size-semantics=FIXED-SIZE, implementation-data-type=Float
package /SOCR_Code_pkg/SOCR_Code_dt/ApplDataTypes
  app type Float: category=VALUE, sw-calibration-access=READ-WRITE, compu {identical}, range phys -INF..INF
  application array data type rt_Array_Float_96: category=ARRAY, sw-calibration-access=READ-WRITE
    element rt_Array_Float_96: category=VALUE, type=Float, array-size-semantics=FIXED-SIZE, max-number-of-elements=96
  app type Boolean: category=BOOLEAN, sw-calibration-access=READ-WRITE, compu {0=FALSE, 1=TRUE}
  application array data type rt_Array_Boolean_96: category=ARRAY, sw-calibration-access=READ-WRITE
    element rt_Array_Boolean_96: category=BOOLEAN, type=Boolean, array-size-semantics=FIXED-SIZE, max-number-of-elements=96
  14 x app type, all with sw-calibration-access=READ-WRITE:
    TeHVSR_e_StateMode: category=VALUE, compu {0=CeHVSR_e_StateModeReserved, 1=CeHVSR_e_StateModeInitial, 2=CeHVSR_e_StateModeStandBy, 3=CeHVSR_e_StateModePrecharge, 4=CeHVSR_e_StateModeNormalDischarge, 5=CeHVSR_e_StateModeWarningPowerReduction, 6=CeHVSR_e_StateModePowerReduction, 7=CeHVSR_e_StateModePreChargeFailed, 8=CeHVSR_e_StateModePowerHoldMode, 9=CeHVSR_e_StateModeShutdown, 10=CeHVSR_e_StateModeServiceMode, 11=CeHVSR_e_StateModeReady, 12=CeHVSR_e_StateModeAC_ChargeMode, 13=CeHVSR_e_StateModeEndOfCharge, 14=CeHVSR_e_StateModeDC_ChargeMode, 15=CeHVSR_e_StateModeSystemErr, 16=CeHVSR_e_StateModeTempChargState, 17=CeHVSR_e_StateModeHeatPreChgState, 18=CeHVSR_e_StateModeHeatingState, 19=CeHVSR_e_StateModeHeatFinishState}
    UInt8: category=VALUE, compu {identical}, range phys 0..255
    TeVSDR_e_CurrentFlowState: category=VALUE, compu {0=CeVSDR_e_CurFlowStateInit, 1=CeVSDR_e_CurFlowStateChrg, 2=CeVSDR_e_CurFlowStateDischrg, 3=CeVSDR_e_CurFlowStateInvalid}
    UInt32: category=VALUE, compu {identical}, range phys 0..4294967295
    Appl_CzSOCR_cmp_SOCOCV_mean_data: category=MAP, sw-calprm-axis-set=[{sw-axis-index=1, category=COM_AXIS, sw-axis-grouped=Appl_CtSOCR_cmp_SOCOCV_mean}, {sw-axis-index=2, category=COM_AXIS, sw-axis-grouped=Appl_CxSOCR_cmp_SOCOCV_mean}], compu {identical}, range phys -INF..INF, sw-record-layout=Map_f32
    Appl_CxSOCR_cmp_SOCOCV_mean: category=COM_AXIS, sw-calprm-axis-set={sw-axis-index=2, sw-axis-individual={compu {identical}, sw-max-axis-points=72, sw-min-axis-points=72, range phys -1000000..1000000}}, sw-record-layout=Distr_f32_M
    Appl_CtSOCR_cmp_SOCOCV_mean: category=COM_AXIS, sw-calprm-axis-set={sw-axis-index=1, sw-axis-individual={compu {identical}, sw-max-axis-points=10, sw-min-axis-points=10, range phys -1000000..1000000}}, sw-record-layout=Distr_f32_M
    Appl_CzSOCR_k_TrustFactorOCV_data: category=CURVE, sw-calprm-axis-set={sw-axis-index=1, category=COM_AXIS, sw-axis-grouped=Appl_CxSOCR_k_TrustFactorOCV}, compu {identical}, range phys -INF..INF, sw-record-layout=Cur_f32
    Appl_CxSOCR_k_TrustFactorOCV: category=COM_AXIS, sw-calprm-axis-set={sw-axis-index=1, sw-axis-individual={compu {identical}, sw-max-axis-points=8, sw-min-axis-points=8, range phys -1000000..1000000}}, sw-record-layout=Distr_f32_M
    Appl_KtSOCR_U_SOCOCV_DE_Table: category=CURVE, sw-calprm-axis-set={sw-axis-index=1, category=COM_AXIS, sw-axis-grouped=Appl_KxSOCR_U_SOCOCV_DE}, compu {identical}, range phys -1000000..1000000, sw-record-layout=Cur_f32
    Appl_KxSOCR_U_SOCOCV_DE: category=COM_AXIS, sw-calprm-axis-set={sw-axis-index=1, sw-axis-individual={compu {identical}, sw-max-axis-points=31, sw-min-axis-points=31, range phys -1000000..1000000}}, sw-record-layout=Distr_f32_M
    Appl_KtSOCR_U_vMinBasedOnTemp_DE_Table: category=CURVE, sw-calprm-axis-set={sw-axis-index=1, category=COM_AXIS, sw-axis-grouped=Appl_KxSOCR_U_vMinBasedOnTemp_DE}, compu {identical}, range phys -1000000..1000000, sw-record-layout=Cur_f32
    Appl_KxSOCR_U_vMinBasedOnTemp_DE: category=COM_AXIS, sw-calprm-axis-set={sw-axis-index=1, sw-axis-individual={input-variable-type=Float, compu {identical}, sw-max-axis-points=6, sw-min-axis-points=6, range phys -1000000..1000000}}, sw-record-layout=Distr_f32_M
    UInt16: category=VALUE, compu {identical}, range phys 0..65535
package /SOCR_Code_pkg/SOCR_Code_dt/ApplDataTypes/RecordLayouts
  sw record layout Map_f32: sw-record-layout-group={short-label=Map_f32, sw-record-layout-group={short-label=Val, category=COLUMN_DIR, sw-record-layout-group-axis=1, sw-record-layout-group-index=X, sw-record-layout-group-from=1, sw-record-layout-group-to=-1, sw-record-layout-group={short-label=Val, sw-record-layout-group-axis=2, sw-record-layout-group-index=Y, sw-record-layout-group-from=1, sw-record-layout-group-to=-1, sw-record-layout-v={short-label=Val, base-type=float32, sw-record-layout-v-axis=0, sw-record-layout-v-prop=VALUE, sw-record-layout-v-index=X Y}}}}
  sw record layout Distr_f32_M: sw-record-layout-group={short-label=Y, category=INDEX_INCR, sw-record-layout-group-axis=1, sw-record-layout-group-from=1, sw-record-layout-group-to=-1, sw-record-layout-v={short-label=VALUE, base-type=float32, sw-record-layout-v-axis=1, sw-record-layout-v-prop=VALUE}}
  sw record layout Cur_f32: sw-record-layout-group={short-label=Cur_f32, category=COLUMN_DIR, sw-record-layout-group-axis=0, sw-record-layout-group-index=X, sw-record-layout-group-from=1, sw-record-layout-group-to=-1, sw-record-layout-v={short-label=Val, base-type=float32, sw-record-layout-v-axis=0, sw-record-layout-v-prop=VALUE, sw-record-layout-v-index=X}}
package /SOCR_Code_pkg/SOCR_Code_dt/DataTypeMappings
  data type mapping set SOCR_CodeDataTypeMappingsSet
    data-type-maps:
      application-data-type=Float, implementation-data-type=Float
      application-data-type=rt_Array_Float_96, implementation-data-type=rt_Array_Float_96
      application-data-type=Boolean, implementation-data-type=Boolean
      application-data-type=rt_Array_Boolean_96, implementation-data-type=rt_Array_Boolean_96
      application-data-type=TeHVSR_e_StateMode, implementation-data-type=TeHVSR_e_StateMode
      application-data-type=UInt8, implementation-data-type=UInt8
      application-data-type=TeVSDR_e_CurrentFlowState, implementation-data-type=TeVSDR_e_CurrentFlowState
      application-data-type=UInt32, implementation-data-type=UInt32
      application-data-type=Appl_CzSOCR_cmp_SOCOCV_mean_data, implementation-data-type=rt_Array_Float_720
      application-data-type=Appl_CtSOCR_cmp_SOCOCV_mean, implementation-data-type=rt_Array_Float_10
      application-data-type=Appl_CxSOCR_cmp_SOCOCV_mean, implementation-data-type=rt_Array_Float_72
      application-data-type=Appl_CzSOCR_k_TrustFactorOCV_data, implementation-data-type=rt_Array_Float_8
      application-data-type=Appl_CxSOCR_k_TrustFactorOCV, implementation-data-type=rt_Array_Float_8
      application-data-type=Appl_KtSOCR_U_SOCOCV_DE_Table, implementation-data-type=rt_Array_Float_31
      application-data-type=Appl_KxSOCR_U_SOCOCV_DE, implementation-data-type=rt_Array_Float_31
      application-data-type=Appl_KtSOCR_U_vMinBasedOnTemp_DE_Table, implementation-data-type=rt_Array_Float_6
      application-data-type=Appl_KxSOCR_U_vMinBasedOnTemp_DE, implementation-data-type=rt_Array_Float_6
      application-data-type=UInt16, implementation-data-type=UInt16
package /SOCR_Code_pkg/SOCR_Code_dt/Ground
  9 x constant specification:
    CtSOCR_cmp_SOCOCV_mean: value-spec=[-20 -10 -5 0 5 15 25 35 45 55]
    CxSOCR_cmp_SOCOCV_mean: value-spec=[3.052999973297119 3.138000011444092 3.2669999599456787 3.38100004196167 3.4059998989105225 3.4179999828338623 3.4210000038146973 3.431999921798706 3.4649999141693115 3.4760000705718994 3.493000030517578 3.502000093460083 3.5160000324249268 3.5220000743865967 3.5299999713897705 3.5350000858306885 3.5369999408721924 3.5439999103546143 3.555999994277954 3.569000005722046 3.5810000896453857 3.5859999656677246 3.5969998836517334 3.6050000190734863 3.6089999675750732 3.615999937057495 3.619999885559082 3.624000072479248 3.63700008392334 3.6449999809265137 3.6500000953674316 3.6600000858306885 3.6630001068115234 3.6710000038146973 3.691999912261963 3.694000005722046 3.697000026702881 3.7090001106262207 3.7219998836517334 3.7360000610351562 3.739000082015991 3.743000030517578 3.7950000762939453 3.796999931335449 3.805000066757202 3.812000036239624 3.8269999027252197 3.8320000171661377 3.8369998931884766 3.8399999141693115 3.8889999389648438 3.8929998874664307 3.9000000953674316 3.9040000438690186 3.9149999618530273 3.9189999103546143 3.921999931335449 3.924999952316284 3.9860000610351562 3.990000009536743 3.996999979019165 4.000999927520752 4.004000186920166 4.00600004196167 4.010000228881836 4.073999881744385 4.081999778747559 4.085000038146973 4.0879998207092285 4.090000152587891 4.0929999351501465 4.228000164031982]
    CxSOCR_k_TrustFactorOCV: value-spec=[1799 1800 3599 3600 7200 14400 43199 43200]
    CzSOCR_cmp_SOCOCV_mean_data: value-spec=[0 0 0 0 0 0 0 0 0 0 0 0 0 0 0 0 2.2221999168395996 10 12.857099533081055 15.952400207519531 18.809499740600586 20 22.894699096679688 25 26.052600860595703 27.894699096679688 28.947399139404297 30 32.76599884033203 34.468101501464844 35.531898498535156 37.65959930419922 38.29790115356445 40 42.91669845581055 43.194400787353516 43.61109924316406 45.277801513671875 47.08330154418945 49.027801513671875 49.444400787353516 50 55.84270095825195 56.06740188598633 56.96630096435547 57.75279998779297 59.438201904296875 60 60.57469940185547 60.919498443603516 66.55169677734375 67.0114974975586 67.81610107421875 68.2759017944336 69.54019927978516 70 70.36589813232422 70.73169708251953 78.17070007324219 78.65850067138672 79.51219940185547 80 80.41100311279297 80.68489837646484 81.23290252685547 90 90.51950073242188 90.71430206298828 90.90910339355469 91.03900146484375 91.23380279541016 100 0 0 0 0 0 0 0 0 0 0 0 0 4.242400169372559 6.0605998039245605 8.484800338745117 10 10.434800148010254 11.956500053405762 14.565199851989746 17.391300201416016 20 21.428600311279297 24.571399688720703 26.857099533081055 28 30 30.888900756835938 31.777799606323242 34.66669845581055 36.444400787353516 37.555599212646484 39.777801513671875 40.266700744628906 41.33330154418945 44.13330078125 44.400001525878906 44.79999923706055 46.400001525878906 48.13330078125 50 50.297000885009766 50.69309997558594 55.84159851074219 56.03960037231445 56.83169937133789 57.52479934692383 59.0098991394043 59.505001068115234 60 60.352901458740234 66.11759948730469 66.58820343017578 67.41179656982422 67.88240051269531 69.17649841308594 69.64710235595703 70 70.36589813232422 77.80490112304688 78.2927017211914 79.14630126953125 79.63410186767578 80 80.25640106201172 80.76920318603516 88.97440338134766 90 90.20549774169922 90.41100311279297 90.54789733886719 90.75340270996094 100 0 0 0 0 0 0 0 0 0 0 3.0357000827789307 4.642899990081787 7.142899990081787 8.214300155639648 9.642900466918945 10.625 11.04170036315918 12.5 15 17.70829963684082 20.277799606323242 21.66670036315918 24.722200393676758 26.944400787353516 28.055599212646484 30 30.909099578857422 31.818199157714844 34.772701263427734 36.59090042114258 37.727298736572266 40 40.38460159301758 41.410301208496094 44.10260009765625 44.35900115966797 44.74359893798828 46.282100677490234 47.948699951171875 49.74359893798828 50.097999572753906 50.49020004272461 55.588199615478516 55.7843017578125 56.568599700927734 57.25490188598633 58.72549819946289 59.2156982421875 59.70589828491211 60 65.76470184326172 66.23529815673828 67.05879974365234 67.52940368652344 68.82350158691406 69.29409790039062 69.64710235595703 70 77.17649841308594 77.64710235595703 78.47059631347656 78.94120025634766 79.29409790039062 79.52940368652344 80 88 89 89.375 89.75 90 90.21739959716797 100 0 0 0 0 0 0 0 0 0 1.5277999639511108 3.8889000415802 5.138899803161621 7.0833001136779785 7.9166998863220215 9.027799606323242 9.722200393676758 10 11.45829963684082 13.95829963684082 16.66670036315918 19.16670036315918 20.28569984436035 23.428600311279297 25.71430015563965 26.857099533081055 28.857099533081055 30 30.930200576782227 33.95349884033203 35.81399917602539 36.97669982910156 39.30229949951172 40 41.0526008605957 43.815799713134766 44.07889938354492 44.47370147705078 46.0526008605957 47.76319885253906 49.60530090332031 50 50.40399932861328 55.65660095214844 55.85860061645508 56.66669845581055 57.37369918823242 58.88890075683594 59.39390182495117 59.89899826049805 60.23809814453125 66.07140350341797 66.54759979248047 67.38099670410156 67.85710144042969 69.16670227050781 69.64289855957031 70 70.34480285644531 77.3563003540039 77.81610107421875 78.62069702148438 79.08049774169922 79.42530059814453 79.65519714355469 80.12200164794922 87.92680358886719 88.90239715576172 89.26830291748047 89.63410186767578 89.87799835205078 90.14600372314453 100 0 0 0 0 0 0 0 0 0 0 3.0357000827789307 4.642899990081787 7.142899990081787 8.214300155639648 9.642900466918945 10.625 11.04170036315918 12.5 15 17.70829963684082 20.277799606323242 21.66670036315918 24.722200393676758 26.944400787353516 28.055599212646484 30 30.909099578857422 31.818199157714844 34.772701263427734 36.59090042114258 37.727298736572266 40 40.38460159301758 41.410301208496094 44.10260009765625 44.35900115966797 44.74359893798828 46.282100677490234 47.948699951171875 49.74359893798828 50.097999572753906 50.49020004272461 55.588199615478516 55.7843017578125 56.568599700927734 57.25490188598633 58.72549819946289 59.2156982421875 59.70589828491211 60 65.76470184326172 66.23529815673828 67.05879974365234 67.52940368652344 68.82350158691406 69.29409790039062 69.64710235595703 70 77.17649841308594 77.64710235595703 78.47059631347656 78.94120025634766 79.29409790039062 79.52940368652344 80 88 89 89.375 89.75 90 90.21739959716797 100 0 0 0 0 0 1.3792999982833862 1.7240999937057495 2.9885001182556152 6.781599998474121 8.045999526977539 10 11.184200286865234 13.026300430297852 13.815799713134766 14.868399620056152 15.526300430297852 15.78950023651123 16.710500717163086 18.289499282836914 20 23 24.25 27 29 30 31.707300186157227 32.682899475097656 33.65850067138672 36.82929992675781 38.78049850463867 40 41.38890075683594 41.805599212646484 42.91669845581055 45.83330154418945 46.11109924316406 46.527801513671875 48.194400787353516 50 51.33330154418945 51.61899948120117 52 56.95240020751953 57.14289855957031 57.90480041503906 58.5713996887207 60 60.568199157714844 61.13639831542969 61.477298736572266 67.04550170898438 67.5 68.29550170898438 68.75 70 70.4395980834961 70.76920318603516 71.0988998413086 77.80220031738281 78.2417984008789 79.01100158691406 79.45050048828125 79.78019714355469 80 80.45980072021484 87.81610107421875 88.73560333251953 89.08049774169922 89.42530059814453 89.65519714355469 90 100 0 0 0 0 2.941200017929077 4.35290002822876 4.705900192260742 6 9.882399559020996 11.111100196838379 13 14 15.5556001663208 16.222200393676758 17.111099243164062 17.66670036315918 17.888900756835938 18.66670036315918 20 22.653099060058594 25.101999282836914 26.122400283813477 28.367300033569336 30 31 32.75 33.75 34.75 38 40 40.78120040893555 42.34379959106445 42.8125 44.0625 47.34379959106445 47.65620040893555 48.125 50 51.26210021972656 52.62139892578125 52.912601470947266 53.30099868774414 58.3494987487793 58.543701171875 59.32040023803711 60 61.630401611328125 62.17390060424805 62.71739959716797 63.04349899291992 68.36959838867188 68.8042984008789 69.56520080566406 70 71.18280029296875 71.61289978027344 71.93550109863281 72.25810241699219 78.81719970703125 79.24729919433594 80 80.42549896240234 80.74469757080078 80.9573974609375 81.38300323486328 88.19149780273438 89.0426025390625 89.36170196533203 89.68090057373047 89.89360046386719 90.14600372314453 100 0 0 0 6.90910005569458 8.424200057983398 9.15149974822998 9.33329963684082 10 13.367300033569336 14.489800453186035 16.22450065612793 17.142900466918945 18.571399688720703 19.183700561523438 20 20.746299743652344 21.0447998046875 22.089599609375 23.880599975585938 25.820899963378906 27.611900329589844 28.358200073242188 30 32 33 34.75 35.75 36.75 40 41.33330154418945 42.16669845581055 43.83330154418945 44.33330154418945 45.66669845581055 49.16669845581055 49.5 50 51.11109924316406 52.31480026245117 53.61109924316406 53.88890075683594 54.259300231933594 59.074100494384766 59.259300231933594 60 60.73680114746094 62.315799713134766 62.842098236083984 63.36840057373047 63.684200286865234 68.84210205078125 69.26319885253906 70 70.41670227050781 71.5625 71.97920227050781 72.29170227050781 72.60420227050781 78.95829772949219 79.375 80.10530090332031 80.52629852294922 80.84210205078125 81.05259704589844 81.47370147705078 88.21050262451172 89.05259704589844 89.36840057373047 89.68419647216797 89.89469909667969 90.14600372314453 100 0 0 4.558300018310547 8.586600303649902 9.470000267028809 9.894000053405762 10 11.089099884033203 14.356399536132812 15.445500373840332 17.128700256347656 18.019800186157227 19.405899047851562 20 21.081100463867188 21.756799697875977 22.027000427246094 22.972999572753906 24.594600677490234 26.35140037536621 27.972999572753906 28.64859962463379 30.25 32.25 33.25 35 36 37 40.1786003112793 41.60710144042969 42.5 44.285701751708984 44.8213996887207 46.25 50 50.19419860839844 50.48540115356445 51.6505012512207 52.912601470947266 54.27180099487305 54.5630989074707 54.951499938964844 60 60.212799072265625 61.06380081176758 61.80849838256836 63.404300689697266 63.93619918823242 64.46810150146484 64.78720092773438 70 70.41239929199219 71.13400268554688 71.54640197753906 72.6803970336914 73.0927963256836 73.402099609375 73.7113037109375 80 80.40399932861328 81.11109924316406 81.51519775390625 81.81819915771484 82.02020263671875 82.42420196533203 88.88890075683594 89.6969985961914 90 90.20980072021484 90.34970092773438 90.55940246582031 100 0 2.3287999629974365 5.86299991607666 8.986300468444824 9.671199798583984 10 10.306099891662598 11.428600311279297 14.795900344848633 15.918399810791016 17.653099060058594 18.571399688720703 20 20.75950050354004 21.772199630737305 22.405099868774414 22.658199310302734 23.544300079345703 25.06329917907715 26.708900451660156 28.227800369262695 28.86079978942871 30.476200103759766 32.38100051879883 33.33330154418945 35 35.95240020751953 36.90480041503906 40 41.403499603271484 42.28070068359375 44.035099029541016 44.5614013671875 45.964900970458984 49.64910125732422 50 50.29130172729492 51.456298828125 52.71839904785156 54.077701568603516 54.368900299072266 54.757301330566406 59.80580139160156 60 60.83330154418945 61.5625 63.125 63.64580154418945 64.16670227050781 64.47920227050781 69.58329772949219 70 70.72160339355469 71.13400268554688 72.26799774169922 72.6803970336914 72.98970031738281 73.29900360107422 79.58760070800781 80 80.71430206298828 81.12239837646484 81.42859649658203 81.63269805908203 82.04080200195312 88.57140350341797 89.38780212402344 89.69390106201172 90 90.14289855957031 90.35710144042969 100]
    CzSOCR_k_TrustFactorOCV_data: value-spec=[0 0 0 0 1 1 1 1]
    KtSOCR_U_SOCOCV_DE_Table: value-spec=[3.052999973297119 3.06030011177063 3.0676000118255615 3.074899911880493 3.082200050354004 3.0894999504089355 3.0968000888824463 3.104099988937378 3.1113998889923096 3.1187000274658203 3.125999927520752 3.2355000972747803 3.4179999828338623 3.4670000076293945 3.5160000324249268 3.555500030517578 3.5950000286102295 3.615999937057495 3.63700008392334 3.6654999256134033 3.694000005722046 3.745500087738037 3.796999931335449 3.8450000286102295 3.8929998874664307 3.941499948501587 3.990000009536743 4.039000034332275 4.0879998207092285 4.1579999923706055 4.228000164031982]
    KtSOCR_U_vMinBasedOnTemp_DE_Table: value-spec=[3.0399999618530273 3.2699999809265137 3.2699999809265137 3.319999933242798 3.319999933242798 3.3499999046325684]
    KxSOCR_U_SOCOCV_DE: value-spec=[0 0.20000000298023224 0.4000000059604645 0.6000000238418579 0.800000011920929 1 1.2000000476837158 1.399999976158142 1.600000023841858 1.7999999523162842 2 5 10 15 20 25 30 35 40 45 50 55 60 65 70 75 80 85 90 95 100]
    KxSOCR_U_vMinBasedOnTemp_DE: value-spec=[-30 -0.0010000000474974513 0 9.99899959564209 10 55]
package /SOCR_Code_pkg/SOCR_Code_dt/SwAddrMethods
  sw addr method CODE: section-type=CODE
  sw addr method CONST: section-type=CONST
  sw addr method VAR: section-type=VAR
