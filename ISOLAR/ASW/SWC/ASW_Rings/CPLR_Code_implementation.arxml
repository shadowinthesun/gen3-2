AUTOSAR XML (schema 4-0-3)
package /CPLR_Code_pkg/CPLR_Code_imp
  swc implementation CPLR_Code: programming-language=C, sw-version=1.295.1, used-code-generator=Embedded Coder 7.2 (R2019a) 23-Nov-2018, vendor-id=0, behavior=CPLR_Code
    code-descriptors:
      code Code
        artifact-descriptors:
          short-label=CPLR_Code_c, category=SWSRC
          short-label=cplr_temperature_c, category=SWSRC
          short-label=cplr_voltage_c, category=SWSRC
          short-label=g_App_DualDebouncer_c, category=SWSRC
          short-label=ASW_Types_h, category=SWHDR
          short-label=CPLR_Code_h, category=SWHDR
          short-label=CPLR_Code_private_h, category=SWHDR
          short-label=CPLR_Code_types_h, category=SWHDR
          short-label=cplr_temperature_h, category=SWHDR
          short-label=cplr_voltage_h, category=SWHDR
          short-label=g_App_DualDebouncer_h, category=SWHDR
          short-label=g_App_DualDebouncer_private_h, category=SWHDR
          short-label=g_App_DualDebouncer_types_h, category=SWHDR
          short-label=rtwtypes_h, category=SWHDR
          short-label=tmwtypes_h, category=SWHDR
    resource consumption RsrcCons_CPLR_Code
