AUTOSAR XML (schema 4-0-3)
standard types defined: Float, Boolean, UInt8, UInt16, float32, boolean, uint8, uint16
package /HVIR_Code_pkg/HVIR_Code_dt
  unit NoUnit: factor-si-to-unit=1, offset-si-to-unit=0
  impl type TeHVIR_e_HVIL_Status: category=VALUE, base-type=uint8
  impl type TeHVIR_e_HVIL_StatusFS: category=VALUE, base-type=uint8
package /HVIR_Code_pkg/HVIR_Code_dt/ApplDataTypes
  6 x app type, all with sw-calibration-access=READ-WRITE:
    Float: category=VALUE, compu {identical}, range phys -INF..INF
    Boolean: category=BOOLEAN, compu {0=FALSE, 1=TRUE}
    UInt8: category=VALUE, compu {identical}, range phys 0..255
    TeHVIR_e_HVIL_Status: category=VALUE, compu {0=CeHVIR_e_HVIL_Closed, 1=CeHVIR_e_HVIL_Open_Fault, 3=CeHVIR_e_HVIL_Invalid}
    TeHVIR_e_HVIL_StatusFS: category=VALUE, compu {0=CeHVIR_e_HVIL_ClosedFS, 1=CeHVIR_e_HVIL_Open_FaultFS, 3=CeHVIR_e_HVIL_InvalidFS}
    UInt16: category=VALUE, compu {identical}, range phys 0..65535
package /HVIR_Code_pkg/HVIR_Code_dt/DataTypeMappings
  data type mapping set HVIR_CodeDataTypeMappingsSet
    data-type-maps:
      application-data-type=Float, implementation-data-type=Float
      application-data-type=Boolean, implementation-data-type=Boolean
      application-data-type=UInt8, implementation-data-type=UInt8
      application-data-type=TeHVIR_e_HVIL_Status, implementation-data-type=TeHVIR_e_HVIL_Status
      application-data-type=TeHVIR_e_HVIL_StatusFS, implementation-data-type=TeHVIR_e_HVIL_StatusFS
      application-data-type=UInt16, implementation-data-type=UInt16
package /HVIR_Code_pkg/HVIR_Code_dt/SwAddrMethods
  sw addr method CODE: section-type=CODE
  sw addr method CONST: section-type=CONST
  sw addr method VAR: section-type=VAR
