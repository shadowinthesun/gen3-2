AUTOSAR XML (schema 4-0-3)
package /CHMR_Code_pkg/CHMR_Code_if
  88 x sender receiver interface:
    VeCHMR_U_ChrgVoltSetPt
      data VeCHMR_U_ChrgVoltSetPt: category=VALUE, sw-calibration-access=READ-ONLY, type=Float
    VeCHMR_I_ChrgCurrentRq
      data VeCHMR_I_ChrgCurrentRq: category=VALUE, sw-calibration-access=READ-ONLY, type=Float
    VeCHMR_b_ChrgOverCurr_level1_flt
      data VeCHMR_b_ChrgOverCurr_level1_flt: category=BOOLEAN, sw-calibration-access=READ-ONLY, type=Boolean
    VeCHMR_b_ChrgOverCurr_level2_flt
      data VeCHMR_b_ChrgOverCurr_level2_flt: category=BOOLEAN, sw-calibration-access=READ-ONLY, type=Boolean
    VeCHMR_k_ChrgOverCurr_level3_flt
      data VeCHMR_k_ChrgOverCurr_level3_flt: category=VALUE, sw-calibration-access=READ-ONLY, type=UInt8
    VeCHMR_b_OverDischCurr_OnChrg_flt
      data VeCHMR_b_OverDischCurr_OnChrg_flt: category=BOOLEAN, sw-calibration-access=READ-ONLY, type=Boolean
    VeCHMR_b_OBCFail_flt
      data VeCHMR_b_OBCFail_flt: category=BOOLEAN, sw-calibration-access=READ-ONLY, type=Boolean
    VeCHMR_b_ChrgVCUShutDwn_flt
      data VeCHMR_b_ChrgVCUShutDwn_flt: category=BOOLEAN, sw-calibration-access=READ-ONLY, type=Boolean
    VeCHMR_mU_CellMinVolt
      data VeCHMR_mU_CellMinVolt: category=VALUE, sw-calibration-access=READ-ONLY, type=Float
    VeCHMR_mU_CellMaxVolt
      data VeCHMR_mU_CellMaxVolt: category=VALUE, sw-calibration-access=READ-ONLY, type=Float
    VeCHMR_e_VCUChargeRequest
      data VeCHMR_e_VCUChargeRequest: category=VALUE, sw-calibration-access=READ-ONLY, type=TeCHMR_e_VCU_ChargeRequest
    VeCHMR_b_ChrgRequestOut
      data VeCHMR_b_ChrgRequestOut: category=BOOLEAN, sw-calibration-access=READ-ONLY, type=Boolean
    VeCHMR_min_ChargeTimeRem
      data VeCHMR_min_ChargeTimeRem: category=VALUE, sw-calibration-access=READ-ONLY, type=Float
    VeCHMR_b_ChrgComplete
      data VeCHMR_b_ChrgComplete: category=BOOLEAN, sw-calibration-access=READ-ONLY, type=Boolean
    VeCHMR_b_AC_DC_BothConnected
      data VeCHMR_b_AC_DC_BothConnected: category=BOOLEAN, sw-calibration-access=READ-ONLY, type=Boolean
    VeCHMR_e_BookChargeSetResp
      data VeCHMR_e_BookChargeSetResp: category=VALUE, sw-calibration-access=READ-ONLY, type=TeCHMR_e_BookChargeSetResponse
    VeCHMR_e_BookChgStaCheckRes
      data VeCHMR_e_BookChgStaCheckRes: category=VALUE, sw-calibration-access=READ-ONLY, type=TeCHMR_e_BookChgStaCheckReponse
    VeCHMR_I_ChrgCurrentMax
      data VeCHMR_I_ChrgCurrentMax: category=VALUE, sw-calibration-access=READ-ONLY, type=Float
    VeCHMR_e_BookChgSetStatus
      data VeCHMR_e_BookChgSetStatus: category=VALUE, sw-calibration-access=READ-ONLY, type=TeCHMR_e_BookChargeSetResponse
    VeCHMR_e_ChrgLEDCntrol
      data VeCHMR_e_ChrgLEDCntrol: category=VALUE, sw-calibration-access=READ-ONLY, type=TeCHMR_e_OBC_ChrgLEDCntrol
    VeCHMR_b_TermChrgVoltTempAbnormal
      data VeCHMR_b_TermChrgVoltTempAbnormal: category=BOOLEAN, sw-calibration-access=READ-ONLY, type=Boolean
    VeCHMR_b_ChargeEn
      data VeCHMR_b_ChargeEn: category=BOOLEAN, sw-calibration-access=READ-ONLY, type=Boolean
    VeCHMR_k_SWS1Control
      data VeCHMR_k_SWS1Control: category=VALUE, sw-calibration-access=READ-ONLY, type=UInt8
    VeCHMR_b_ReChargeStatus
      data VeCHMR_b_ReChargeStatus: category=BOOLEAN, sw-calibration-access=READ-ONLY, type=Boolean
    VeCHMR_k_SWS2Control
      data VeCHMR_k_SWS2Control: category=VALUE, sw-calibration-access=READ-ONLY, type=UInt8
    VeCHMR_b_ChargeReq
      data VeCHMR_b_ChargeReq: category=BOOLEAN, sw-calibration-access=READ-ONLY, type=Boolean
    VeCHMR_k_ChargeStatus
      data VeCHMR_k_ChargeStatus: category=VALUE, sw-calibration-access=READ-ONLY, type=UInt8
    VeCHMR_k_OBCWorkingCommand
      data VeCHMR_k_OBCWorkingCommand: category=VALUE, sw-calibration-access=READ-ONLY, type=UInt8
    VeCHMR_k_HeatingInsulationReq
      data VeCHMR_k_HeatingInsulationReq: category=VALUE, sw-calibration-access=READ-ONLY, type=UInt8
    VeCHMR_e_ChargingSM
      data VeCHMR_e_ChargingSM: category=VALUE, sw-calibration-access=READ-ONLY, type=TeCHMR_e_ChargingStateMachine
    VeCHMR_b_HeatingInsulationReqcomplt
      data VeCHMR_b_HeatingInsulationReqcomplt: category=BOOLEAN, sw-calibration-access=READ-ONLY, type=Boolean
    VeCHMR_b_ChargingActive
      data VeCHMR_b_ChargingActive: category=BOOLEAN, sw-calibration-access=READ-ONLY, type=Boolean
    VeCHMR_min_TimeToCharge
      data VeCHMR_min_TimeToCharge: category=VALUE, sw-calibration-access=READ-ONLY, type=Float
    VeCHMR_I_ChrgTableCurrent
      data VeCHMR_I_ChrgTableCurrent: category=VALUE, sw-calibration-access=READ-ONLY, type=Float
    VeCHMR_k_PackOverChrgPower_Rank_CAN
      data VeCHMR_k_PackOverChrgPower_Rank_CAN: category=VALUE, sw-calibration-access=READ-ONLY, type=UInt8
    VeCHMR_b_HCUChargeReq
      data VeCHMR_b_HCUChargeReq: category=BOOLEAN, sw-calibration-access=READ-ONLY, type=Boolean
    VeCHMR_b_ChargingSigLoss
      data VeCHMR_b_ChargingSigLoss: category=BOOLEAN, sw-calibration-access=READ-ONLY, type=Boolean
    VeCHMR_b_ChargingFinishedSigLoss
      data VeCHMR_b_ChargingFinishedSigLoss: category=BOOLEAN, sw-calibration-access=READ-ONLY, type=Boolean
    VeCHMR_b_ChargeReq1
      data VeCHMR_b_ChargeReq1: category=BOOLEAN, sw-calibration-access=READ-ONLY, type=Boolean
    VeCHMR_b_ActiveHeatFlag
      data VeCHMR_b_ActiveHeatFlag: category=BOOLEAN, sw-calibration-access=READ-ONLY, type=Boolean
    VeCHMR_b_HCUHeatReq
      data VeCHMR_b_HCUHeatReq: category=BOOLEAN, sw-calibration-access=READ-ONLY, type=Boolean
    VeCHMR_b_OBCChargeReq
      data VeCHMR_b_OBCChargeReq: category=BOOLEAN, sw-calibration-access=READ-ONLY, type=Boolean
    VeCHMR_b_OBCHeatReq
      data VeCHMR_b_OBCHeatReq: category=BOOLEAN, sw-calibration-access=READ-ONLY, type=Boolean
    VeCHMR_U_HeatVoltSet
      data VeCHMR_U_HeatVoltSet: category=VALUE, sw-calibration-access=READ-ONLY, type=Float
    VeCHMR_k_PackOverChrgPower_Rank_CAN_CA
      data VeCHMR_k_PackOverChrgPower_Rank_CAN_CA: category=VALUE, sw-calibration-access=READ-ONLY, type=UInt8
    VeCHMR_b_HeatReset
      data VeCHMR_b_HeatReset: category=BOOLEAN, sw-calibration-access=READ-ONLY, type=Boolean
    VeCHMR_b_HCUReq
      data VeCHMR_b_HCUReq: category=BOOLEAN, sw-calibration-access=READ-ONLY, type=Boolean
    VeCHMR_k_PackChargingThermalSt
      data VeCHMR_k_PackChargingThermalSt: category=VALUE, sw-calibration-access=READ-ONLY, type=UInt8
    VeADPR_I_ChrgMaxOutCurr
      data VeADPR_I_ChrgMaxOutCurr: category=VALUE, type=Float
    VeCANR_e_ChrgFltSts
      data VeCANR_e_ChrgFltSts: category=VALUE, type=TeCHMR_e_ChrgOnbrdFailStatus
    VeCSCR_U_MaxCellVoltageMod
      data VeCSCR_U_MaxCellVoltageMod: category=VALUE, type=Float
    VeVSDR_I_HVCurrent
      data VeVSDR_I_HVCurrent: category=VALUE, type=Float
    VeCSCR_T_MinCellTempMod
      data VeCSCR_T_MinCellTempMod: category=VALUE, type=Float
    VeCSCR_T_MaxCellTempMod
      data VeCSCR_T_MaxCellTempMod: category=VALUE, type=Float
    VeCANR_e_ChrgStatus
      data VeCANR_e_ChrgStatus: category=VALUE, type=TeCHMR_e_ChrgMode
    VeFCMR_b_FastChgConntState
      data VeFCMR_b_FastChgConntState: category=BOOLEAN, type=Boolean
    VeCANR_k_ACChConnStatus
      data VeCANR_k_ACChConnStatus: category=VALUE, type=UInt8
    VeADPR_b_ChrgElecLock
      data VeADPR_b_ChrgElecLock: category=BOOLEAN, type=Boolean
    VeADPR_b_ChgPlugInCounterReset
      data VeADPR_b_ChgPlugInCounterReset: category=BOOLEAN, type=Boolean
    VeCANR_k_OBCDischarge_Button
      data VeCANR_k_OBCDischarge_Button: category=VALUE, type=UInt8
    VeCANR_k_DischargeVehicleState
      data VeCANR_k_DischargeVehicleState: category=VALUE, type=UInt8
    VeADPR_e_ChargerEnable
      data VeADPR_e_ChargerEnable: category=VALUE, type=TeCHMR_e_OBC_ChrgEnable
    VeADPR_b_ACChargEn
      data VeADPR_b_ACChargEn: category=BOOLEAN, type=Boolean
    VeHVSR_e_StateMode
      data VeHVSR_e_StateMode: category=VALUE, type=TeHVSR_e_StateMode
    VeADPR_k_HeatingMethod
      data VeADPR_k_HeatingMethod: category=VALUE, type=UInt8
    VeADPR_b_ACChConnect
      data VeADPR_b_ACChConnect: category=BOOLEAN, type=Boolean
    VeCSCR_U_PackVoltage_out
      data VeCSCR_U_PackVoltage_out: category=VALUE, type=Float
    VeADPR_b_ACpreheatingEn
      data VeADPR_b_ACpreheatingEn: category=BOOLEAN, type=Boolean
    VeADPR_k_S2Command
      data VeADPR_k_S2Command: category=VALUE, type=UInt8
    VeSOCR_min_TimeToCharge
      data VeSOCR_min_TimeToCharge: category=VALUE, type=Float
    VeADPR_b_KeepWarmEn
      data VeADPR_b_KeepWarmEn: category=BOOLEAN, type=Boolean
    VeTHMR_b_HeaterContator
      data VeTHMR_b_HeaterContator: category=BOOLEAN, type=Boolean
    VeADPR_b_ShutDownEn
      data VeADPR_b_ShutDownEn: category=BOOLEAN, type=Boolean
    VeCFLR_k_HVClosingReq
      data VeCFLR_k_HVClosingReq: category=VALUE, type=UInt8
    VeTHMR_I_BATT_ChgCorrCur
      data VeTHMR_I_BATT_ChgCorrCur: category=VALUE, type=Float
    VeTHMR_b_ACKeepWarmTimeOver
      data VeTHMR_b_ACKeepWarmTimeOver: category=BOOLEAN, type=Boolean
    VeTHMR_k_BMSToEHUInslationReq
      data VeTHMR_k_BMSToEHUInslationReq: category=VALUE, type=UInt8
    VeLLSR_b_ClearDTC
      data VeLLSR_b_ClearDTC: category=BOOLEAN, type=Boolean
    VeCANR_k_VCUHvPowerCtrl
      data VeCANR_k_VCUHvPowerCtrl: category=VALUE, type=UInt8
    VeCANR_k_VCUAllowToCharge
      data VeCANR_k_VCUAllowToCharge: category=VALUE, type=UInt8
    VeHVSR_b_ShutDownReq
      data VeHVSR_b_ShutDownReq: category=BOOLEAN, type=Boolean
    VeCANR_k_OBCWorkingMode
      data VeCANR_k_OBCWorkingMode: category=VALUE, type=UInt8
    VeCANR_k_ChrgStatus
      data VeCANR_k_ChrgStatus: category=VALUE, type=UInt8
    VeDHSR_k_FaultLvl
      data VeDHSR_k_FaultLvl: category=VALUE, type=UInt8
    VeCANR_kP_HCUCosumePower
      data VeCANR_kP_HCUCosumePower: category=VALUE, type=Float
    VeDHSR_r_ChrgFactor
      data VeDHSR_r_ChrgFactor: category=VALUE, type=Float
    VeCFLR_b_HeatContactor
      data VeCFLR_b_HeatContactor: category=BOOLEAN, type=Boolean
    VeTHMR_k_ThermalManageReq
      data VeTHMR_k_ThermalManageReq: category=VALUE, type=UInt8
package /CalibrationComponents
  parameter interface CHMR_if
    54 x parameter data prototype, all with sw-calibration-access=READ-WRITE:
      KeCHMR_Ah_BattRatedAh: category=VALUE, type=Float
      KeCHMR_I_ChgOverCurrentResetAddVal: category=VALUE, type=Float
      KeCHMR_I_ChgOverCurrentSetAddVal: category=VALUE, type=Float
      KeCHMR_I_ChrgCurrentRqOvrd: category=VALUE, type=Float
      KeCHMR_I_MaxCurrentOvrdValue: category=VALUE, type=Float
      KeCHMR_I_OverDischCurr_OnChrg: category=VALUE, type=Float
      KeCHMR_I_PreheatingChrgCurrentRq: category=VALUE, type=Float
      KeCHMR_U_DfltVoltageRequest: category=VALUE, type=Float
      KeCHMR_U_MaxVoltageCVPhase: category=VALUE, type=Float
      KeCHMR_U_MaxVoltageChange: category=VALUE, type=Float
      KeCHMR_U_PreheatVoltageReq: category=VALUE, type=Float
      KeCHMR_g_ChgOverCurrentResetGain: category=VALUE, type=Float
      KeCHMR_g_ChgOverCurrentSetGain: category=VALUE, type=Float
      KeCHMR_mU_CellMaxVoltOvrd: category=VALUE, type=Float
      KeCHMR_mU_CellMinVoltOvrd: category=VALUE, type=Float
      KeCHMR_min_ChargeTimeRemOvrd: category=VALUE, type=Float
      KeCHMR_t_CHMR_FunctionCallRate: category=VALUE, type=Float
      KeCHMR_t_ChrgEnDelay1: category=VALUE, type=Float
      KeCHMR_t_FunctionCallRate: category=VALUE, type=Float
      KeCHMR_t_MinTime2SwitchState{1..6}: category=VALUE, type=Float
      KeCHMR_t_MinTime2SwitchState8: category=VALUE, type=Float
      KeCHMR_t_MinTimeInterrupt2Shutdown: category=VALUE, type=Float
      KeCHMR_t_MinTimeShDown2OFF: category=VALUE, type=Float
      KeCHMR_t_OverCurrentThrehldResetDelay: category=VALUE, type=Float
      KeCHMR_t_OverCurrentThrehldSetDelay: category=VALUE, type=Float
      KeCHMR_t_SendSWS2command_Timer: category=VALUE, type=Float
      KeCHMR_t_TimeChrgNoPerform: category=VALUE, type=Float
      KeCHMR_t_TimeOverDischEDuCharg: category=VALUE, type=Float
      KeCHMR_t_WaitVCUAllow: category=VALUE, type=Float
      KeCHMR_b_ACDCBothConEn: category=BOOLEAN, type=Boolean
      KeCHMR_b_ACDCBothConOvrd: category=BOOLEAN, type=Boolean
      KeCHMR_b_ChargeCompleteEn: category=BOOLEAN, type=Boolean
      KeCHMR_b_ChargeCompleteOvrdVal: category=BOOLEAN, type=Boolean
      KeCHMR_b_ChargeEnOvrdEn: category=BOOLEAN, type=Boolean
      KeCHMR_b_ChargeEnOvrdVal: category=BOOLEAN, type=Boolean
      KeCHMR_b_ChrgCurrentRqOvrdCtrl: category=BOOLEAN, type=Boolean
      KeCHMR_b_ChrgEnOvrCtl: category=BOOLEAN, type=Boolean
      KeCHMR_b_ChrgEnOvrValue: category=BOOLEAN, type=Boolean
      KeCHMR_b_ChrgOverCurr_level3OvrdEn: category=BOOLEAN, type=Boolean
      KeCHMR_b_ChrgReqOvrCtl: category=BOOLEAN, type=Boolean
      KeCHMR_b_ChrgReqOvrValue: category=BOOLEAN, type=Boolean
      KeCHMR_b_ChrgStatusOvrCtl: category=BOOLEAN, type=Boolean
      KeCHMR_b_HeatingInsulationReqOvrdEn: category=BOOLEAN, type=Boolean
      KeCHMR_b_MaxCurrentOvrdCtrl: category=BOOLEAN, type=Boolean
      KeCHMR_b_OBCFailOvrdEn: category=BOOLEAN, type=Boolean
      KeCHMR_b_OBCFailOvrdVal: category=BOOLEAN, type=Boolean
      KeCHMR_k_ChrgOverCurr_level3OvrdVal: category=VALUE, type=UInt8
      KeCHMR_k_ChrgStatusOvrValue: category=VALUE, type=UInt8
      KeCHMR_k_HeatingInsulationReqOvrdVal: category=VALUE, type=UInt8
