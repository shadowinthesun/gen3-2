AUTOSAR XML (schema 4-0-3)
package /CalibrationComponents
  parameter interface HVIR_if
    50 x parameter data prototype, all with sw-calibration-access=READ-WRITE:
      KeHVIR_I_FastChgCurrentLoop: category=VALUE, type=Float
      KeHVIR_I_MainCurrentLoop: category=VALUE, type=Float
      KeHVIR_R_FastChgLoopResThreshold: category=VALUE, type=Float
      KeHVIR_R_MainLoopResThreshold: category=VALUE, type=Float
      KeHVIR_U_HS_HVILFaultedDflt: category=VALUE, type=Float
      KeHVIR_U_HS_HVILFaultedDflt1: category=VALUE, type=Float
      KeHVIR_U_LS_HVILFaultedDflt: category=VALUE, type=Float
      KeHVIR_U_LS_HVILFaultedDflt1: category=VALUE, type=Float
      KeHVIR_U_OvrdHS2_HVILVal: category=VALUE, type=Float
      KeHVIR_U_OvrdHS_HVIL1Val: category=VALUE, type=Float
      KeHVIR_U_OvrdHS_HVILVal: category=VALUE, type=Float
      KeHVIR_U_OvrdLS2_HVILVal: category=VALUE, type=Float
      KeHVIR_U_OvrdLS_HVIL1Val: category=VALUE, type=Float
      KeHVIR_U_OvrdLS_HVILVal: category=VALUE, type=Float
      KeHVIR_t_MainLoopHVILFltOffDbnc: category=VALUE, type=Float
      KeHVIR_t_MainLoopHVILFltOnDbnc: category=VALUE, type=Float
      KeHVIR_t_SampleRate: category=VALUE, type=Float
      KeHVIR_Cnt_DbncFastChgCommFlt: category=VALUE, type=UInt16
      KeHVIR_Cnt_DbncMainCommFlt: category=VALUE, type=UInt16
      KeHVIR_Cnt_FastChgLoopHVILFltDbnc: category=VALUE, type=UInt16
      KeHVIR_e_MainHVIL2_StOvrdVal: category=VALUE, type=TeHVIR_e_HVIL_Status
      KeHVIR_e_MainHVIL_StOvrdVal: category=VALUE, type=TeHVIR_e_HVIL_Status
      KeHVIR_e_FastChrgHVIL_StOvrdVal: category=VALUE, type=TeHVIR_e_HVIL_StatusFS
      KeHVIR_b_FastChgHVIL_fltOvrd: category=BOOLEAN, type=Boolean
      KeHVIR_b_FastChgHVIL_fltOvrdVal: category=BOOLEAN, type=Boolean
      KeHVIR_b_FastChrgHVIL_StOvrdCtrl: category=BOOLEAN, type=Boolean
      KeHVIR_b_MainHVIL2_StOvrd: category=BOOLEAN, type=Boolean
      KeHVIR_b_MainHVIL2_flt_Ctrl: category=BOOLEAN, type=Boolean
      KeHVIR_b_MainHVIL_StOvrd: category=BOOLEAN, type=Boolean
      KeHVIR_b_MainHVIL_flt_Ctrl: category=BOOLEAN, type=Boolean
      KeHVIR_b_OvrdHS2_HVILFltOvrd: category=BOOLEAN, type=Boolean
      KeHVIR_b_OvrdHS2_HVILFltVal: category=BOOLEAN, type=Boolean
      KeHVIR_b_OvrdHS2_HVILOvrd: category=BOOLEAN, type=Boolean
      KeHVIR_b_OvrdHS_HVIL1Ovrd: category=BOOLEAN, type=Boolean
      KeHVIR_b_OvrdHS_HVILFlt1Ovrd: category=BOOLEAN, type=Boolean
      KeHVIR_b_OvrdHS_HVILFlt1Val: category=BOOLEAN, type=Boolean
      KeHVIR_b_OvrdHS_HVILFltOvrd: category=BOOLEAN, type=Boolean
      KeHVIR_b_OvrdHS_HVILFltVal: category=BOOLEAN, type=Boolean
      KeHVIR_b_OvrdHS_HVILOvrd: category=BOOLEAN, type=Boolean
      KeHVIR_b_OvrdLS2_HVILFltOvrd: category=BOOLEAN, type=Boolean
      KeHVIR_b_OvrdLS2_HVILFltVal: category=BOOLEAN, type=Boolean
      KeHVIR_b_OvrdLS2_HVILOvrd: category=BOOLEAN, type=Boolean
      KeHVIR_b_OvrdLS_HVIL1Ovrd: category=BOOLEAN, type=Boolean
      KeHVIR_b_OvrdLS_HVILFlt1Ovrd: category=BOOLEAN, type=Boolean
      KeHVIR_b_OvrdLS_HVILFlt1Val: category=BOOLEAN, type=Boolean
      KeHVIR_b_OvrdLS_HVILFltOvrd: category=BOOLEAN, type=Boolean
      KeHVIR_b_OvrdLS_HVILFltVal: category=BOOLEAN, type=Boolean
      KeHVIR_b_OvrdLS_HVILOvrd: category=BOOLEAN, type=Boolean
      KeHVIR_k_MainHVIL2_flt_Val: category=VALUE, type=UInt8
      KeHVIR_k_MainHVIL_flt_Val: category=VALUE, type=UInt8
package /HVIR_Code_pkg/HVIR_Code_if
  23 x sender receiver interface:
    VeHVIR_k_MainHVIL_flt
      data VeHVIR_k_MainHVIL_flt: category=VALUE, sw-calibration-access=READ-ONLY, type=UInt8
    VeHVIR_e_MainHVIL_St
      data VeHVIR_e_MainHVIL_St: category=VALUE, sw-calibration-access=READ-ONLY, type=TeHVIR_e_HVIL_Status
    VeHVIR_b_FastChgHVIL_flt
      data VeHVIR_b_FastChgHVIL_flt: category=BOOLEAN, sw-calibration-access=READ-ONLY, type=Boolean
    VeHVIR_e_FastChgHVIL_St
      data VeHVIR_e_FastChgHVIL_St: category=VALUE, sw-calibration-access=READ-ONLY, type=TeHVIR_e_HVIL_StatusFS
    VeHVIR_k_MainHVIL2_flt
      data VeHVIR_k_MainHVIL2_flt: category=VALUE, sw-calibration-access=READ-ONLY, type=UInt8
    VeHVIR_e_MainHVIL2_St
      data VeHVIR_e_MainHVIL2_St: category=VALUE, sw-calibration-access=READ-ONLY, type=TeHVIR_e_HVIL_Status
    VeHVIR_K_HVIL_Rank_CAN
      data VeHVIR_K_HVIL_Rank_CAN: category=VALUE, sw-calibration-access=READ-ONLY, type=UInt8
    VeHVIR_k_VcleHVIL_flt
      data VeHVIR_k_VcleHVIL_flt: category=VALUE, sw-calibration-access=READ-ONLY, type=UInt8
    VeHVIR_e_VcleHVIL_St
      data VeHVIR_e_VcleHVIL_St: category=VALUE, sw-calibration-access=READ-ONLY, type=Float
    VeHVIR_k_MainHVILCircuit_flt
      data VeHVIR_k_MainHVILCircuit_flt: category=VALUE, sw-calibration-access=READ-ONLY, type=UInt8
    VeHVIR_k_MainHVILCircuit2_flt
      data VeHVIR_k_MainHVILCircuit2_flt: category=VALUE, sw-calibration-access=READ-ONLY, type=UInt8
    VeHVIR_b_HVILCircuitFlt_CAN
      data VeHVIR_b_HVILCircuitFlt_CAN: category=BOOLEAN, sw-calibration-access=READ-ONLY, type=Boolean
    VeLLSR_U_HS_HVIL
      data VeLLSR_U_HS_HVIL: category=VALUE, type=Float
    VeLLSR_b_HS_HVIL_Inv
      data VeLLSR_b_HS_HVIL_Inv: category=BOOLEAN, type=Boolean
    VeLLSR_U_LS_HVIL
      data VeLLSR_U_LS_HVIL: category=VALUE, type=Float
    VeLLSR_b_LS_HVIL_Inv
      data VeLLSR_b_LS_HVIL_Inv: category=BOOLEAN, type=Boolean
    VeLLSR_U_HS_FCHVIL
      data VeLLSR_U_HS_FCHVIL: category=VALUE, type=Float
    VeLLSR_b_HS_FCHVIL_Inv
      data VeLLSR_b_HS_FCHVIL_Inv: category=BOOLEAN, type=Boolean
    VeLLSR_U_LS_FCHVIL
      data VeLLSR_U_LS_FCHVIL: category=VALUE, type=Float
    VeLLSR_b_LS_FCHVIL_Inv
      data VeLLSR_b_LS_FCHVIL_Inv: category=BOOLEAN, type=Boolean
    VeLLSR_U_VcleHVIL
      data VeLLSR_U_VcleHVIL: category=VALUE, type=Float
    VeLLSR_b_VcleHVIL_Inv
      data VeLLSR_b_VcleHVIL_Inv: category=BOOLEAN, type=Boolean
    VeLLSR_b_ClearDTC
      data VeLLSR_b_ClearDTC: category=BOOLEAN, type=Boolean
