AUTOSAR XML (schema 4-0-3)
package /CalibrationComponents
  parameter interface ISLR_if
    45 x parameter data prototype, all with sw-calibration-access=READ-WRITE:
      KeISLR_Cnt_FastAverageFilter: category=VALUE, type=Float
      KeISLR_Cnt_SlowAverageFilter: category=VALUE, type=Float
      KeISLR_U_VoltageThresh: category=VALUE, type=Float
      KeISLR_kR_ChrgIslErrLevel{1..3}: category=VALUE, type=Float
      KeISLR_kR_DischrgIslErrLevel{1..3}: category=VALUE, type=Float
      KeISLR_kR_MaxIslr: category=VALUE, type=Float
      KeISLR_kR_NegRes_Val: category=VALUE, type=Float
      KeISLR_kR_ParallelResistance: category=VALUE, type=Float
      KeISLR_kR_PosRes_Val: category=VALUE, type=Float
      KeISLR_kR_SeriesResistance: category=VALUE, type=Float
      KeISLR_k_Factor: category=VALUE, type=Float
      KeISLR_k_SecurityFac: category=VALUE, type=Float
      KeISLR_t_FunctionCall: category=VALUE, type=Float
      KeISLR_t_IsolationAftContactorCloseDelay: category=VALUE, type=Float
      KeISLR_t_IsolationBefContactorCloseDelay: category=VALUE, type=Float
      KeISLR_t_Timer2CloseSwtch1: category=VALUE, type=Float
      KeISLR_t_Timer2CloseSwtch1Exit: category=VALUE, type=Float
      KeISLR_t_Timer2CloseSwtch1ForCheckQuick: category=VALUE, type=Float
      KeISLR_t_Timer2CloseSwtch2: category=VALUE, type=Float
      KeISLR_t_Timer2CloseSwtch2Exit: category=VALUE, type=Float
      KeISLR_t_Timer2CloseSwtchs: category=VALUE, type=Float
      KeISLR_e_IsolationFaultLvl{1..3}: category=VALUE, type=TeISLR_e_IsolationStatus
      KeISLR_e_IsolationNormal: category=VALUE, type=TeISLR_e_IsolationStatus
      KeISLR_e_IsolationBattError: category=VALUE, type=TeISLR_e_IsolationStatus1
      KeISLR_e_IsolationHvError: category=VALUE, type=TeISLR_e_IsolationStatus1
      KeISLR_e_IsolationOk: category=VALUE, type=TeISLR_e_IsolationStatus1
      KeISLR_b_Isolation_flt_En: category=BOOLEAN, type=Boolean
      KeISLR_b_Isolation_flt_L1_En: category=BOOLEAN, type=Boolean
      KeISLR_b_Isolation_flt_L2_En: category=BOOLEAN, type=Boolean
      KeISLR_b_OvrdStatus1: category=BOOLEAN, type=Boolean
      KeISLR_b_OvrdSwitch1Cntrl: category=BOOLEAN, type=Boolean
      KeISLR_b_OvrdSwitch1CntrlVal: category=BOOLEAN, type=Boolean
      KeISLR_b_OvrdSwitch2Cntrl: category=BOOLEAN, type=Boolean
      KeISLR_b_OvrdSwitch2CntrlVal: category=BOOLEAN, type=Boolean
      KeISLR_kR_NegRes_En: category=BOOLEAN, type=Boolean
      KeISLR_kR_PosRes_En: category=BOOLEAN, type=Boolean
      KeISLR_k_Isolation_flt_L1_Val: category=VALUE, type=UInt8
      KeISLR_k_Isolation_flt_L2_Val: category=VALUE, type=UInt8
      KeISLR_k_Isolation_flt_Val: category=VALUE, type=UInt8
package /ISLR_Code_pkg/ISLR_Code_if
  36 x sender receiver interface:
    VeISLR_b_Switch1_drv
      data VeISLR_b_Switch1_drv: category=BOOLEAN, sw-calibration-access=READ-ONLY, type=Boolean
    VeISLR_b_Switch2_drv
      data VeISLR_b_Switch2_drv: category=BOOLEAN, sw-calibration-access=READ-ONLY, type=Boolean
    VeISLR_kR_InsolationResistance
      data VeISLR_kR_InsolationResistance: category=VALUE, sw-calibration-access=READ-ONLY, type=Float
    VeISLR_e_IsolationStatus1
      data VeISLR_e_IsolationStatus1: category=VALUE, sw-calibration-access=READ-ONLY, type=TeISLR_e_IsolationStatus1
    VeISLR_e_IsolationStatus
      data VeISLR_e_IsolationStatus: category=VALUE, sw-calibration-access=READ-ONLY, type=TeISLR_e_IsolationStatus
    VeISLR_b_IsolationDetectedBefContactorClose_flt
      data VeISLR_b_IsolationDetectedBefContactorClose_flt: category=BOOLEAN, sw-calibration-access=READ-ONLY, type=Boolean
    VeISLR_b_IsolationDetectedAftContactorClose_flt
      data VeISLR_b_IsolationDetectedAftContactorClose_flt: category=BOOLEAN, sw-calibration-access=READ-ONLY, type=Boolean
    VeISLR_kR_NegRes
      data VeISLR_kR_NegRes: category=VALUE, sw-calibration-access=READ-ONLY, type=Float
    VeISLR_kR_PosRes
      data VeISLR_kR_PosRes: category=VALUE, sw-calibration-access=READ-ONLY, type=Float
    VeISLR_k_Isolation_flt
      data VeISLR_k_Isolation_flt: category=VALUE, sw-calibration-access=READ-ONLY, type=UInt8
    VeISLR_k_Isolation_DisableAck
      data VeISLR_k_Isolation_DisableAck: category=VALUE, sw-calibration-access=READ-ONLY, type=UInt8
    VeISLR_V_NegToChassisAvg
      data VeISLR_V_NegToChassisAvg: category=VALUE, sw-calibration-access=READ-ONLY, type=Float
    VeISLR_Sum_NegToChassis
      data VeISLR_Sum_NegToChassis: category=VALUE, sw-calibration-access=READ-ONLY, type=Float
    VeISLR_Sum_b
      data VeISLR_Sum_b: category=VALUE, sw-calibration-access=READ-ONLY, type=Float
    VeISLR_V_PosToChassis
      data VeISLR_V_PosToChassis: category=VALUE, sw-calibration-access=READ-ONLY, type=Float
    VeISLR_V_PosToChassisAvg
      data VeISLR_V_PosToChassisAvg: category=VALUE, sw-calibration-access=READ-ONLY, type=Float
    VeISLR_Cnt_AverageFilter
      data VeISLR_Cnt_AverageFilter: category=VALUE, sw-calibration-access=READ-ONLY, type=Float
    VeISLR_Sum_PosChassis
      data VeISLR_Sum_PosChassis: category=VALUE, sw-calibration-access=READ-ONLY, type=Float
    VeISLR_Sum_a
      data VeISLR_Sum_a: category=VALUE, sw-calibration-access=READ-ONLY, type=Float
    VeISLR_K_a
      data VeISLR_K_a: category=VALUE, sw-calibration-access=READ-ONLY, type=Float
    VeISLR_K_b
      data VeISLR_K_b: category=VALUE, sw-calibration-access=READ-ONLY, type=Float
    VeISLR_k_Isolation_L1_flt
      data VeISLR_k_Isolation_L1_flt: category=VALUE, sw-calibration-access=READ-ONLY, type=UInt8
    VeISLR_k_Isolation_L2_flt
      data VeISLR_k_Isolation_L2_flt: category=VALUE, sw-calibration-access=READ-ONLY, type=UInt8
    VeISLR_k_Isolation_Rank_CAN
      data VeISLR_k_Isolation_Rank_CAN: category=VALUE, sw-calibration-access=READ-ONLY, type=UInt8
    VeISLR_InterIsolation_flt
      data VeISLR_InterIsolation_flt: category=VALUE, sw-calibration-access=READ-ONLY, type=UInt8
    VeISLR_ExterIsolation_flt
      data VeISLR_ExterIsolation_flt: category=VALUE, sw-calibration-access=READ-ONLY, type=UInt8
    VeISLR_k_IsolationFlt_CAN
      data VeISLR_k_IsolationFlt_CAN: category=VALUE, sw-calibration-access=READ-ONLY, type=UInt8
    VeLLSR_mU_PackSideIsolationVoltagePos
      data VeLLSR_mU_PackSideIsolationVoltagePos: category=VALUE, type=Float
    VeHVSR_b_IsolationActive
      data VeHVSR_b_IsolationActive: category=BOOLEAN, type=Boolean
    VeLLSR_mU_PackSideIsolationVoltageNeg
      data VeLLSR_mU_PackSideIsolationVoltageNeg: category=VALUE, type=Float
    VeVSDR_U_HighVoltage
      data VeVSDR_U_HighVoltage: category=VALUE, type=Float
    VeHVSR_e_StateMode
      data VeHVSR_e_StateMode: category=VALUE, type=TeHVSR_e_StateMode
    VeHVSR_b_FastIsolationActive
      data VeHVSR_b_FastIsolationActive: category=BOOLEAN, type=Boolean
    VeCFLR_b_ContactorsClosed
      data VeCFLR_b_ContactorsClosed: category=BOOLEAN, type=Boolean
    VeLLSR_b_ClearDTC
      data VeLLSR_b_ClearDTC: category=BOOLEAN, type=Boolean
    VeLLSR_k_Isolation_Disable
      data VeLLSR_k_Isolation_Disable: category=VALUE, type=UInt8
