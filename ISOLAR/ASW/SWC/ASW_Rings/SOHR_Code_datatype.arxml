AUTOSAR XML (schema 4-0-3)
standard types defined: Float, Boolean, UInt8, float32, boolean, uint8
package /SOHR_Code_pkg/SOHR_Code_dt
  unit NoUnit: factor-si-to-unit=1, offset-si-to-unit=0
  impl type rt_Array_Float_6: category=ARRAY
    element rt_Array_Float_6: array-size=6, array-size-semantics=FIXED-SIZE, implementation-data-type=Float
package /SOHR_Code_pkg/SOHR_Code_dt/ApplDataTypes
  5 x app type, all with sw-calibration-access=READ-WRITE:
    Float: category=VALUE, compu {identical}, range phys -INF..INF
    Boolean: category=BOOLEAN, compu {0=FALSE, 1=TRUE}
    UInt8: category=VALUE, compu {identical}, range phys 0..255
    Appl_KtSOHR_r_SOHCoefficient_Table: category=CURVE, sw-calprm-axis-set={sw-axis-index=1, category=COM_AXIS, sw-axis-grouped=Appl_KxSOHR_r_SOHCoefficient}, compu {identical}, range phys -1000000..1000000, sw-record-layout=Cur_f32
    Appl_KxSOHR_r_SOHCoefficient: category=COM_AXIS, sw-calprm-axis-set={sw-axis-index=1, sw-axis-individual={compu {identical}, sw-max-axis-points=6, sw-min-axis-points=6, range phys -1000000..1000000}}, sw-record-layout=Distr_f32_M
package /SOHR_Code_pkg/SOHR_Code_dt/ApplDataTypes/RecordLayouts
  sw record layout Cur_f32: sw-record-layout-group={short-label=Cur_f32, category=COLUMN_DIR, sw-record-layout-group-axis=0, sw-record-layout-group-index=X, sw-record-layout-group-from=1, sw-record-layout-group-to=-1, sw-record-layout-v={short-label=Val, base-type=float32, sw-record-layout-v-axis=0, sw-record-layout-v-prop=VALUE, sw-record-layout-v-index=X}}
  sw record layout Distr_f32_M: sw-record-layout-group={short-label=X, category=INDEX_INCR, sw-record-layout-group-axis=1, sw-record-layout-group-from=1, sw-record-layout-group-to=-1, sw-record-layout-v={short-label=VALUE, base-type=float32, sw-record-layout-v-axis=1, sw-record-layout-v-prop=VALUE}}
package /SOHR_Code_pkg/SOHR_Code_dt/DataTypeMappings
  data type mapping set SOHR_CodeDataTypeMappingsSet
    data-type-maps:
      application-data-type=Float, implementation-data-type=Float
      application-data-type=Boolean, implementation-data-type=Boolean
      application-data-type=UInt8, implementation-data-type=UInt8
      application-data-type=Appl_KtSOHR_r_SOHCoefficient_Table, implementation-data-type=rt_Array_Float_6
      application-data-type=Appl_KxSOHR_r_SOHCoefficient, implementation-data-type=rt_Array_Float_6
package /SOHR_Code_pkg/SOHR_Code_dt/Ground
  constant specification KtSOHR_r_SOHCoefficient_Table: value-spec=[1 0.9800000190734863 0.949999988079071 0.8999999761581421 0.8500000238418579 0.800000011920929]
  constant specification KxSOHR_r_SOHCoefficient: value-spec=[0 18340 35850 70730 93650 104950]
package /SOHR_Code_pkg/SOHR_Code_dt/SwAddrMethods
  sw addr method CODE: section-type=CODE
  sw addr method CONST: section-type=CONST
  sw addr method VAR: section-type=VAR
