AUTOSAR XML (schema 4-0-3)
package /CalibrationComponents
  parameter interface GCFR_if
    9 x parameter data prototype, all with sw-calibration-access=READ-WRITE:
      KeGCFR_Cnt_NumberofTempReadings: category=VALUE, type=UInt8
      KeGCFR_Cnt_NumberofCells: category=VALUE, type=UInt8
      KeGCFR_Ah_BatteryCellsCap: category=VALUE, type=Float
      KeGCFR_Cnt_NumberOfCSC: category=VALUE, type=UInt8
      KeGCFR_Cnt_NumberOfCellParal: category=VALUE, type=UInt8
      KeGCFR_Cnt_NumberofHeatFilms: category=VALUE, type=UInt8
      KeLLSR_b_ActiveKeriant_En: category=BOOLEAN, type=Boolean
      KeLLSR_k_ActiveKariant_Val: category=VALUE, type=UInt8
      KeGCFR_Cnt_NumberOfWaterThermistors: category=VALUE, type=UInt8
package /GCFR_pkg/GCFR_if
  16 x sender receiver interface:
    VeGCFR_Cnt_NumberofCells
      data VeGCFR_Cnt_NumberofCells: category=VALUE, sw-calibration-access=READ-ONLY, type=UInt8
    VeGCFR_Cnt_NumberofTempReadings
      data VeGCFR_Cnt_NumberofTempReadings: category=VALUE, sw-calibration-access=READ-ONLY, type=UInt8
    VeGCFR_Cnt_NumberOfCSC
      data VeGCFR_Cnt_NumberOfCSC: category=VALUE, sw-calibration-access=READ-ONLY, type=UInt8
    VeGCFR_Cnt_NumberofHeatFilms
      data VeGCFR_Cnt_NumberofHeatFilms: category=VALUE, sw-calibration-access=READ-ONLY, type=UInt8
    VeGCFR_Cnt_NumberOfCellParal
      data VeGCFR_Cnt_NumberOfCellParal: category=VALUE, sw-calibration-access=READ-ONLY, type=UInt8
    VeGCFR_Ah_BatteryCellsCap
      data VeGCFR_Ah_BatteryCellsCap: category=VALUE, sw-calibration-access=READ-ONLY, type=Float
    VeGCFR_n_batteryDataFrameNum
      data VeGCFR_n_batteryDataFrameNum: category=VALUE, sw-calibration-access=READ-ONLY, type=UInt8
    VeGCFR_n_batteryDataFrameNumSum
      data VeGCFR_n_batteryDataFrameNumSum: category=VALUE, sw-calibration-access=READ-ONLY, type=UInt8
    VeGCFR_n_BattTypeCode
      data VeGCFR_n_BattTypeCode: category=VALUE, sw-calibration-access=READ-ONLY, type=UInt8
    VeGCFR_n_PackCodeLength
      data VeGCFR_n_PackCodeLength: category=VALUE, sw-calibration-access=READ-ONLY, type=UInt8
    VeGCFR_n_PackSubsysNum
      data VeGCFR_n_PackSubsysNum: category=VALUE, sw-calibration-access=READ-ONLY, type=UInt8
    VeGCFR_n_PackSubsysSum
      data VeGCFR_n_PackSubsysSum: category=VALUE, sw-calibration-access=READ-ONLY, type=UInt8
    VeGCFR_U_PackVoltageUpperLimit
      data VeGCFR_U_PackVoltageUpperLimit: category=VALUE, sw-calibration-access=READ-ONLY, type=Float
    VeGCFR_U_PackVoltageLowerLimit
      data VeGCFR_U_PackVoltageLowerLimit: category=VALUE, sw-calibration-access=READ-ONLY, type=Float
    KeGCFR_Cnt_NumberOfWaterThermistors
      data KeGCFR_Cnt_NumberOfWaterThermistors: category=VALUE, sw-calibration-access=READ-ONLY, type=UInt8
    VeLLSR_k_ActiveVariant
      data VeLLSR_k_ActiveVariant: category=VALUE, sw-calibration-access=READ-ONLY, type=UInt8
