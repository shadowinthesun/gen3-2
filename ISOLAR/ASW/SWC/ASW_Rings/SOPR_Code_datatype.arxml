AUTOSAR XML (schema 4-0-3)
standard types defined: Float, Boolean, UInt8, float32, boolean, uint8
package /SOPR_Code_pkg/SOPR_Code_dt
  unit NoUnit: factor-si-to-unit=1, offset-si-to-unit=0
  impl type TeVSDR_e_CurrentFlowState: category=VALUE, base-type=uint8
  impl type TeHVSR_e_StateMode: category=VALUE, base-type=uint8
package /SOPR_Code_pkg/SOPR_Code_dt/ApplDataTypes
  5 x app type, all with sw-calibration-access=READ-WRITE:
    Float: category=VALUE, compu {identical}, range phys -INF..INF
    Boolean: category=BOOLEAN, compu {0=FALSE, 1=TRUE}
    TeVSDR_e_CurrentFlowState: category=VALUE, compu {0=CeVSDR_e_CurFlowStateInit, 1=CeVSDR_e_CurFlowStateChrg, 2=CeVSDR_e_CurFlowStateDischrg, 3=CeVSDR_e_CurFlowStateInvalid}
    TeHVSR_e_StateMode: category=VALUE, compu {0=CeHVSR_e_StateModeReserved, 1=CeHVSR_e_StateModeInitial, 2=CeHVSR_e_StateModeStandBy, 3=CeHVSR_e_StateModePrecharge, 4=CeHVSR_e_StateModeNormalDischarge, 5=CeHVSR_e_StateModeWarningPowerReduction, 6=CeHVSR_e_StateModePowerReduction, 7=CeHVSR_e_StateModePreChargeFailed, 8=CeHVSR_e_StateModePowerHoldMode, 9=CeHVSR_e_StateModeShutdown, 10=CeHVSR_e_StateModeServiceMode, 11=CeHVSR_e_StateModeReady, 12=CeHVSR_e_StateModeAC_ChargeMode, 13=CeHVSR_e_StateModeEndOfCharge, 14=CeHVSR_e_StateModeDC_ChargeMode, 15=CeHVSR_e_StateModeSystemErr, 16=CeHVSR_e_StateModeTempChargState, 17=CeHVSR_e_StateModeHeatPreChgState, 18=CeHVSR_e_StateModeHeatingState, 19=CeHVSR_e_StateModeHeatFinishState}
    UInt8: category=VALUE, compu {identical}, range phys 0..255
package /SOPR_Code_pkg/SOPR_Code_dt/DataTypeMappings
  data type mapping set SOPR_CodeDataTypeMappingsSet
    data-type-maps:
      application-data-type=Float, implementation-data-type=Float
      application-data-type=Boolean, implementation-data-type=Boolean
      application-data-type=TeVSDR_e_CurrentFlowState, implementation-data-type=TeVSDR_e_CurrentFlowState
      application-data-type=TeHVSR_e_StateMode, implementation-data-type=TeHVSR_e_StateMode
      application-data-type=UInt8, implementation-data-type=UInt8
package /SOPR_Code_pkg/SOPR_Code_dt/SwAddrMethods
  sw addr method CODE: section-type=CODE
  sw addr method CONST: section-type=CONST
  sw addr method VAR: section-type=VAR
