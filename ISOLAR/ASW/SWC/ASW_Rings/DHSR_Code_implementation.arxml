AUTOSAR XML (schema 4-0-3)
package /DHSR_Code_pkg/DHSR_Code_imp
  swc implementation DHSR_Code: programming-language=C, sw-version=1.295.1, used-code-generator=Embedded Coder 7.2 (R2019a) 23-Nov-2018, vendor-id=0, behavior=DHSR_Code
    code-descriptors:
      code Code
        artifact-descriptors:
          short-label=DHSR_Code_c, category=SWSRC
          short-label=g_App_DualDebouncerOnOff_c, category=SWSRC
          short-label=ASW_Types_h, category=SWHDR
          short-label=DHSR_Code_h, category=SWHDR
          short-label=DHSR_Code_private_h, category=SWHDR
          short-label=DHSR_Code_types_h, category=SWHDR
          short-label=g_App_DualDebouncerOnOff_h, category=SWHDR
          short-label=g_App_DualDebouncerOnOff_private_h, category=SWHDR
          short-label=g_App_DualDebouncerOnOff_types_h, category=SWHDR
          short-label=rtwtypes_h, category=SWHDR
          short-label=tmwtypes_h, category=SWHDR
    resource consumption RsrcCons_DHSR_Code
