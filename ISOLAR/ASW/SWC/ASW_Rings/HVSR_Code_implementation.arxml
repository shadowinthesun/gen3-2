AUTOSAR XML (schema 4-0-3)
package /HVSR_Code_pkg/HVSR_Code_imp
  swc implementation HVSR_Code: programming-language=C, sw-version=1.295.1, used-code-generator=Embedded Coder 7.2 (R2019a) 23-Nov-2018, vendor-id=0, behavior=HVSR_Code
    code-descriptors:
      code Code
        artifact-descriptors:
          short-label=HVSR_Code_c, category=SWSRC
          short-label=HVSR_Code_Calibration_c, category=SWSRC
          short-label=HVSR_Code_FaultHandler_c, category=SWSRC
          short-label=HVSR_Code_Main_c, category=SWSRC
          short-label=HVSR_Code_data_c, category=SWSRC
          short-label=g_App_DualDebouncerOnOff_c, category=SWSRC
          short-label=ASW_Types_h, category=SWHDR
          short-label=HVSR_Code_h, category=SWHDR
          short-label=HVSR_Code_Calibration_h, category=SWHDR
          short-label=HVSR_Code_FaultHandler_h, category=SWHDR
          short-label=HVSR_Code_Main_h, category=SWHDR
          short-label=HVSR_Code_private_h, category=SWHDR
          short-label=HVSR_Code_types_h, category=SWHDR
          short-label=g_App_DualDebouncerOnOff_h, category=SWHDR
          short-label=g_App_DualDebouncerOnOff_private_h, category=SWHDR
          short-label=g_App_DualDebouncerOnOff_types_h, category=SWHDR
          short-label=rtwtypes_h, category=SWHDR
          short-label=tmwtypes_h, category=SWHDR
    resource consumption RsrcCons_HVSR_Code
