AUTOSAR XML (schema 4-0-3)
package /HMIR_Code_datatype_AVS_pkg
  constant specification KtHMIR_kl_SOC2_AVS: value-spec=[5, 10, 20, 30, 40, 50, 60, 70, 80, 90, 100]
  constant specification KtHMIR_kl_SOC2Range_AVS: value-spec=[0, 1, 8, 13, 28, 45, 63, 70, 75, 83, 100]
  constant specification mapping set HMIR_Code_datatype_AVS_MappingSet
    mappings:
      appl-constant=KtHMIR_kl_SOC2, impl-constant=KtHMIR_kl_SOC2_AVS
      appl-constant=KtHMIR_kl_SOC2Range, impl-constant=KtHMIR_kl_SOC2Range_AVS
