AUTOSAR XML (schema 4-0-3)
package /GCFR_Code_pkg/GCFR_imp
  swc implementation GCFR: programming-language=C, sw-version=1.447.1, used-code-generator=Embedded Coder 7.2 (R2019a) 23-Nov-2018, vendor-id=0, behavior=GCFR
    code-descriptors:
      code Code
        artifact-descriptors:
          short-label=GCFR_Code_c, category=SWSRC
          short-label=GCFR_Code_h, category=SWHDR
          short-label=GCFR_Code_private_h, category=SWHDR
          short-label=GCFR_Code_types_h, category=SWHDR
          short-label=rtwtypes_h, category=SWHDR
    resource consumption RsrcCons_GCFR_Code
