AUTOSAR XML (schema 4-0-3)
package /CPLR_Code_pkg/CPLR_Code_if
  70 x sender receiver interface:
    VeCPLR_k_PackOverVolt_L1_flt
      data VeCPLR_k_PackOverVolt_L1_flt: category=VALUE, sw-calibration-access=READ-ONLY, type=UInt8
    VeCPLR_k_PackOverVoltRank
      data VeCPLR_k_PackOverVoltRank: category=VALUE, sw-calibration-access=READ-ONLY, type=UInt8
    VeCPLR_k_PackOverVolt_Rank_CAN
      data VeCPLR_k_PackOverVolt_Rank_CAN: category=VALUE, sw-calibration-access=READ-ONLY, type=UInt8
    VeCPLR_k_PackOverVolt_L3_flt
      data VeCPLR_k_PackOverVolt_L3_flt: category=VALUE, sw-calibration-access=READ-ONLY, type=UInt8
    VeCPLR_k_PackUnderVolt_L2_flt
      data VeCPLR_k_PackUnderVolt_L2_flt: category=VALUE, sw-calibration-access=READ-ONLY, type=UInt8
    VeCPLR_k_PackUnderVoltRank
      data VeCPLR_k_PackUnderVoltRank: category=VALUE, sw-calibration-access=READ-ONLY, type=UInt8
    VeCPLR_k_PackUnderVolt_Rank_CAN
      data VeCPLR_k_PackUnderVolt_Rank_CAN: category=VALUE, sw-calibration-access=READ-ONLY, type=UInt8
    VeCPLR_k_PackUnderVolt_L3_flt
      data VeCPLR_k_PackUnderVolt_L3_flt: category=VALUE, sw-calibration-access=READ-ONLY, type=UInt8
    VeCPLR_k_OverCV_L1_flt
      data VeCPLR_k_OverCV_L1_flt: category=VALUE, sw-calibration-access=READ-ONLY, type=UInt8
    VeCPLR_k_OverCV_L3_flt
      data VeCPLR_k_OverCV_L3_flt: category=VALUE, sw-calibration-access=READ-ONLY, type=UInt8
    VeCPLR_k_OverCV_L4_flt
      data VeCPLR_k_OverCV_L4_flt: category=VALUE, sw-calibration-access=READ-ONLY, type=UInt8
    VeCPLR_k_CellOverVoltRank
      data VeCPLR_k_CellOverVoltRank: category=VALUE, sw-calibration-access=READ-ONLY, type=UInt8
    VeCPLR_k_OverCV_Rank_CAN
      data VeCPLR_k_OverCV_Rank_CAN: category=VALUE, sw-calibration-access=READ-ONLY, type=UInt8
    VeCPLR_k_DeltaCV_L1_flt
      data VeCPLR_k_DeltaCV_L1_flt: category=VALUE, sw-calibration-access=READ-ONLY, type=UInt8
    VeCPLR_k_DeltaCV_L2_flt
      data VeCPLR_k_DeltaCV_L2_flt: category=VALUE, sw-calibration-access=READ-ONLY, type=UInt8
    VeCPLR_k_DeltaCV_L3_flt
      data VeCPLR_k_DeltaCV_L3_flt: category=VALUE, sw-calibration-access=READ-ONLY, type=UInt8
    VeCPLR_k_DeltaCV_Rank_CAN
      data VeCPLR_k_DeltaCV_Rank_CAN: category=VALUE, sw-calibration-access=READ-ONLY, type=UInt8
    VeCPLR_k_UnderCV_L2_flt
      data VeCPLR_k_UnderCV_L2_flt: category=VALUE, sw-calibration-access=READ-ONLY, type=UInt8
    VeCPLR_k_UnderCV_L3_flt
      data VeCPLR_k_UnderCV_L3_flt: category=VALUE, sw-calibration-access=READ-ONLY, type=UInt8
    VeCPLR_k_UnderCV_L4_flt
      data VeCPLR_k_UnderCV_L4_flt: category=VALUE, sw-calibration-access=READ-ONLY, type=UInt8
    VeCPLR_k_CellUnderVoltRank
      data VeCPLR_k_CellUnderVoltRank: category=VALUE, sw-calibration-access=READ-ONLY, type=UInt8
    VeCPLR_k_UnderCV_Rank_CAN
      data VeCPLR_k_UnderCV_Rank_CAN: category=VALUE, sw-calibration-access=READ-ONLY, type=UInt8
    VeCPLR_k_OverCT_L1_flt
      data VeCPLR_k_OverCT_L1_flt: category=VALUE, sw-calibration-access=READ-ONLY, type=UInt8
    VeCPLR_k_OverCT_L3_flt
      data VeCPLR_k_OverCT_L3_flt: category=VALUE, sw-calibration-access=READ-ONLY, type=UInt8
    VeCPLR_k_OverCT_L4_flt
      data VeCPLR_k_OverCT_L4_flt: category=VALUE, sw-calibration-access=READ-ONLY, type=UInt8
    VeCPLR_k_PackOverTempRank
      data VeCPLR_k_PackOverTempRank: category=VALUE, sw-calibration-access=READ-ONLY, type=UInt8
    VeCPLR_k_OverCT_Rank_CAN
      data VeCPLR_k_OverCT_Rank_CAN: category=VALUE, sw-calibration-access=READ-ONLY, type=UInt8
    VeCPLR_k_DeltaCT_L1_flt
      data VeCPLR_k_DeltaCT_L1_flt: category=VALUE, sw-calibration-access=READ-ONLY, type=UInt8
    VeCPLR_k_DeltaCT_L2_flt
      data VeCPLR_k_DeltaCT_L2_flt: category=VALUE, sw-calibration-access=READ-ONLY, type=UInt8
    VeCPLR_k_DeltaCT_L3_flt
      data VeCPLR_k_DeltaCT_L3_flt: category=VALUE, sw-calibration-access=READ-ONLY, type=UInt8
    VeCPLR_k_DeltaTempRank
      data VeCPLR_k_DeltaTempRank: category=VALUE, sw-calibration-access=READ-ONLY, type=UInt8
    VeCPLR_k_DeltaCT_Rank_CAN
      data VeCPLR_k_DeltaCT_Rank_CAN: category=VALUE, sw-calibration-access=READ-ONLY, type=UInt8
    VeCPLR_k_UnderCT_L1_flt
      data VeCPLR_k_UnderCT_L1_flt: category=VALUE, sw-calibration-access=READ-ONLY, type=UInt8
    VeCPLR_k_UnderCT_L3_flt
      data VeCPLR_k_UnderCT_L3_flt: category=VALUE, sw-calibration-access=READ-ONLY, type=UInt8
    VeCPLR_k_UnderCT_L4_flt
      data VeCPLR_k_UnderCT_L4_flt: category=VALUE, sw-calibration-access=READ-ONLY, type=UInt8
    VeCPLR_k_UnderCT_Rank_CAN
      data VeCPLR_k_UnderCT_Rank_CAN: category=VALUE, sw-calibration-access=READ-ONLY, type=UInt8
    VeCPLR_k_ThermalRunaway_flt
      data VeCPLR_k_ThermalRunaway_flt: category=VALUE, sw-calibration-access=READ-ONLY, type=UInt8
    VeCPLR_b_ThermalRunaway_Rank_CAN
      data VeCPLR_b_ThermalRunaway_Rank_CAN: category=BOOLEAN, sw-calibration-access=READ-ONLY, type=Boolean
    VeCPLR_k_PCBOverTemp_flt
      data VeCPLR_k_PCBOverTemp_flt: category=VALUE, sw-calibration-access=READ-ONLY, type=UInt8
    VeCPLR_k_UnderCV_L0_flt
      data VeCPLR_k_UnderCV_L0_flt: category=VALUE, sw-calibration-access=READ-ONLY, type=UInt8
    VeCPLR_k_OverCV_L2_flt
      data VeCPLR_k_OverCV_L2_flt: category=VALUE, sw-calibration-access=READ-ONLY, type=UInt8
    VeCPLR_k_OverCurrDischarge_L3_flt
      data VeCPLR_k_OverCurrDischarge_L3_flt: category=VALUE, sw-calibration-access=READ-ONLY, type=UInt8
    VeCPLR_k_OverChrgCurrRank
      data VeCPLR_k_OverChrgCurrRank: category=VALUE, sw-calibration-access=READ-ONLY, type=UInt8
    VeCPLR_k_OverDchrgCurrRank
      data VeCPLR_k_OverDchrgCurrRank: category=VALUE, sw-calibration-access=READ-ONLY, type=UInt8
    VeCPLR_k_SocJump_flt
      data VeCPLR_k_SocJump_flt: category=VALUE, sw-calibration-access=READ-ONLY, type=UInt8
    VeCPLR_k_SocLowRank
      data VeCPLR_k_SocLowRank: category=VALUE, sw-calibration-access=READ-ONLY, type=UInt8
    VeCPLR_k_SocLowRank_RM
      data VeCPLR_k_SocLowRank_RM: category=VALUE, sw-calibration-access=READ-ONLY, type=UInt8
    VeCPLR_k_SocOver_flt
      data VeCPLR_k_SocOver_flt: category=VALUE, sw-calibration-access=READ-ONLY, type=UInt8
    VeCSCR_U_PackVoltage_out
      data VeCSCR_U_PackVoltage_out: category=VALUE, type=Float
    VeLLSR_b_PackVoltage_Inv
      data VeLLSR_b_PackVoltage_Inv: category=BOOLEAN, type=Boolean
    VeCSCR_U_MaxCellVoltageMod
      data VeCSCR_U_MaxCellVoltageMod: category=VALUE, type=Float
    VeCSCR_U_MinCellVoltageMod
      data VeCSCR_U_MinCellVoltageMod: category=VALUE, type=Float
    VeCSCR_U_DeltaCellVoltage
      data VeCSCR_U_DeltaCellVoltage: category=VALUE, type=Float
    VeCSCR_b_CellVoltage_Inv
      data VeCSCR_b_CellVoltage_Inv: category=BOOLEAN, type=Boolean
    VeVSDR_I_HVCurrent
      data VeVSDR_I_HVCurrent: category=VALUE, type=Float
    VeLLSR_b_HVCurrent_Inv
      data VeLLSR_b_HVCurrent_Inv: category=BOOLEAN, type=Boolean
    VeCSCR_T_MaxCellTempMod
      data VeCSCR_T_MaxCellTempMod: category=VALUE, type=Float
    VeCSCR_T_MinCellTempMod
      data VeCSCR_T_MinCellTempMod: category=VALUE, type=Float
    VeCSCR_T_DeltaCellTemp
      data VeCSCR_T_DeltaCellTemp: category=VALUE, type=Float
    VeCSCR_b_CellTemp_Inv
      data VeCSCR_b_CellTemp_Inv: category=BOOLEAN, type=Boolean
    VaCSCR_T_CellTempArray_out
      data VaCSCR_T_CellTempArray_out: category=ARRAY, type=rt_Array_Float_16
    VaCSCR_dT_CellTempRate_out
      data VaCSCR_dT_CellTempRate_out: category=ARRAY, type=rt_Array_Float_16
    VaLLSR_b_CellTemp_Inv
      data VaLLSR_b_CellTemp_Inv: category=ARRAY, type=rt_Array_Boolean_16
    VeCSCR_T_MaxPCBTemp
      data VeCSCR_T_MaxPCBTemp: category=VALUE, type=Float
    VeCSCR_b_PCBTemp_Inv
      data VeCSCR_b_PCBTemp_Inv: category=BOOLEAN, type=Boolean
    VeHVSR_e_StateMode
      data VeHVSR_e_StateMode: category=VALUE, type=TeHVSR_e_StateMode
    VeSOCR_Pct_BatteryPackSOC
      data VeSOCR_Pct_BatteryPackSOC: category=VALUE, type=Float
    VeLLSR_b_ClearDTC
      data VeLLSR_b_ClearDTC: category=BOOLEAN, type=Boolean
    VeCSCR_b_PackVoltageFltd
      data VeCSCR_b_PackVoltageFltd: category=BOOLEAN, type=Boolean
    VeCFLR_b_EnblGPIOHeat_drv
      data VeCFLR_b_EnblGPIOHeat_drv: category=BOOLEAN, type=Boolean
package /CalibrationComponents
  parameter interface CPLR_if
    223 x parameter data prototype, all with sw-calibration-access=READ-WRITE:
      KeCPLR_Pct_DeltaCV_L{1..3}_flt_SOC_Set: category=VALUE, type=Float
      KeCPLR_T_DeltaCT_L1_flt_Reset1: category=VALUE, type=Float
      KeCPLR_T_DeltaCT_L1_flt_Reset2: category=VALUE, type=Float
      KeCPLR_T_DeltaCT_L1_flt_Set1: category=VALUE, type=Float
      KeCPLR_T_DeltaCT_L1_flt_Set2: category=VALUE, type=Float
      KeCPLR_T_DeltaCT_L2_flt_Reset1: category=VALUE, type=Float
      KeCPLR_T_DeltaCT_L2_flt_Reset2: category=VALUE, type=Float
      KeCPLR_T_DeltaCT_L2_flt_Set1: category=VALUE, type=Float
      KeCPLR_T_DeltaCT_L2_flt_Set2: category=VALUE, type=Float
      KeCPLR_T_DeltaCT_L3_flt_Reset1: category=VALUE, type=Float
      KeCPLR_T_DeltaCT_L3_flt_Reset2: category=VALUE, type=Float
      KeCPLR_T_DeltaCT_L3_flt_Set1: category=VALUE, type=Float
      KeCPLR_T_DeltaCT_L3_flt_Set2: category=VALUE, type=Float
      KeCPLR_T_DeltaCT_flt_Set_TM: category=VALUE, type=Float
      KeCPLR_T_OverCT_L1_flt_Reset: category=VALUE, type=Float
      KeCPLR_T_OverCT_L1_flt_Set: category=VALUE, type=Float
      KeCPLR_T_OverCT_L3_flt_Reset: category=VALUE, type=Float
      KeCPLR_T_OverCT_L3_flt_Set: category=VALUE, type=Float
      KeCPLR_T_OverCT_L4_flt_Set: category=VALUE, type=Float
      KeCPLR_T_PCBOverTemp_flt_Reset: category=VALUE, type=Float
      KeCPLR_T_PCBOverTemp_flt_Set: category=VALUE, type=Float
      KeCPLR_T_PackUnderVolt_L2_flt_Reset1: category=VALUE, type=Float
      KeCPLR_T_PackUnderVolt_L2_flt_Reset12: category=VALUE, type=Float
      KeCPLR_T_PackUnderVolt_L2_flt_Reset2: category=VALUE, type=Float
      KeCPLR_T_PackUnderVolt_L2_flt_Set1: category=VALUE, type=Float
      KeCPLR_T_PackUnderVolt_L2_flt_Set12: category=VALUE, type=Float
      KeCPLR_T_PackUnderVolt_L2_flt_Set2: category=VALUE, type=Float
      KeCPLR_T_PackUnderVolt_L3_flt_Reset1: category=VALUE, type=Float
      KeCPLR_T_PackUnderVolt_L3_flt_Reset12: category=VALUE, type=Float
      KeCPLR_T_PackUnderVolt_L3_flt_Reset2: category=VALUE, type=Float
      KeCPLR_T_PackUnderVolt_L3_flt_Set1: category=VALUE, type=Float
      KeCPLR_T_PackUnderVolt_L3_flt_Set12: category=VALUE, type=Float
      KeCPLR_T_PackUnderVolt_L3_flt_Set2: category=VALUE, type=Float
      KeCPLR_T_ThermalRunaway_flt_Reset: category=VALUE, type=Float
      KeCPLR_T_ThermalRunaway_flt_Set: category=VALUE, type=Float
      KeCPLR_T_ThermalRunaway_flt_TDiffReset: category=VALUE, type=Float
      KeCPLR_T_ThermalRunaway_flt_TDiffSet: category=VALUE, type=Float
      KeCPLR_T_UnderCT_L1_flt_Reset: category=VALUE, type=Float
      KeCPLR_T_UnderCT_L1_flt_Set: category=VALUE, type=Float
      KeCPLR_T_UnderCT_L3_flt_Reset: category=VALUE, type=Float
      KeCPLR_T_UnderCT_L3_flt_Set: category=VALUE, type=Float
      KeCPLR_T_UnderCT_L4_flt_Reset: category=VALUE, type=Float
      KeCPLR_T_UnderCT_L4_flt_Set: category=VALUE, type=Float
      KeCPLR_T_UnderCV_L2_flt_Reset1: category=VALUE, type=Float
      KeCPLR_T_UnderCV_L2_flt_Reset12: category=VALUE, type=Float
      KeCPLR_T_UnderCV_L2_flt_Reset2: category=VALUE, type=Float
      KeCPLR_T_UnderCV_L2_flt_Set1: category=VALUE, type=Float
      KeCPLR_T_UnderCV_L2_flt_Set12: category=VALUE, type=Float
      KeCPLR_T_UnderCV_L2_flt_Set2: category=VALUE, type=Float
      KeCPLR_T_UnderCV_L3_flt_Reset1: category=VALUE, type=Float
      KeCPLR_T_UnderCV_L3_flt_Reset12: category=VALUE, type=Float
      KeCPLR_T_UnderCV_L3_flt_Reset2: category=VALUE, type=Float
      KeCPLR_T_UnderCV_L3_flt_Set1: category=VALUE, type=Float
      KeCPLR_T_UnderCV_L3_flt_Set12: category=VALUE, type=Float
      KeCPLR_T_UnderCV_L3_flt_Set2: category=VALUE, type=Float
      KeCPLR_U_DeltaCV_L1_flt_Reset1: category=VALUE, type=Float
      KeCPLR_U_DeltaCV_L1_flt_Reset2: category=VALUE, type=Float
      KeCPLR_U_DeltaCV_L1_flt_Set1: category=VALUE, type=Float
      KeCPLR_U_DeltaCV_L1_flt_Set2: category=VALUE, type=Float
      KeCPLR_U_DeltaCV_L2_flt_Reset1: category=VALUE, type=Float
      KeCPLR_U_DeltaCV_L2_flt_Reset2: category=VALUE, type=Float
      KeCPLR_U_DeltaCV_L2_flt_Set1: category=VALUE, type=Float
      KeCPLR_U_DeltaCV_L2_flt_Set2: category=VALUE, type=Float
      KeCPLR_U_DeltaCV_L3_flt_Reset1: category=VALUE, type=Float
      KeCPLR_U_DeltaCV_L3_flt_Reset2: category=VALUE, type=Float
      KeCPLR_U_DeltaCV_L3_flt_Set1: category=VALUE, type=Float
      KeCPLR_U_DeltaCV_L3_flt_Set2: category=VALUE, type=Float
      KeCPLR_U_OverCV_L1_flt_Reset_OP: category=VALUE, type=Float
      KeCPLR_U_OverCV_L1_flt_Set: category=VALUE, type=Float
      KeCPLR_U_OverCV_L3_flt_Reset_OP: category=VALUE, type=Float
      KeCPLR_U_OverCV_L3_flt_Set: category=VALUE, type=Float
      KeCPLR_U_OverCV_L4_flt_Set: category=VALUE, type=Float
      KeCPLR_U_OverCV_flt_BatTestSet: category=VALUE, type=Float
      KeCPLR_U_PackOverVolt_L1_flt_Reset: category=VALUE, type=Float
      KeCPLR_U_PackOverVolt_L1_flt_Set: category=VALUE, type=Float
      KeCPLR_U_PackOverVolt_L3_flt_Set: category=VALUE, type=Float
      KeCPLR_U_PackOverVolt_flt_BatTestSet: category=VALUE, type=Float
      KeCPLR_U_PackUnderVolt_L2_flt_Reset1: category=VALUE, type=Float
      KeCPLR_U_PackUnderVolt_L2_flt_Reset2: category=VALUE, type=Float
      KeCPLR_U_PackUnderVolt_L2_flt_Set1: category=VALUE, type=Float
      KeCPLR_U_PackUnderVolt_L2_flt_Set2: category=VALUE, type=Float
      KeCPLR_U_PackUnderVolt_L3_flt_Reset1: category=VALUE, type=Float
      KeCPLR_U_PackUnderVolt_L3_flt_Reset2: category=VALUE, type=Float
      KeCPLR_U_PackUnderVolt_L3_flt_Set1: category=VALUE, type=Float
      KeCPLR_U_PackUnderVolt_L3_flt_Set2: category=VALUE, type=Float
      KeCPLR_U_ThermalRunaway_flt_VMinReset: category=VALUE, type=Float
      KeCPLR_U_ThermalRunaway_flt_VMinSet: category=VALUE, type=Float
      KeCPLR_U_UnderCV_L2_flt_Reset1: category=VALUE, type=Float
      KeCPLR_U_UnderCV_L2_flt_Reset2: category=VALUE, type=Float
      KeCPLR_U_UnderCV_L2_flt_Set1: category=VALUE, type=Float
      KeCPLR_U_UnderCV_L2_flt_Set2: category=VALUE, type=Float
      KeCPLR_U_UnderCV_L3_flt_Reset1: category=VALUE, type=Float
      KeCPLR_U_UnderCV_L3_flt_Reset2: category=VALUE, type=Float
      KeCPLR_U_UnderCV_L3_flt_Set1: category=VALUE, type=Float
      KeCPLR_U_UnderCV_L3_flt_Set2: category=VALUE, type=Float
      KeCPLR_U_UnderCV_L4_flt_Set_CH: category=VALUE, type=Float
      KeCPLR_U_UnderCV_L4_flt_Set_OP: category=VALUE, type=Float
      KeCPLR_dT_ThermalRunaway_flt_Set: category=VALUE, type=Float
      KeCPLR_t_DeltaCT_L1_flt_Reset: category=VALUE, type=Float
      KeCPLR_t_DeltaCT_L1_flt_Set: category=VALUE, type=Float
      KeCPLR_t_DeltaCT_L2_flt_Reset: category=VALUE, type=Float
      KeCPLR_t_DeltaCT_L2_flt_Set: category=VALUE, type=Float
      KeCPLR_t_DeltaCT_L3_flt_Reset: category=VALUE, type=Float
      KeCPLR_t_DeltaCT_L3_flt_Set: category=VALUE, type=Float
      KeCPLR_t_DeltaCV_L1_flt: category=VALUE, type=Float
      KeCPLR_t_DeltaCV_L1_flt_Reset: category=VALUE, type=Float
      KeCPLR_t_DeltaCV_L2_flt: category=VALUE, type=Float
      KeCPLR_t_DeltaCV_L2_flt_Reset: category=VALUE, type=Float
      KeCPLR_t_DeltaCV_L3_flt: category=VALUE, type=Float
      KeCPLR_t_DeltaCV_L3_flt_Reset: category=VALUE, type=Float
      KeCPLR_t_OverCT_L1_flt_Reset: category=VALUE, type=Float
      KeCPLR_t_OverCT_L1_flt_Set: category=VALUE, type=Float
      KeCPLR_t_OverCT_L3_flt_Reset: category=VALUE, type=Float
      KeCPLR_t_OverCT_L3_flt_Set: category=VALUE, type=Float
      KeCPLR_t_OverCT_L4_flt_Set: category=VALUE, type=Float
      KeCPLR_t_OverCV_L1_flt_Reset_OP: category=VALUE, type=Float
      KeCPLR_t_OverCV_L1_flt_Set: category=VALUE, type=Float
      KeCPLR_t_OverCV_L3_flt_Reset_OP: category=VALUE, type=Float
      KeCPLR_t_OverCV_L3_flt_Set: category=VALUE, type=Float
      KeCPLR_t_OverCV_L4_flt_Set: category=VALUE, type=Float
      KeCPLR_t_PCBOverTemp_flt_Set: category=VALUE, type=Float
      KeCPLR_t_PackOverVolt_L1_flt_Reset: category=VALUE, type=Float
      KeCPLR_t_PackOverVolt_L1_flt_Set: category=VALUE, type=Float
      KeCPLR_t_PackOverVolt_L3_flt_Set: category=VALUE, type=Float
      KeCPLR_t_PackUnderVolt_L2_flt_Reset: category=VALUE, type=Float
      KeCPLR_t_PackUnderVolt_L2_flt_Set: category=VALUE, type=Float
      KeCPLR_t_PackUnderVolt_L3_flt_Reset: category=VALUE, type=Float
      KeCPLR_t_PackUnderVolt_L3_flt_Set: category=VALUE, type=Float
      KeCPLR_t_ThermalRunaway_flt_Set: category=VALUE, type=Float
      KeCPLR_t_ThermalRunaway_flt_TdiffSet: category=VALUE, type=Float
      KeCPLR_t_ThermalRunaway_flt_TmaxSet: category=VALUE, type=Float
      KeCPLR_t_ThermalRunaway_flt_VminSet: category=VALUE, type=Float
      KeCPLR_t_UnderCT_L1_flt_Reset: category=VALUE, type=Float
      KeCPLR_t_UnderCT_L1_flt_Set: category=VALUE, type=Float
      KeCPLR_t_UnderCT_L3_flt_Reset: category=VALUE, type=Float
      KeCPLR_t_UnderCT_L3_flt_Set: category=VALUE, type=Float
      KeCPLR_t_UnderCT_L4_flt_Reset: category=VALUE, type=Float
      KeCPLR_t_UnderCT_L4_flt_Set: category=VALUE, type=Float
      KeCPLR_t_UnderCV_L2_flt_Reset: category=VALUE, type=Float
      KeCPLR_t_UnderCV_L2_flt_Set: category=VALUE, type=Float
      KeCPLR_t_UnderCV_L3_flt_Reset: category=VALUE, type=Float
      KeCPLR_t_UnderCV_L3_flt_Set: category=VALUE, type=Float
      KeCPLR_t_UnderCV_L4_flt_Set: category=VALUE, type=Float
      KeCPLR_b_CellOverVoltRank_En: category=BOOLEAN, type=Boolean
      KeCPLR_b_CellUnderVoltRank_En: category=BOOLEAN, type=Boolean
      KeCPLR_b_DeltaCT_L{1..3}_flt_En: category=BOOLEAN, type=Boolean
      KeCPLR_b_DeltaCT_Rank_CAN_En: category=BOOLEAN, type=Boolean
      KeCPLR_b_DeltaCV_L{1..3}_flt_En: category=BOOLEAN, type=Boolean
      KeCPLR_b_DeltaCV_Rank_CAN_En: category=BOOLEAN, type=Boolean
      KeCPLR_b_DeltaTempRank_En: category=BOOLEAN, type=Boolean
      KeCPLR_b_OverCT_L1_flt_En: category=BOOLEAN, type=Boolean
      KeCPLR_b_OverCT_L3_flt_En: category=BOOLEAN, type=Boolean
      KeCPLR_b_OverCT_L4_flt_En: category=BOOLEAN, type=Boolean
      KeCPLR_b_OverCT_Rank_CAN_En: category=BOOLEAN, type=Boolean
      KeCPLR_b_OverCV_L1_flt_En: category=BOOLEAN, type=Boolean
      KeCPLR_b_OverCV_L3_flt_En: category=BOOLEAN, type=Boolean
      KeCPLR_b_OverCV_L4_flt_En: category=BOOLEAN, type=Boolean
      KeCPLR_b_OverCV_Rank_CAN_En: category=BOOLEAN, type=Boolean
      KeCPLR_b_PCBOverTemp_flt_En: category=BOOLEAN, type=Boolean
      KeCPLR_b_PackOverTempRank_En: category=BOOLEAN, type=Boolean
      KeCPLR_b_PackOverVoltRank_En: category=BOOLEAN, type=Boolean
      KeCPLR_b_PackOverVolt_L1_flt_En: category=BOOLEAN, type=Boolean
      KeCPLR_b_PackOverVolt_L3_flt_En: category=BOOLEAN, type=Boolean
      KeCPLR_b_PackOverVolt_Rank_CAN_En: category=BOOLEAN, type=Boolean
      KeCPLR_b_PackUnderVoltRank_En: category=BOOLEAN, type=Boolean
      KeCPLR_b_PackUnderVolt_L2_flt_En: category=BOOLEAN, type=Boolean
      KeCPLR_b_PackUnderVolt_L3_flt_En: category=BOOLEAN, type=Boolean
      KeCPLR_b_PackUnderVolt_Rank_CAN_En: category=BOOLEAN, type=Boolean
      KeCPLR_b_ThermalRunaway_Rank_CAN_En: category=BOOLEAN, type=Boolean
      KeCPLR_b_ThermalRunaway_Rank_CAN_Val: category=BOOLEAN, type=Boolean
      KeCPLR_b_ThermalRunaway_flt_En: category=BOOLEAN, type=Boolean
      KeCPLR_b_UnderCT_L1_flt_En: category=BOOLEAN, type=Boolean
      KeCPLR_b_UnderCT_L3_flt_En: category=BOOLEAN, type=Boolean
      KeCPLR_b_UnderCT_L4_flt_En: category=BOOLEAN, type=Boolean
      KeCPLR_b_UnderCT_Rank_CAN_En: category=BOOLEAN, type=Boolean
      KeCPLR_b_UnderCV_L{2..4}_flt_En: category=BOOLEAN, type=Boolean
      KeCPLR_b_UnderCV_Rank_CAN_En: category=BOOLEAN, type=Boolean
      KeCPLR_k_CellOverVoltRank_Val: category=VALUE, type=UInt8
      KeCPLR_k_CellUnderVoltRank_Val: category=VALUE, type=UInt8
      KeCPLR_k_DeltaCT_L{1..3}_flt_Val: category=VALUE, type=UInt8
      KeCPLR_k_DeltaCT_Rank_CAN_Val: category=VALUE, type=UInt8
      KeCPLR_k_DeltaCV_L{1..3}_flt_Val: category=VALUE, type=UInt8
      KeCPLR_k_DeltaCV_Rank_CAN_Val: category=VALUE, type=UInt8
      KeCPLR_k_DeltaTempRank_Val: category=VALUE, type=UInt8
      KeCPLR_k_OverCT_L1_flt_Val: category=VALUE, type=UInt8
      KeCPLR_k_OverCT_L3_flt_Val: category=VALUE, type=UInt8
      KeCPLR_k_OverCT_L4_flt_Val: category=VALUE, type=UInt8
      KeCPLR_k_OverCT_Rank_CAN_Val: category=VALUE, type=UInt8
      KeCPLR_k_OverCV_L1_flt_Val: category=VALUE, type=UInt8
      KeCPLR_k_OverCV_L3_flt_Val: category=VALUE, type=UInt8
      KeCPLR_k_OverCV_L4_flt_Val: category=VALUE, type=UInt8
      KeCPLR_k_OverCV_Rank_CAN_Val: category=VALUE, type=UInt8
      KeCPLR_k_PCBOverTemp_flt_Val: category=VALUE, type=UInt8
      KeCPLR_k_PackOverTempRank_Val: category=VALUE, type=UInt8
      KeCPLR_k_PackOverVoltRank_Val: category=VALUE, type=UInt8
      KeCPLR_k_PackOverVolt_L1_flt_Val: category=VALUE, type=UInt8
      KeCPLR_k_PackOverVolt_L3_flt_Val: category=VALUE, type=UInt8
      KeCPLR_k_PackOverVolt_Rank_CAN_Val: category=VALUE, type=UInt8
      KeCPLR_k_PackUnderVoltRank_Val: category=VALUE, type=UInt8
      KeCPLR_k_PackUnderVolt_L2_flt_Val: category=VALUE, type=UInt8
      KeCPLR_k_PackUnderVolt_L3_flt_Val: category=VALUE, type=UInt8
      KeCPLR_k_PackUnderVolt_Rank_CAN_Val: category=VALUE, type=UInt8
      KeCPLR_k_ThermalRunaway_flt_Val: category=VALUE, type=UInt8
      KeCPLR_k_UnderCT_L1_flt_Val: category=VALUE, type=UInt8
      KeCPLR_k_UnderCT_L3_flt_Val: category=VALUE, type=UInt8
      KeCPLR_k_UnderCT_L4_flt_Val: category=VALUE, type=UInt8
      KeCPLR_k_UnderCT_Rank_CAN_Val: category=VALUE, type=UInt8
      KeCPLR_k_UnderCV_L{2..4}_flt_Val: category=VALUE, type=UInt8
      KeCPLR_k_UnderCV_Rank_CAN_Val: category=VALUE, type=UInt8
