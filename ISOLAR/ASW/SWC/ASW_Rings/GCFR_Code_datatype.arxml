AUTOSAR XML (schema 4-0-3)
standard types defined: Boolean, Float, UInt8, boolean, float32, uint8
package /GCFR_pkg/GCFR_dt
  7 x impl type:
    rt_Array_Boolean_4: category=ARRAY
      element rt_Array_Boolean_4: array-size=4, array-size-semantics=FIXED-SIZE, implementation-data-type=Boolean
    TeHVSR_e_ContactorCmndPosSide: category=VALUE, base-type=uint8
    TeHVSR_e_ContactorCmndNegSide: category=VALUE, base-type=uint8
    rt_Array_Float_4: category=ARRAY
      element rt_Array_Float_4: array-size=4, array-size-semantics=FIXED-SIZE, implementation-data-type=Float
    TeVSDR_e_ShuntHallCurrStatus: category=VALUE, base-type=uint8
    TeVSDR_e_HVCompareStatus: category=VALUE, base-type=uint8
    rt_Array_Float_2: category=ARRAY
      element rt_Array_Float_2: array-size=2, array-size-semantics=FIXED-SIZE, implementation-data-type=Float
  unit NoUnit: factor-si-to-unit=1, offset-si-to-unit=0
  6 x impl type, all with category=ARRAY:
    rt_Array_Float_13
      element rt_Array_Float_13: array-size=13, array-size-semantics=FIXED-SIZE, implementation-data-type=Float
    rt_Array_Float_11
      element rt_Array_Float_11: array-size=11, array-size-semantics=FIXED-SIZE, implementation-data-type=Float
    rt_Array_Float_143
      element rt_Array_Float_143: array-size=143, array-size-semantics=FIXED-SIZE, implementation-data-type=Float
    rt_Array_Float_12
      element rt_Array_Float_12: array-size=12, array-size-semantics=FIXED-SIZE, implementation-data-type=Float
    rt_Array_Float_14
      element rt_Array_Float_14: array-size=14, array-size-semantics=FIXED-SIZE, implementation-data-type=Float
    rt_Array_Float_168
      element rt_Array_Float_168: array-size=168, array-size-semantics=FIXED-SIZE, implementation-data-type=Float
package /GCFR_pkg/GCFR_dt/ApplDataTypes
  7 x app type, all with sw-calibration-access=READ-WRITE:
    TeHVSR_e_ContactorCmndPosSide: category=VALUE
    TeHVSR_e_ContactorCmndNegSide: category=VALUE
    TeVSDR_e_ShuntHallCurrStatus: category=VALUE
    TeVSDR_e_HVCompareStatus: category=VALUE
    UInt8: category=VALUE, compu {identical}, range phys 0..255
    Float: category=VALUE, compu {identical}, range phys -INF..INF
    Boolean: category=BOOLEAN, compu {0=FALSE, 1=TRUE}
  6 x application array data type, all with category=ARRAY, sw-calibration-access=READ-WRITE:
    rt_Array_Float_13
      element rt_Array_Float_13: category=VALUE, type=Float, array-size-semantics=FIXED-SIZE, max-number-of-elements=13
    rt_Array_Float_11
      element rt_Array_Float_11: category=VALUE, type=Float, array-size-semantics=FIXED-SIZE, max-number-of-elements=11
    rt_Array_Float_143
      element rt_Array_Float_143: category=VALUE, type=Float, array-size-semantics=FIXED-SIZE, max-number-of-elements=143
    rt_Array_Float_12
      element rt_Array_Float_12: category=VALUE, type=Float, array-size-semantics=FIXED-SIZE, max-number-of-elements=12
    rt_Array_Float_14
      element rt_Array_Float_14: category=VALUE, type=Float, array-size-semantics=FIXED-SIZE, max-number-of-elements=14
    rt_Array_Float_168
      element rt_Array_Float_168: category=VALUE, type=Float, array-size-semantics=FIXED-SIZE, max-number-of-elements=168
package /GCFR_pkg/GCFR_dt/DataTypeMappings
  data type mapping set WorkingDataTypeMappingsSet
    data-type-maps:
      application-data-type=TeHVSR_e_ContactorCmndPosSide, implementation-data-type=TeHVSR_e_ContactorCmndPosSide
      application-data-type=TeHVSR_e_ContactorCmndNegSide, implementation-data-type=TeHVSR_e_ContactorCmndNegSide
      application-data-type=TeVSDR_e_ShuntHallCurrStatus, implementation-data-type=TeVSDR_e_ShuntHallCurrStatus
      application-data-type=TeVSDR_e_HVCompareStatus, implementation-data-type=TeVSDR_e_HVCompareStatus
      application-data-type=UInt8, implementation-data-type=UInt8
      application-data-type=Float, implementation-data-type=Float
      application-data-type=Boolean, implementation-data-type=Boolean
      application-data-type=rt_Array_Float_13, implementation-data-type=rt_Array_Float_13
      application-data-type=rt_Array_Float_11, implementation-data-type=rt_Array_Float_11
      application-data-type=rt_Array_Float_143, implementation-data-type=rt_Array_Float_143
      application-data-type=rt_Array_Float_12, implementation-data-type=rt_Array_Float_12
      application-data-type=rt_Array_Float_14, implementation-data-type=rt_Array_Float_14
      application-data-type=rt_Array_Float_168, implementation-data-type=rt_Array_Float_168
package /GCFR_pkg/GCFR_dt/Ground
  43 x constant specification:
    DefaultInitValu_963fa2511e05c781: value-spec=[{short-label=DefaultInitValu_72c7a3039c9feb36, constant=DefaultInitValue_Boolean}, {short-label=DefaultInitValu_cff2000e8ca7b5ef, constant=DefaultInitValue_Boolean}, {short-label=DefaultInitValu_5a7e3acef364db3a, constant=DefaultInitValue_Boolean}, {short-label=DefaultInitValu_8f12866c94c9aafa, constant=DefaultInitValue_Boolean}]
    DefaultInitValue_Boolean: value-spec=0
    DefaultInitValue_Float: value-spec=0
    DefaultInitValu_a58d11e09496fd61: value-spec=CeHVSR_e_PosContactorCmndOpen
    DefaultInitValu_e36d3592a9cc1d62: value-spec=CeHVSR_e_NegContactorCmndOpen
    DefaultInitValu_cbde969d42339536: value-spec=[{short-label=DefaultInitValu_fc0f992b465a982d, constant=DefaultInitValue_Float}, {short-label=DefaultInitValu_fa73ca854b914cda, constant=DefaultInitValue_Float}, {short-label=DefaultInitValu_f1ce7788512f7bc4, constant=DefaultInitValue_Float}, {short-label=DefaultInitValu_3a9682b5c4c2b873, constant=DefaultInitValue_Float}]
    DefaultInitValu_88075686c5678ff5: value-spec=CeVSDR_e_ShantHallCurr_Mismatch
    DefaultInitValu_2874135d92ee472a: value-spec=CeVSDR_e_Match
    DefaultInitValu_e08b08d2402b7568: value-spec=[{short-label=DefaultInitValu_d7bea4671d004272, constant=DefaultInitValue_Float}, {short-label=DefaultInitValu_346cefc70ec913f0, constant=DefaultInitValue_Float}]
    KtSOHR_Ah_AvailableCapacity1_x: value-spec=KtSOHR_Ah_AvailableCapacity1_x:[-30, -20, -15, -10, -5, 0, 5, 10, 15, 25, 45, 50, 55]
    KtSOHR_Ah_AvailableCapacity1_y: value-spec=KtSOHR_Ah_AvailableCapacity1_y:[45.20000076293945, 48.81999969482422, 49.97999954223633, 50.59000015258789, 51.189998626708984, 52.13999938964844, 53.09000015258789, 53.79999923706055, 55.20000076293945, 56.599998474121094, 57.599998474121094, 57.70000076293945, 57.900001525878906]
    KtSOHR_Ah_AvailableCapacity2_x: value-spec=KtSOHR_Ah_AvailableCapacity2_x:[-30, -20, -15, -10, -5, 0, 5, 10, 15, 25, 45, 50, 55]
    KtSOHR_Ah_AvailableCapacity2_y: value-spec=KtSOHR_Ah_AvailableCapacity2_y:[30.899999618530273, 32.900001525878906, 33.79999923706055, 35.099998474121094, 35.599998474121094, 36.20000076293945, 36.79999923706055, 37.29999923706055, 38.5, 40.70000076293945, 43.400001525878906, 43.599998474121094, 43.70000076293945]
    PzGCFR_kP_SOC_TempChrgPwrLmt1_x: value-spec=PzGCFR_kP_SOC_TempChrgPwrLmt1_x:[0, 10, 20, 30, 40, 50, 60, 70, 80, 90, 100]
    PzGCFR_kP_SOC_TempChrgPwrLmt1_y: value-spec=PzGCFR_kP_SOC_TempChrgPwrLmt1_y:[-30, -20, -15, -10, -5, 0, 5, 10, 15, 25, 45, 50, 55]
    PzGCFR_kP_SOC_TempChrgPwrLmt1_z: value-spec=PzGCFR_kP_SOC_TempChrgPwrLmt1_z:[0, 0, 0, 0, 0, 0, 0, 0, 0, 0, 0, 0, 1.5, 1.5, 1, 1, 1, 0.5, 0.5, 0.5, 0.5, 0, 0, 2.5, 2.5, 1.5, 1.5, 1.5, 1, 1, 1, 0.5, 0, 0, 3, 3, 2.5, 2.5, 2.5, 1.5, 1.5, 1.5, 1, 0, 0, 5, 5, 3.5, 3.5, 3.5, 3, 2.5, 2, 1, 0, 0, 8, 8, 5.5, 5.5, 5.5, 4.5, 3.5, 2.5, 1.5, 0, 0, 16, 16, 13, 13, 12, 9, 9, 5, 2.5, 0, 0, 23, 23, 20, 20, 18, 16, 10, 7, 4, 0, 0, 30, 30, 27, 27, 25, 20, 15, 11, 5, 0, 0, 42, 42, 40, 40, 38, 32, 25, 20, 10, 0, 0, 42, 42, 40, 40, 38, 32, 25, 20, 10, 0, 0, 33, 33, 28, 28, 26, 22, 15, 10, 6, 0, 0, 20, 18, 14, 14, 14, 10, 8, 6, 4, 0]
    PzGCFR_kP_SOC_TempChrgPwrLmt2_x: value-spec=PzGCFR_kP_SOC_TempChrgPwrLmt2_x:[0, 10, 20, 30, 40, 50, 60, 70, 80, 90, 100]
    PzGCFR_kP_SOC_TempChrgPwrLmt2_y: value-spec=PzGCFR_kP_SOC_TempChrgPwrLmt2_y:[-30, -20, -15, -10, -5, 0, 5, 10, 15, 25, 45, 50, 55]
    PzGCFR_kP_SOC_TempChrgPwrLmt2_z: value-spec=PzGCFR_kP_SOC_TempChrgPwrLmt2_z:[0, 0, 0, 0, 0, 0, 0, 0, 0, 0, 0, 0, 0, 0, 0, 0, 0, 0, 0, 0, 0, 0, 0, 0, 0, 0, 0, 0, 0, 0, 0, 0, 0, 0, 2, 2, 1.5, 1.5, 1.5, 1, 1, 0.800000011920929, 0.5, 0, 0, 3, 3, 2, 2, 2, 1.5, 1.5, 1, 0.800000011920929, 0, 0, 4, 4, 3, 3, 3, 2, 2, 1.5, 1, 0, 0, 8, 8, 6, 6, 6, 5, 4, 3, 2, 0, 0, 13, 13, 13, 9, 9, 8, 6, 4, 2, 0, 0, 18, 18, 18, 14, 14, 11, 7, 5, 3, 0, 0, 26, 26, 26, 23, 23, 21, 17, 15, 8, 0, 0, 26, 26, 26, 23, 23, 21, 17, 12, 8, 0, 0, 13, 13, 13, 11, 11, 10, 8, 6, 4, 0, 0, 8, 8, 8, 7, 7, 7, 5, 3, 2, 0]
    KzGCFR_kP_SOC_TempChrgPwrLmt1_x: value-spec=KzGCFR_kP_SOC_TempChrgPwrLmt1_x:[0, 10, 20, 30, 40, 50, 60, 70, 80, 90, 100]
    KzGCFR_kP_SOC_TempChrgPwrLmt1_y: value-spec=KzGCFR_kP_SOC_TempChrgPwrLmt1_y:[-30, -20, -15, -10, -5, 0, 5, 10, 15, 25, 45, 50, 55]
    KzGCFR_kP_SOC_TempChrgPwrLmt1_z: value-spec=KzGCFR_kP_SOC_TempChrgPwrLmt1_z:[0, 0, 0, 0, 0, 0, 0, 0, 0, 0, 0, 0, 1.5, 1.5, 1, 1, 1, 0.5, 0.5, 0.5, 0.5, 0, 0, 2.5, 2.5, 1.5, 1.5, 1.5, 1, 1, 1, 0.5, 0, 0, 3, 3, 2.5, 2.5, 2.5, 1.5, 1.5, 1.5, 1, 0, 0, 5, 5, 3.5, 3.5, 3.5, 3, 2.5, 2, 1, 0, 0, 8, 8, 5.5, 5.5, 5.5, 4.5, 3.5, 2.5, 1.5, 0, 0, 16, 16, 13, 13, 12, 9, 9, 5, 2.5, 0, 0, 23, 23, 20, 20, 18, 16, 10, 7, 4, 0, 0, 30, 30, 27, 27, 25, 20, 15, 11, 5, 0, 0, 42, 42, 40, 40, 38, 32, 25, 20, 10, 0, 0, 42, 42, 40, 40, 38, 32, 25, 20, 10, 0, 0, 33, 33, 28, 28, 26, 22, 15, 10, 6, 0, 0, 20, 18, 14, 14, 14, 10, 8, 6, 4, 0]
    KzGCFR_kP_SOC_TempChrgPwrLmt2_x: value-spec=KzGCFR_kP_SOC_TempChrgPwrLmt2_x:[0, 10, 20, 30, 40, 50, 60, 70, 80, 90, 100]
    KzGCFR_kP_SOC_TempChrgPwrLmt2_y: value-spec=KzGCFR_kP_SOC_TempChrgPwrLmt2_y:[-30, -20, -15, -10, -5, 0, 5, 10, 15, 25, 45, 50, 55]
    KzGCFR_kP_SOC_TempChrgPwrLmt2_z: value-spec=KzGCFR_kP_SOC_TempChrgPwrLmt2_z:[0, 0, 0, 0, 0, 0, 0, 0, 0, 0, 0, 0, 0, 0, 0, 0, 0, 0, 0, 0, 0, 0, 0, 0, 0, 0, 0, 0, 0, 0, 0, 0, 0, 0, 2, 2, 1.5, 1.5, 1.5, 1, 1, 0.800000011920929, 0.5, 0, 0, 3, 3, 2, 2, 2, 1.5, 1.5, 1, 0.800000011920929, 0, 0, 4, 4, 3, 3, 3, 2, 2, 1.5, 1, 0, 0, 8, 8, 6, 6, 6, 5, 4, 3, 2, 0, 0, 13, 13, 13, 9, 9, 8, 6, 4, 2, 0, 0, 18, 18, 18, 14, 14, 11, 7, 5, 3, 0, 0, 26, 26, 26, 23, 23, 21, 17, 15, 8, 0, 0, 26, 26, 26, 23, 23, 21, 17, 12, 8, 0, 0, 13, 13, 13, 11, 11, 10, 8, 6, 4, 0, 0, 8, 8, 8, 7, 7, 7, 5, 3, 2, 0]
    KzGCFR_kP_SOC_TempChrgPwrLmtInst1_x: value-spec=KzGCFR_kP_SOC_TempChrgPwrLmtInst1_x:[0, 10, 20, 30, 40, 50, 60, 70, 80, 90, 100]
    KzGCFR_kP_SOC_TempChrgPwrLmtInst1_y: value-spec=KzGCFR_kP_SOC_TempChrgPwrLmtInst1_y:[-30, -20, -15, -10, -5, 0, 5, 10, 15, 25, 45, 50, 55]
    KzGCFR_kP_SOC_TempChrgPwrLmtInst1_z: value-spec=KzGCFR_kP_SOC_TempChrgPwrLmtInst1_z:[0, 0, 0, 0, 0, 0, 0, 0, 0, 0, 0, 0, 3, 3, 2, 2, 2, 1, 1, 1, 1, 0, 0, 5, 5, 3, 3, 3, 2, 2, 2, 1, 0, 0, 6, 6, 5, 5, 5, 3, 3, 3, 2, 0, 0, 10, 10, 7, 7, 7, 5, 5, 5, 2, 0, 0, 23, 23, 15, 15, 15, 10, 9, 7, 5, 0, 0, 46, 46, 33, 33, 33, 23, 19, 15, 9, 0, 0, 66, 66, 53, 53, 53, 39, 35, 31, 13, 0, 0, 95, 95, 85, 85, 85, 65, 55, 40, 21, 0, 0, 140, 140, 140, 140, 140, 115, 85, 60, 25, 0, 0, 140, 140, 140, 140, 140, 115, 85, 60, 25, 0, 0, 115, 115, 100, 100, 100, 75, 60, 45, 19, 0, 0, 80, 80, 70, 70, 70, 45, 35, 20, 13, 0]
    KzGCFR_kP_SOC_TempChrgPwrLmtInst2_x: value-spec=KzGCFR_kP_SOC_TempChrgPwrLmtInst2_x:[0, 10, 20, 30, 40, 50, 60, 70, 80, 90, 100]
    KzGCFR_kP_SOC_TempChrgPwrLmtInst2_y: value-spec=KzGCFR_kP_SOC_TempChrgPwrLmtInst2_y:[-30, -20, -15, -10, -5, 0, 5, 10, 15, 25, 45, 50, 55]
    KzGCFR_kP_SOC_TempChrgPwrLmtInst2_z: value-spec=KzGCFR_kP_SOC_TempChrgPwrLmtInst2_z:[0, 0, 0, 0, 0, 0, 0, 0, 0, 0, 0, 0, 2, 2, 1, 1, 1, 0.5, 0.5, 0.5, 0, 0, 0, 3, 3, 2, 2, 2, 1, 1, 1, 0.5, 0, 0, 5, 5, 4, 4, 4, 2, 2, 2, 1, 0, 0, 8, 8, 6, 6, 6, 4, 4, 4, 1, 0, 0, 18, 18, 12, 12, 12, 8, 7, 6, 4, 0, 0, 35, 35, 25, 25, 25, 18, 15, 12, 7, 0, 0, 50, 50, 40, 40, 40, 35, 27, 22, 10, 0, 0, 70, 70, 65, 65, 65, 50, 40, 25, 16, 0, 0, 100, 100, 100, 100, 100, 80, 60, 40, 20, 0, 0, 100, 100, 100, 100, 100, 55, 45, 27, 15, 0, 0, 40, 40, 40, 40, 40, 32, 25, 25, 9, 0, 0, 20, 20, 20, 20, 20, 16, 13, 9, 7, 0]
    KzGCFR_kP_SOC_TempDschgPwrLmt1_x: value-spec=KzGCFR_kP_SOC_TempDschgPwrLmt1_x:[0, 5, 10, 20, 30, 40, 50, 60, 70, 80, 90, 100]
    KzGCFR_kP_SOC_TempDschgPwrLmt1_y: value-spec=KzGCFR_kP_SOC_TempDschgPwrLmt1_y:[-30, -20, -15, -10, -5, 0, 5, 10, 15, 20, 25, 45, 50, 55]
    KzGCFR_kP_SOC_TempDschgPwrLmt1_z: value-spec=KzGCFR_kP_SOC_TempDschgPwrLmt1_z:[0, 1, 1, 3, 5, 6, 7, 8, 9, 9, 9, 9, 0, 1, 2, 6, 8, 9, 12, 13, 16, 16, 16, 16, 0, 2, 3, 8, 12, 14, 17, 19, 22, 22, 22, 22, 0, 3, 5, 13, 16, 19, 22, 24, 27, 27, 27, 27, 0, 5, 7, 16, 22, 24, 27, 30, 33, 33, 33, 33, 0, 8, 10, 25, 25, 30, 30, 35, 40, 40, 40, 40, 0, 9, 13, 35, 35, 40, 40, 45, 50, 50, 50, 50, 0, 10, 19, 45, 45, 50, 50, 55, 60, 60, 60, 60, 0, 11, 18, 55, 55, 60, 60, 65, 70, 70, 70, 70, 0, 12, 24, 65, 65, 70, 70, 75, 80, 80, 80, 80, 0, 15, 30, 70, 70, 75, 75, 80, 85, 85, 90, 90, 0, 15, 30, 70, 70, 75, 75, 80, 85, 85, 90, 90, 0, 10, 20, 60, 60, 65, 65, 70, 75, 75, 80, 80, 0, 3, 5, 20, 30, 40, 40, 50, 60, 60, 60, 60]
    KzGCFR_kP_SOC_TempDschgPwrLmt2_x: value-spec=KzGCFR_kP_SOC_TempDschgPwrLmt2_x:[0, 5, 10, 20, 30, 40, 50, 60, 70, 80, 90, 100]
    KzGCFR_kP_SOC_TempDschgPwrLmt2_y: value-spec=KzGCFR_kP_SOC_TempDschgPwrLmt2_y:[-30, -20, -15, -10, -5, 0, 5, 10, 15, 20, 25, 45, 50, 55]
    KzGCFR_kP_SOC_TempDschgPwrLmt2_z: value-spec=KzGCFR_kP_SOC_TempDschgPwrLmt2_z:[0, 0, 1, 2, 3, 4, 4, 6, 6, 6, 6, 6, 0, 1, 2, 4, 6, 6, 6, 9, 9, 9, 9, 9, 0, 1, 2, 6, 8, 8, 8, 12, 12, 12, 12, 12, 0, 1, 3, 7, 9, 11, 11, 15, 15, 15, 15, 15, 0, 2, 3, 8, 10, 13, 13, 18, 18, 18, 18, 18, 0, 3, 5, 10, 14, 18, 18, 23, 23, 23, 23, 23, 0, 2, 5, 13, 18, 22, 22, 28, 28, 28, 28, 28, 0, 3, 6, 18, 23, 28, 28, 35, 35, 35, 35, 35, 0, 3, 6, 22, 26, 33, 33, 40, 40, 40, 40, 40, 0, 4, 7, 24, 31, 40, 40, 45, 45, 45, 45, 45, 0, 5, 9, 34, 38, 46, 46, 50, 50, 50, 50, 50, 0, 5, 9, 15, 20, 20, 20, 30, 30, 30, 30, 30, 0, 3, 5, 10, 15, 15, 15, 21, 21, 21, 21, 21, 0, 2, 3, 7, 10, 10, 10, 15, 15, 15, 15, 15]
    KzGCFR_kP_SOC_TempDschgPwrLmtInst1_x: value-spec=KzGCFR_kP_SOC_TempDschgPwrLmtInst1_x:[0, 5, 10, 20, 30, 40, 50, 60, 70, 80, 90, 100]
    KzGCFR_kP_SOC_TempDschgPwrLmtInst1_y: value-spec=KzGCFR_kP_SOC_TempDschgPwrLmtInst1_y:[-30, -20, -15, -10, -5, 0, 5, 10, 15, 20, 25, 45, 50, 55]
    KzGCFR_kP_SOC_TempDschgPwrLmtInst1_z: value-spec=KzGCFR_kP_SOC_TempDschgPwrLmtInst1_z:[0, 1, 2, 6, 10, 11, 13, 15, 18, 18, 18, 18, 0, 2, 4, 12, 16, 18, 22, 25, 30, 30, 30, 30, 0, 3, 6, 16, 22, 27, 32, 35, 40, 40, 40, 40, 0, 5, 10, 25, 30, 35, 40, 45, 50, 50, 50, 50, 0, 6, 12, 30, 40, 45, 50, 55, 60, 60, 60, 60, 0, 7, 14, 35, 45, 50, 55, 60, 75, 75, 75, 75, 0, 8, 16, 40, 50, 55, 65, 75, 95, 95, 95, 95, 0, 12, 24, 60, 70, 80, 90, 105, 120, 120, 120, 120, 0, 15, 30, 75, 85, 100, 110, 125, 140, 140, 140, 140, 0, 17, 34, 85, 105, 120, 130, 145, 160, 160, 160, 160, 0, 20, 40, 100, 120, 135, 150, 165, 180, 180, 180, 180, 0, 20, 40, 100, 120, 135, 150, 165, 180, 180, 180, 180, 0, 15, 30, 70, 90, 105, 120, 130, 145, 145, 145, 145, 0, 7, 10, 30, 40, 55, 65, 85, 100, 100, 100, 100]
    KzGCFR_kP_SOC_TempDschgPwrLmtInst2_x: value-spec=KzGCFR_kP_SOC_TempDschgPwrLmtInst2_x:[0, 5, 10, 20, 30, 40, 50, 60, 70, 80, 90, 100]
    KzGCFR_kP_SOC_TempDschgPwrLmtInst2_y: value-spec=KzGCFR_kP_SOC_TempDschgPwrLmtInst2_y:[-30, -20, -15, -10, -5, 0, 5, 10, 15, 20, 25, 45, 50, 55]
    KzGCFR_kP_SOC_TempDschgPwrLmtInst2_z: value-spec=KzGCFR_kP_SOC_TempDschgPwrLmtInst2_z:[0, 1, 2, 5, 7, 9, 10, 10, 10, 15, 15, 15, 0, 2, 3, 11, 13, 17, 20, 22, 25, 25, 25, 25, 0, 3, 5, 15, 16, 20, 25, 27, 30, 30, 30, 30, 0, 3, 6, 18, 22, 30, 30, 35, 35, 35, 35, 35, 0, 4, 7, 20, 25, 35, 40, 44, 45, 45, 45, 45, 0, 4, 8, 30, 35, 45, 50, 53, 56, 56, 56, 56, 0, 5, 10, 35, 45, 55, 60, 70, 70, 70, 70, 70, 0, 7, 13, 45, 55, 65, 70, 80, 80, 80, 80, 80, 0, 8, 15, 50, 60, 75, 80, 90, 90, 90, 90, 90, 0, 9, 17, 55, 70, 85, 90, 100, 100, 100, 100, 100, 0, 13, 26, 65, 85, 100, 100, 110, 110, 110, 110, 110, 0, 10, 21, 45, 55, 65, 80, 80, 80, 80, 80, 80, 0, 6, 12, 30, 38, 45, 50, 50, 50, 50, 50, 50, 0, 2, 5, 12, 15, 18, 20, 20, 20, 20, 20, 20]
