AUTOSAR XML (schema 4-2-2)
package /ETAS_Project/EcucModuleConfigurationValuess
  module config Dem
    DemConfigSet
      52 x DemEventParameter, all with DemMaxNumberFreezeFrameRecords=2, DemEventKind=DEM_EVENT_KIND_SWC, DemEventAvailable=true, DemEventFailureCycleCounterThreshold=1, DemExtendedDataClassRef=Set1_Extd, DemFreezeFrameClassRef=Set1_Freeze:
        Event_Cell_Overvoltage_1: DemFFPrestorageSupported=false, DemOperationCycleRef=DEM_OPCYC_POWER, DemDTCRef=DemDTCClass_Cell_Overvoltage_1
          DemEventClass:
            DemAgingAllowed = true
            DemAgingCycleCounterThreshold = 3
            DemEventFailureCycleCounterThreshold = 1
            DemEventPriority = 2
            DemEventDestination = DEM_DTC_ORIGIN_PRIMARY_MEMORY
            DemEventSignificance = DEM_EVENT_SIGNIFICANCE_FAULT
            DemDebounceAlgorithmClass
          DemRbEventClass: DemRbEventBufferTime=0, DemRbEventRecoverableInSameOperationCycle=true, DemRbEventStatusBitStorageTestFailed=false
          DemDebounceAlgorithmClass
            DemDebounceCounterBased: DemDebounceCounterBasedClassRef=Generic_DemDebounceCounterBasedClass
        Event_Cell_Overvoltage_2: DemFFPrestorageSupported=false, DemOperationCycleRef=DEM_OPCYC_POWER, DemDTCRef=DemDTCClass_Cell_Overvoltage_2
          DemEventClass:
            DemAgingAllowed = true
            DemAgingCycleCounterThreshold = 3
            DemEventFailureCycleCounterThreshold = 1
            DemEventPriority = 2
            DemFFPrestorageSupported = false
            DemEventDestination = DEM_DTC_ORIGIN_PRIMARY_MEMORY
            DemEventSignificance = DEM_EVENT_SIGNIFICANCE_FAULT
            DemDebounceAlgorithmClass
          DemRbEventClass: DemRbEventBufferTime=0, DemRbEventRecoverableInSameOperationCycle=true, DemRbEventStatusBitStorageTestFailed=false
          DemDebounceAlgorithmClass
            DemDebounceCounterBased: DemDebounceCounterBasedClassRef=Generic_DemDebounceCounterBasedClass
        Event_Cell_Overvoltage_3: DemFFPrestorageSupported=false, DemOperationCycleRef=DEM_OPCYC_OBD_DCY, DemDTCRef=DemDTCClass_Cell_Overvoltage_3
          DemEventClass:
            DemAgingAllowed = true
            DemAgingCycleCounterThreshold = 3
            DemEventFailureCycleCounterThreshold = 1
            DemEventPriority = 2
            DemFFPrestorageSupported = false
            DemEventDestination = DEM_DTC_ORIGIN_PRIMARY_MEMORY
            DemEventSignificance = DEM_EVENT_SIGNIFICANCE_FAULT
            DemDebounceAlgorithmClass
          DemRbEventClass: DemRbEventBufferTime=0, DemRbEventRecoverableInSameOperationCycle=true, DemRbEventStatusBitStorageTestFailed=false
          DemDebounceAlgorithmClass
            DemDebounceCounterBased: DemDebounceCounterBasedClassRef=Generic_DemDebounceCounterBasedClass
        Event_Cell_Undervoltage_1: DemFFPrestorageSupported=false, DemOperationCycleRef=DEM_OPCYC_POWER, DemDTCRef=DemDTCClass_Cell_Undervoltage_1
          DemEventClass:
            DemAgingAllowed = true
            DemAgingCycleCounterThreshold = 3
            DemEventFailureCycleCounterThreshold = 1
            DemEventPriority = 2
            DemFFPrestorageSupported = false
            DemEventDestination = DEM_DTC_ORIGIN_PRIMARY_MEMORY
            DemEventSignificance = DEM_EVENT_SIGNIFICANCE_FAULT
            DemDebounceAlgorithmClass
          DemRbEventClass: DemRbEventBufferTime=0, DemRbEventRecoverableInSameOperationCycle=true, DemRbEventStatusBitStorageTestFailed=false
          DemDebounceAlgorithmClass
            DemDebounceCounterBased: DemDebounceCounterBasedClassRef=Generic_DemDebounceCounterBasedClass
        Event_Cell_Undervoltage_2: DemFFPrestorageSupported=false, DemOperationCycleRef=DEM_OPCYC_POWER, DemDTCRef=DemDTCClass_Cell_Undervoltage_2
          DemEventClass:
            DemAgingAllowed = true
            DemAgingCycleCounterThreshold = 3
            DemEventFailureCycleCounterThreshold = 1
            DemEventPriority = 2
            DemFFPrestorageSupported = false
            DemEventDestination = DEM_DTC_ORIGIN_PRIMARY_MEMORY
            DemEventSignificance = DEM_EVENT_SIGNIFICANCE_FAULT
            DemDebounceAlgorithmClass
          DemRbEventClass: DemRbEventBufferTime=0, DemRbEventRecoverableInSameOperationCycle=true, DemRbEventStatusBitStorageTestFailed=false
          DemDebounceAlgorithmClass
            DemDebounceCounterBased: DemDebounceCounterBasedClassRef=Generic_DemDebounceCounterBasedClass
        Event_Cell_Undervoltage_3: DemFFPrestorageSupported=false, DemOperationCycleRef=DEM_OPCYC_OBD_DCY, DemDTCRef=DemDTCClass_Cell_Undervoltage_3
          DemEventClass:
            DemAgingAllowed = true
            DemAgingCycleCounterThreshold = 3
            DemEventFailureCycleCounterThreshold = 1
            DemEventPriority = 2
            DemFFPrestorageSupported = false
            DemEventDestination = DEM_DTC_ORIGIN_PRIMARY_MEMORY
            DemEventSignificance = DEM_EVENT_SIGNIFICANCE_FAULT
            DemDebounceAlgorithmClass
          DemRbEventClass: DemRbEventBufferTime=0, DemRbEventRecoverableInSameOperationCycle=true, DemRbEventStatusBitStorageTestFailed=false
          DemDebounceAlgorithmClass
            DemDebounceCounterBased: DemDebounceCounterBasedClassRef=Generic_DemDebounceCounterBasedClass
        Event_Cell_Deltavoltage3: DemFFPrestorageSupported=false, DemOperationCycleRef=DEM_OPCYC_POWER, DemDTCRef=DemDTCClass_Cell_Deltavoltage3
          DemEventClass:
            DemAgingAllowed = true
            DemAgingCycleCounterThreshold = 3
            DemEventFailureCycleCounterThreshold = 1
            DemEventPriority = 2
            DemFFPrestorageSupported = false
            DemEventDestination = DEM_DTC_ORIGIN_PRIMARY_MEMORY
            DemEventSignificance = DEM_EVENT_SIGNIFICANCE_FAULT
            DemDebounceAlgorithmClass
          DemRbEventClass: DemRbEventBufferTime=0, DemRbEventRecoverableInSameOperationCycle=true, DemRbEventStatusBitStorageTestFailed=false
          DemDebounceAlgorithmClass
            DemDebounceCounterBased: DemDebounceCounterBasedClassRef=Generic_DemDebounceCounterBasedClass
        Event_Batt_Overvoltage_2: DemFFPrestorageSupported=false, DemOperationCycleRef=DEM_OPCYC_POWER, DemDTCRef=DemDTCClass_Batt_Overvoltage_2
          DemEventClass:
            DemAgingAllowed = true
            DemAgingCycleCounterThreshold = 3
            DemEventFailureCycleCounterThreshold = 1
            DemEventPriority = 2
            DemFFPrestorageSupported = false
            DemEventDestination = DEM_DTC_ORIGIN_PRIMARY_MEMORY
            DemEventSignificance = DEM_EVENT_SIGNIFICANCE_FAULT
            DemDebounceAlgorithmClass
          DemRbEventClass: DemRbEventBufferTime=0, DemRbEventRecoverableInSameOperationCycle=true, DemRbEventStatusBitStorageTestFailed=false
          DemDebounceAlgorithmClass
            DemDebounceCounterBased: DemDebounceCounterBasedClassRef=Generic_DemDebounceCounterBasedClass
        Event_Batt_Undervoltage_2: DemFFPrestorageSupported=false, DemOperationCycleRef=DEM_OPCYC_POWER, DemDTCRef=DemDTCClass_Batt_Undervoltage_2
          DemEventClass:
            DemAgingAllowed = true
            DemAgingCycleCounterThreshold = 3
            DemEventFailureCycleCounterThreshold = 1
            DemEventPriority = 2
            DemFFPrestorageSupported = false
            DemEventDestination = DEM_DTC_ORIGIN_PRIMARY_MEMORY
            DemEventSignificance = DEM_EVENT_SIGNIFICANCE_FAULT
            DemDebounceAlgorithmClass
          DemRbEventClass: DemRbEventBufferTime=0, DemRbEventRecoverableInSameOperationCycle=true, DemRbEventStatusBitStorageTestFailed=false
          DemDebounceAlgorithmClass
            DemDebounceCounterBased: DemDebounceCounterBasedClassRef=Generic_DemDebounceCounterBasedClass
        Event_Batt_Overtemp_3: DemFFPrestorageSupported=false, DemOperationCycleRef=DEM_OPCYC_OBD_DCY, DemDTCRef=DemDTCClass_Batt_Overtemp_3
          DemEventClass:
            DemAgingAllowed = true
            DemAgingCycleCounterThreshold = 3
            DemEventFailureCycleCounterThreshold = 1
            DemEventPriority = 2
            DemFFPrestorageSupported = false
            DemEventDestination = DEM_DTC_ORIGIN_PRIMARY_MEMORY
            DemEventSignificance = DEM_EVENT_SIGNIFICANCE_FAULT
            DemDebounceAlgorithmClass
          DemRbEventClass: DemRbEventBufferTime=0, DemRbEventRecoverableInSameOperationCycle=true, DemRbEventStatusBitStorageTestFailed=false
          DemDebounceAlgorithmClass
            DemDebounceCounterBased: DemDebounceCounterBasedClassRef=Generic_DemDebounceCounterBasedClass
        Event_Batt_Undertemp_3: DemFFPrestorageSupported=false, DemOperationCycleRef=DEM_OPCYC_OBD_DCY, DemDTCRef=DemDTCClass_Batt_Undertemp_3
          DemEventClass:
            DemAgingAllowed = true
            DemAgingCycleCounterThreshold = 3
            DemEventFailureCycleCounterThreshold = 1
            DemEventPriority = 2
            DemFFPrestorageSupported = false
            DemEventDestination = DEM_DTC_ORIGIN_PRIMARY_MEMORY
            DemEventSignificance = DEM_EVENT_SIGNIFICANCE_FAULT
            DemDebounceAlgorithmClass
          DemRbEventClass: DemRbEventBufferTime=0, DemRbEventRecoverableInSameOperationCycle=true, DemRbEventStatusBitStorageTestFailed=false
          DemDebounceAlgorithmClass
            DemDebounceCounterBased: DemDebounceCounterBasedClassRef=Generic_DemDebounceCounterBasedClass
        Event_Batt_Deltatemp_3: DemFFPrestorageSupported=false, DemOperationCycleRef=DEM_OPCYC_POWER, DemDTCRef=DemDTCClass_Batt_Deltatemp_3
          DemEventClass:
            DemAgingAllowed = true
            DemAgingCycleCounterThreshold = 3
            DemEventFailureCycleCounterThreshold = 1
            DemEventPriority = 2
            DemFFPrestorageSupported = false
            DemEventDestination = DEM_DTC_ORIGIN_PRIMARY_MEMORY
            DemEventSignificance = DEM_EVENT_SIGNIFICANCE_FAULT
            DemDebounceAlgorithmClass
          DemRbEventClass: DemRbEventBufferTime=0, DemRbEventRecoverableInSameOperationCycle=true, DemRbEventStatusBitStorageTestFailed=false
          DemDebounceAlgorithmClass
            DemDebounceCounterBased: DemDebounceCounterBasedClassRef=Generic_DemDebounceCounterBasedClass
        Event_Pack_OverDchrgPower_3: DemFFPrestorageSupported=false, DemOperationCycleRef=DEM_OPCYC_POWER, DemDTCRef=DemDTCClass_Pack_OverDchrgPower_3
          DemEventClass:
            DemAgingAllowed = true
            DemAgingCycleCounterThreshold = 3
            DemEventFailureCycleCounterThreshold = 1
            DemEventPriority = 2
            DemFFPrestorageSupported = false
            DemEventDestination = DEM_DTC_ORIGIN_PRIMARY_MEMORY
            DemEventSignificance = DEM_EVENT_SIGNIFICANCE_FAULT
            DemDebounceAlgorithmClass
          DemRbEventClass: DemRbEventBufferTime=0, DemRbEventRecoverableInSameOperationCycle=true, DemRbEventStatusBitStorageTestFailed=false
          DemDebounceAlgorithmClass
            DemDebounceCounterBased: DemDebounceCounterBasedClassRef=Generic_DemDebounceCounterBasedClass
        Event_Pack_OverRegenPower_3: DemFFPrestorageSupported=false, DemOperationCycleRef=DEM_OPCYC_POWER, DemDTCRef=DemDTCClass_Pack_OverRegenPower_3
          DemEventClass:
            DemAgingAllowed = true
            DemAgingCycleCounterThreshold = 3
            DemEventFailureCycleCounterThreshold = 1
            DemEventPriority = 2
            DemFFPrestorageSupported = false
            DemEventDestination = DEM_DTC_ORIGIN_PRIMARY_MEMORY
            DemEventSignificance = DEM_EVENT_SIGNIFICANCE_FAULT
            DemDebounceAlgorithmClass
          DemRbEventClass: DemRbEventBufferTime=0, DemRbEventRecoverableInSameOperationCycle=true, DemRbEventStatusBitStorageTestFailed=false
          DemDebounceAlgorithmClass
            DemDebounceCounterBased: DemDebounceCounterBasedClassRef=Generic_DemDebounceCounterBasedClass
        Event_BMS_ACChrgOverCurrent: DemFFPrestorageSupported=false, DemOperationCycleRef=DEM_OPCYC_OBD_DCY, DemDTCRef=DemDTCClass_BMS_ACChrgOverCurrent
          DemEventClass:
            DemAgingAllowed = true
            DemAgingCycleCounterThreshold = 3
            DemEventFailureCycleCounterThreshold = 1
            DemEventPriority = 2
            DemFFPrestorageSupported = false
            DemEventDestination = DEM_DTC_ORIGIN_PRIMARY_MEMORY
            DemEventSignificance = DEM_EVENT_SIGNIFICANCE_FAULT
            DemDebounceAlgorithmClass
          DemRbEventClass: DemRbEventBufferTime=0, DemRbEventRecoverableInSameOperationCycle=true, DemRbEventStatusBitStorageTestFailed=false
          DemDebounceAlgorithmClass
            DemDebounceCounterBased: DemDebounceCounterBasedClassRef=Generic_DemDebounceCounterBasedClass
        Event_SOC_low_3: DemFFPrestorageSupported=false, DemOperationCycleRef=DEM_OPCYC_POWER, DemDTCRef=DemDTCClass_SOC_low_3
          DemEventClass:
            DemAgingAllowed = true
            DemAgingCycleCounterThreshold = 3
            DemEventFailureCycleCounterThreshold = 1
            DemEventPriority = 2
            DemFFPrestorageSupported = false
            DemEventDestination = DEM_DTC_ORIGIN_PRIMARY_MEMORY
            DemEventSignificance = DEM_EVENT_SIGNIFICANCE_FAULT
            DemDebounceAlgorithmClass
          DemRbEventClass: DemRbEventBufferTime=0, DemRbEventRecoverableInSameOperationCycle=true, DemRbEventStatusBitStorageTestFailed=false
          DemDebounceAlgorithmClass
            DemDebounceCounterBased: DemDebounceCounterBasedClassRef=Generic_DemDebounceCounterBasedClass
        Event_IsoResistor_Error_1: DemFFPrestorageSupported=false, DemOperationCycleRef=DEM_OPCYC_POWER, DemDTCRef=DemDTCClass_IsoResistor_Error_1
          DemEventClass:
            DemAgingAllowed = true
            DemAgingCycleCounterThreshold = 3
            DemEventFailureCycleCounterThreshold = 1
            DemEventPriority = 2
            DemFFPrestorageSupported = false
            DemEventDestination = DEM_DTC_ORIGIN_PRIMARY_MEMORY
            DemEventSignificance = DEM_EVENT_SIGNIFICANCE_FAULT
            DemDebounceAlgorithmClass
          DemRbEventClass: DemRbEventBufferTime=0, DemRbEventRecoverableInSameOperationCycle=true, DemRbEventStatusBitStorageTestFailed=false
          DemDebounceAlgorithmClass
            DemDebounceCounterBased: DemDebounceCounterBasedClassRef=Generic_DemDebounceCounterBasedClass
        Event_IsoResistor_Error_2: DemFFPrestorageSupported=false, DemOperationCycleRef=DEM_OPCYC_OBD_DCY, DemDTCRef=DemDTCClass_IsoResistor_Error_2
          DemEventClass:
            DemAgingAllowed = true
            DemAgingCycleCounterThreshold = 3
            DemEventFailureCycleCounterThreshold = 1
            DemEventPriority = 2
            DemFFPrestorageSupported = false
            DemEventDestination = DEM_DTC_ORIGIN_PRIMARY_MEMORY
            DemEventSignificance = DEM_EVENT_SIGNIFICANCE_FAULT
            DemDebounceAlgorithmClass
          DemRbEventClass: DemRbEventBufferTime=0, DemRbEventRecoverableInSameOperationCycle=true, DemRbEventStatusBitStorageTestFailed=false
          DemDebounceAlgorithmClass
            DemDebounceCounterBased: DemDebounceCounterBasedClassRef=Generic_DemDebounceCounterBasedClass
        Event_Crash_states: DemFFPrestorageSupported=false, DemOperationCycleRef=DEM_OPCYC_OBD_DCY, DemDTCRef=DemDTCClass_Crash_states
          DemEventClass:
            DemAgingAllowed = true
            DemAgingCycleCounterThreshold = 3
            DemEventFailureCycleCounterThreshold = 1
            DemEventPriority = 2
            DemFFPrestorageSupported = false
            DemEventDestination = DEM_DTC_ORIGIN_PRIMARY_MEMORY
            DemEventSignificance = DEM_EVENT_SIGNIFICANCE_FAULT
            DemDebounceAlgorithmClass
          DemRbEventClass: DemRbEventBufferTime=0, DemRbEventRecoverableInSameOperationCycle=true, DemRbEventStatusBitStorageTestFailed=false
          DemDebounceAlgorithmClass
            DemDebounceCounterBased: DemDebounceCounterBasedClassRef=Generic_DemDebounceCounterBasedClass
        Event_ThermalRunaway_Error: DemFFPrestorageSupported=false, DemOperationCycleRef=DEM_OPCYC_OBD_DCY, DemDTCRef=DemDTCClass_ThermalRunaway_Error
          DemEventClass:
            DemAgingAllowed = true
            DemAgingCycleCounterThreshold = 3
            DemEventFailureCycleCounterThreshold = 1
            DemEventPriority = 2
            DemFFPrestorageSupported = false
            DemEventDestination = DEM_DTC_ORIGIN_PRIMARY_MEMORY
            DemEventSignificance = DEM_EVENT_SIGNIFICANCE_FAULT
            DemDebounceAlgorithmClass
          DemRbEventClass: DemRbEventBufferTime=0, DemRbEventRecoverableInSameOperationCycle=true, DemRbEventStatusBitStorageTestFailed=false
          DemDebounceAlgorithmClass
            DemDebounceCounterBased: DemDebounceCounterBasedClassRef=Generic_DemDebounceCounterBasedClass
        Event_BatteryHeatingFault: DemFFPrestorageSupported=false, DemOperationCycleRef=DEM_OPCYC_POWER, DemDTCRef=DemDTCClass_BatteryHeatingFault
          DemEventClass:
            DemAgingAllowed = true
            DemAgingCycleCounterThreshold = 3
            DemEventFailureCycleCounterThreshold = 1
            DemEventPriority = 2
            DemFFPrestorageSupported = false
            DemEventDestination = DEM_DTC_ORIGIN_PRIMARY_MEMORY
            DemEventSignificance = DEM_EVENT_SIGNIFICANCE_FAULT
            DemDebounceAlgorithmClass
          DemRbEventClass: DemRbEventBufferTime=0, DemRbEventRecoverableInSameOperationCycle=true, DemRbEventStatusBitStorageTestFailed=false
          DemDebounceAlgorithmClass
            DemDebounceCounterBased: DemDebounceCounterBasedClassRef=Generic_DemDebounceCounterBasedClass
        Event_BatteryCoolingFault: DemFFPrestorageSupported=false, DemOperationCycleRef=DEM_OPCYC_POWER, DemDTCRef=DemDTCClass_BatteryCoolingFault
          DemEventClass:
            DemAgingAllowed = true
            DemAgingCycleCounterThreshold = 3
            DemEventFailureCycleCounterThreshold = 1
            DemEventPriority = 2
            DemFFPrestorageSupported = false
            DemEventDestination = DEM_DTC_ORIGIN_PRIMARY_MEMORY
            DemEventSignificance = DEM_EVENT_SIGNIFICANCE_FAULT
            DemDebounceAlgorithmClass
          DemRbEventClass: DemRbEventBufferTime=0, DemRbEventRecoverableInSameOperationCycle=true, DemRbEventStatusBitStorageTestFailed=false
          DemDebounceAlgorithmClass
            DemDebounceCounterBased: DemDebounceCounterBasedClassRef=Generic_DemDebounceCounterBasedClass
        Event_BatteryCircuitOverCurrent: DemFFPrestorageSupported=false, DemOperationCycleRef=DEM_OPCYC_POWER, DemDTCRef=DemDTCClass_BatteryCircuitOverCurrent
          DemEventClass:
            DemAgingAllowed = true
            DemAgingCycleCounterThreshold = 3
            DemEventFailureCycleCounterThreshold = 1
            DemEventPriority = 2
            DemFFPrestorageSupported = false
            DemEventDestination = DEM_DTC_ORIGIN_PRIMARY_MEMORY
            DemEventSignificance = DEM_EVENT_SIGNIFICANCE_FAULT
            DemDebounceAlgorithmClass
          DemRbEventClass: DemRbEventBufferTime=0, DemRbEventRecoverableInSameOperationCycle=true, DemRbEventStatusBitStorageTestFailed=false
          DemDebounceAlgorithmClass
            DemDebounceCounterBased: DemDebounceCounterBasedClassRef=Generic_DemDebounceCounterBasedClass
        Event_PosCont_StuckClose: DemFFPrestorageSupported=false, DemOperationCycleRef=DEM_OPCYC_OBD_DCY, DemDTCRef=DemDTCClass_PosCont_StuckClose
          DemEventClass:
            DemAgingAllowed = true
            DemAgingCycleCounterThreshold = 3
            DemEventFailureCycleCounterThreshold = 1
            DemEventPriority = 2
            DemFFPrestorageSupported = false
            DemEventDestination = DEM_DTC_ORIGIN_PRIMARY_MEMORY
            DemEventSignificance = DEM_EVENT_SIGNIFICANCE_FAULT
            DemDebounceAlgorithmClass
          DemRbEventClass: DemRbEventBufferTime=0, DemRbEventRecoverableInSameOperationCycle=true, DemRbEventStatusBitStorageTestFailed=false
          DemDebounceAlgorithmClass
            DemDebounceCounterBased: DemDebounceCounterBasedClassRef=Generic_DemDebounceCounterBasedClass
        Event_PosCont_StuckOpen: DemFFPrestorageSupported=false, DemOperationCycleRef=DEM_OPCYC_OBD_DCY, DemDTCRef=DemDTCClass_PosCont_StuckOpen
          DemEventClass:
            DemAgingAllowed = true
            DemAgingCycleCounterThreshold = 3
            DemEventFailureCycleCounterThreshold = 1
            DemEventPriority = 2
            DemFFPrestorageSupported = false
            DemEventDestination = DEM_DTC_ORIGIN_PRIMARY_MEMORY
            DemEventSignificance = DEM_EVENT_SIGNIFICANCE_FAULT
            DemDebounceAlgorithmClass
          DemRbEventClass: DemRbEventBufferTime=0, DemRbEventRecoverableInSameOperationCycle=true, DemRbEventStatusBitStorageTestFailed=false
          DemDebounceAlgorithmClass
            DemDebounceCounterBased: DemDebounceCounterBasedClassRef=Generic_DemDebounceCounterBasedClass
        Event_NegCont_StuckClose: DemFFPrestorageSupported=false, DemOperationCycleRef=DEM_OPCYC_OBD_DCY, DemDTCRef=DemDTCClass_NegCont_StuckClose
          DemEventClass:
            DemAgingAllowed = true
            DemAgingCycleCounterThreshold = 3
            DemEventFailureCycleCounterThreshold = 1
            DemEventPriority = 2
            DemFFPrestorageSupported = false
            DemEventDestination = DEM_DTC_ORIGIN_PRIMARY_MEMORY
            DemEventSignificance = DEM_EVENT_SIGNIFICANCE_FAULT
            DemDebounceAlgorithmClass
          DemRbEventClass: DemRbEventBufferTime=0, DemRbEventRecoverableInSameOperationCycle=true, DemRbEventStatusBitStorageTestFailed=false
          DemDebounceAlgorithmClass
            DemDebounceCounterBased: DemDebounceCounterBasedClassRef=Generic_DemDebounceCounterBasedClass
        Event_NegCont_StuckOpen: DemFFPrestorageSupported=false, DemOperationCycleRef=DEM_OPCYC_OBD_DCY, DemDTCRef=DemDTCClass_NegCont_StuckOpen
          DemEventClass:
            DemAgingAllowed = true
            DemAgingCycleCounterThreshold = 3
            DemEventFailureCycleCounterThreshold = 1
            DemEventPriority = 2
            DemFFPrestorageSupported = false
            DemEventDestination = DEM_DTC_ORIGIN_PRIMARY_MEMORY
            DemEventSignificance = DEM_EVENT_SIGNIFICANCE_FAULT
            DemDebounceAlgorithmClass
          DemRbEventClass: DemRbEventBufferTime=0, DemRbEventRecoverableInSameOperationCycle=true, DemRbEventStatusBitStorageTestFailed=false
          DemDebounceAlgorithmClass
            DemDebounceCounterBased: DemDebounceCounterBasedClassRef=Generic_DemDebounceCounterBasedClass
        Event_PrechrgCont_StuckClose: DemFFPrestorageSupported=false, DemOperationCycleRef=DEM_OPCYC_OBD_DCY, DemDTCRef=DemDTCClass_PrechrgCont_StuckClose
          DemEventClass:
            DemAgingAllowed = true
            DemAgingCycleCounterThreshold = 3
            DemEventFailureCycleCounterThreshold = 1
            DemEventPriority = 2
            DemFFPrestorageSupported = false
            DemEventDestination = DEM_DTC_ORIGIN_PRIMARY_MEMORY
            DemEventSignificance = DEM_EVENT_SIGNIFICANCE_FAULT
            DemDebounceAlgorithmClass
          DemRbEventClass: DemRbEventBufferTime=0, DemRbEventRecoverableInSameOperationCycle=true, DemRbEventStatusBitStorageTestFailed=false
          DemDebounceAlgorithmClass
            DemDebounceCounterBased: DemDebounceCounterBasedClassRef=Generic_DemDebounceCounterBasedClass
        Event_PrechrgCont_StuckOpen: DemFFPrestorageSupported=false, DemOperationCycleRef=DEM_OPCYC_OBD_DCY, DemDTCRef=DemDTCClass_PrechrgCont_StuckOpen
          DemEventClass:
            DemAgingAllowed = true
            DemAgingCycleCounterThreshold = 3
            DemEventFailureCycleCounterThreshold = 1
            DemEventPriority = 2
            DemFFPrestorageSupported = false
            DemEventDestination = DEM_DTC_ORIGIN_PRIMARY_MEMORY
            DemEventSignificance = DEM_EVENT_SIGNIFICANCE_FAULT
            DemDebounceAlgorithmClass
          DemRbEventClass: DemRbEventBufferTime=0, DemRbEventRecoverableInSameOperationCycle=true, DemRbEventStatusBitStorageTestFailed=false
          DemDebounceAlgorithmClass
            DemDebounceCounterBased: DemDebounceCounterBasedClassRef=Generic_DemDebounceCounterBasedClass
        Event_MainFuse1_Open: DemFFPrestorageSupported=false, DemOperationCycleRef=DEM_OPCYC_OBD_DCY, DemDTCRef=DemDTCClass_MainFuse1_Open
          DemEventClass:
            DemAgingAllowed = true
            DemAgingCycleCounterThreshold = 3
            DemEventFailureCycleCounterThreshold = 1
            DemEventPriority = 2
            DemFFPrestorageSupported = false
            DemEventDestination = DEM_DTC_ORIGIN_PRIMARY_MEMORY
            DemEventSignificance = DEM_EVENT_SIGNIFICANCE_FAULT
            DemDebounceAlgorithmClass
          DemRbEventClass: DemRbEventBufferTime=0, DemRbEventRecoverableInSameOperationCycle=true, DemRbEventStatusBitStorageTestFailed=false
          DemDebounceAlgorithmClass
            DemDebounceCounterBased: DemDebounceCounterBasedClassRef=Generic_DemDebounceCounterBasedClass
        Event_MainFuse2_Open: DemFFPrestorageSupported=false, DemOperationCycleRef=DEM_OPCYC_POWER, DemDTCRef=DemDTCClass_MainFuse2_Open
          DemEventClass:
            DemAgingAllowed = true
            DemAgingCycleCounterThreshold = 3
            DemEventFailureCycleCounterThreshold = 1
            DemEventPriority = 2
            DemFFPrestorageSupported = false
            DemEventDestination = DEM_DTC_ORIGIN_PRIMARY_MEMORY
            DemEventSignificance = DEM_EVENT_SIGNIFICANCE_FAULT
            DemDebounceAlgorithmClass
          DemRbEventClass: DemRbEventBufferTime=0, DemRbEventRecoverableInSameOperationCycle=true, DemRbEventStatusBitStorageTestFailed=false
          DemDebounceAlgorithmClass
            DemDebounceCounterBased: DemDebounceCounterBasedClassRef=Generic_DemDebounceCounterBasedClass
        Event_VehicleHVInterlockError: DemFFPrestorageSupported=false, DemOperationCycleRef=DEM_OPCYC_OBD_DCY, DemDTCRef=DemDTCClass_VehicleHVInterlockError
          DemEventClass:
            DemAgingAllowed = true
            DemAgingCycleCounterThreshold = 3
            DemEventFailureCycleCounterThreshold = 1
            DemEventPriority = 2
            DemFFPrestorageSupported = false
            DemEventDestination = DEM_DTC_ORIGIN_PRIMARY_MEMORY
            DemEventSignificance = DEM_EVENT_SIGNIFICANCE_FAULT
            DemDebounceAlgorithmClass
          DemRbEventClass: DemRbEventBufferTime=0, DemRbEventRecoverableInSameOperationCycle=true, DemRbEventStatusBitStorageTestFailed=false
          DemDebounceAlgorithmClass
            DemDebounceCounterBased: DemDebounceCounterBasedClassRef=Generic_DemDebounceCounterBasedClass
        Event_BatteryHVInterlockError: DemFFPrestorageSupported=false, DemOperationCycleRef=DEM_OPCYC_OBD_DCY, DemDTCRef=DemDTCClass_BatteryHVInterlockError
          DemEventClass:
            DemAgingAllowed = true
            DemAgingCycleCounterThreshold = 3
            DemEventFailureCycleCounterThreshold = 1
            DemEventPriority = 2
            DemFFPrestorageSupported = false
            DemEventDestination = DEM_DTC_ORIGIN_PRIMARY_MEMORY
            DemEventSignificance = DEM_EVENT_SIGNIFICANCE_FAULT
            DemDebounceAlgorithmClass
          DemRbEventClass: DemRbEventBufferTime=0, DemRbEventRecoverableInSameOperationCycle=true, DemRbEventStatusBitStorageTestFailed=false
          DemDebounceAlgorithmClass
            DemDebounceCounterBased: DemDebounceCounterBasedClassRef=Generic_DemDebounceCounterBasedClass
        Event_BatteryInsulationFault: DemFFPrestorageSupported=false, DemOperationCycleRef=DEM_OPCYC_POWER, DemDTCRef=DemDTCClass_BatteryInsulationFault
          DemEventClass:
            DemAgingAllowed = true
            DemAgingCycleCounterThreshold = 3
            DemEventFailureCycleCounterThreshold = 1
            DemEventPriority = 2
            DemFFPrestorageSupported = false
            DemEventDestination = DEM_DTC_ORIGIN_PRIMARY_MEMORY
            DemEventSignificance = DEM_EVENT_SIGNIFICANCE_FAULT
            DemDebounceAlgorithmClass
          DemRbEventClass: DemRbEventBufferTime=0, DemRbEventRecoverableInSameOperationCycle=true, DemRbEventStatusBitStorageTestFailed=false
          DemDebounceAlgorithmClass
            DemDebounceCounterBased: DemDebounceCounterBasedClassRef=Generic_DemDebounceCounterBasedClass
        Event_VehicleInsulationFault: DemFFPrestorageSupported=false, DemOperationCycleRef=DEM_OPCYC_POWER, DemDTCRef=DemDTCClass_VehicleInsulationFault
          DemEventClass:
            DemAgingAllowed = true
            DemAgingCycleCounterThreshold = 3
            DemEventFailureCycleCounterThreshold = 1
            DemEventPriority = 2
            DemFFPrestorageSupported = false
            DemEventDestination = DEM_DTC_ORIGIN_PRIMARY_MEMORY
            DemEventSignificance = DEM_EVENT_SIGNIFICANCE_FAULT
            DemDebounceAlgorithmClass
          DemRbEventClass: DemRbEventBufferTime=0, DemRbEventRecoverableInSameOperationCycle=true, DemRbEventStatusBitStorageTestFailed=false
          DemDebounceAlgorithmClass
            DemDebounceCounterBased: DemDebounceCounterBasedClassRef=Generic_DemDebounceCounterBasedClass
        Event_Precharge_Resistor_Open: DemFFPrestorageSupported=true, DemOperationCycleRef=DEM_OPCYC_POWER, DemDTCRef=DemDTCClass_Precharge_Resistor_Open
          DemEventClass:
            DemAgingAllowed = true
            DemAgingCycleCounterThreshold = 3
            DemEventFailureCycleCounterThreshold = 1
            DemEventPriority = 2
            DemFFPrestorageSupported = false
            DemEventDestination = DEM_DTC_ORIGIN_PRIMARY_MEMORY
            DemEventSignificance = DEM_EVENT_SIGNIFICANCE_FAULT
            DemDebounceAlgorithmClass
          DemRbEventClass: DemRbEventBufferTime=0, DemRbEventRecoverableInSameOperationCycle=true, DemRbEventStatusBitStorageTestFailed=false
          DemDebounceAlgorithmClass
            DemDebounceCounterBased: DemDebounceCounterBasedClassRef=Generic_DemDebounceCounterBasedClass
        Event_Precharge_Error: DemFFPrestorageSupported=false, DemOperationCycleRef=DEM_OPCYC_OBD_DCY, DemDTCRef=DemDTCClass_Precharge_Error
          DemEventClass:
            DemAgingAllowed = true
            DemAgingCycleCounterThreshold = 3
            DemEventFailureCycleCounterThreshold = 1
            DemEventPriority = 2
            DemFFPrestorageSupported = false
            DemEventDestination = DEM_DTC_ORIGIN_PRIMARY_MEMORY
            DemEventSignificance = DEM_EVENT_SIGNIFICANCE_FAULT
            DemDebounceAlgorithmClass
          DemRbEventClass: DemRbEventBufferTime=0, DemRbEventRecoverableInSameOperationCycle=true, DemRbEventStatusBitStorageTestFailed=false
          DemDebounceAlgorithmClass
            DemDebounceCounterBased: DemDebounceCounterBasedClassRef=Generic_DemDebounceCounterBasedClass
        Event_PrechargeShortCircuit: DemFFPrestorageSupported=false, DemOperationCycleRef=DEM_OPCYC_POWER, DemDTCRef=DemDTCClass_PrechargeShortCircuit
          DemEventClass:
            DemAgingAllowed = true
            DemAgingCycleCounterThreshold = 3
            DemEventFailureCycleCounterThreshold = 1
            DemEventPriority = 2
            DemFFPrestorageSupported = false
            DemEventDestination = DEM_DTC_ORIGIN_PRIMARY_MEMORY
            DemEventSignificance = DEM_EVENT_SIGNIFICANCE_FAULT
            DemDebounceAlgorithmClass
          DemRbEventClass: DemRbEventBufferTime=0, DemRbEventRecoverableInSameOperationCycle=true, DemRbEventStatusBitStorageTestFailed=false
          DemDebounceAlgorithmClass
            DemDebounceCounterBased: DemDebounceCounterBasedClassRef=Generic_DemDebounceCounterBasedClass
        Event_CAN_VCU_error: DemFFPrestorageSupported=false, DemOperationCycleRef=DEM_OPCYC_POWER, DemDTCRef=DemDTCClass_CAN_VCU_error
          DemEventClass:
            DemAgingAllowed = true
            DemAgingCycleCounterThreshold = 3
            DemEventFailureCycleCounterThreshold = 1
            DemEventPriority = 2
            DemFFPrestorageSupported = false
            DemEventDestination = DEM_DTC_ORIGIN_PRIMARY_MEMORY
            DemEventSignificance = DEM_EVENT_SIGNIFICANCE_FAULT
            DemDebounceAlgorithmClass
          DemRbEventClass: DemRbEventBufferTime=0, DemRbEventRecoverableInSameOperationCycle=true, DemRbEventStatusBitStorageTestFailed=false
          DemDebounceAlgorithmClass
            DemDebounceCounterBased: DemDebounceCounterBasedClassRef=Generic_DemDebounceCounterBasedClass
        Event_CAN_MCUF_Error: DemFFPrestorageSupported=false, DemOperationCycleRef=DEM_OPCYC_POWER, DemDTCRef=DemDTCClass_CAN_MCUF_Error
          DemEventClass:
            DemAgingAllowed = true
            DemAgingCycleCounterThreshold = 3
            DemEventFailureCycleCounterThreshold = 1
            DemEventPriority = 2
            DemFFPrestorageSupported = false
            DemEventDestination = DEM_DTC_ORIGIN_PRIMARY_MEMORY
            DemEventSignificance = DEM_EVENT_SIGNIFICANCE_FAULT
            DemDebounceAlgorithmClass
          DemRbEventClass: DemRbEventBufferTime=0, DemRbEventRecoverableInSameOperationCycle=true, DemRbEventStatusBitStorageTestFailed=false
          DemDebounceAlgorithmClass
            DemDebounceCounterBased: DemDebounceCounterBasedClassRef=Generic_DemDebounceCounterBasedClass
        Event_CAN_MCUR_Error: DemFFPrestorageSupported=false, DemOperationCycleRef=DEM_OPCYC_POWER, DemDTCRef=DemDTCClass_CAN_MCUR_Error
          DemEventClass:
            DemAgingAllowed = true
            DemAgingCycleCounterThreshold = 3
            DemEventFailureCycleCounterThreshold = 1
            DemEventPriority = 2
            DemFFPrestorageSupported = false
            DemEventDestination = DEM_DTC_ORIGIN_PRIMARY_MEMORY
            DemEventSignificance = DEM_EVENT_SIGNIFICANCE_FAULT
            DemDebounceAlgorithmClass
          DemRbEventClass: DemRbEventBufferTime=0, DemRbEventRecoverableInSameOperationCycle=true, DemRbEventStatusBitStorageTestFailed=false
          DemDebounceAlgorithmClass
            DemDebounceCounterBased: DemDebounceCounterBasedClassRef=Generic_DemDebounceCounterBasedClass
        Event_CAN_ISG_Error: DemFFPrestorageSupported=false, DemOperationCycleRef=DEM_OPCYC_POWER, DemDTCRef=DemDTCClass_CAN_ISG_Error
          DemEventClass:
            DemAgingAllowed = true
            DemAgingCycleCounterThreshold = 3
            DemEventFailureCycleCounterThreshold = 1
            DemEventPriority = 2
            DemFFPrestorageSupported = false
            DemEventDestination = DEM_DTC_ORIGIN_PRIMARY_MEMORY
            DemEventSignificance = DEM_EVENT_SIGNIFICANCE_FAULT
            DemDebounceAlgorithmClass
          DemRbEventClass: DemRbEventBufferTime=0, DemRbEventRecoverableInSameOperationCycle=true, DemRbEventStatusBitStorageTestFailed=false
          DemDebounceAlgorithmClass
            DemDebounceCounterBased: DemDebounceCounterBasedClassRef=Generic_DemDebounceCounterBasedClass
        Event_CAN_CDU_Error: DemFFPrestorageSupported=true, DemOperationCycleRef=DEM_OPCYC_POWER, DemDTCRef=DemDTCClass_CAN_CDU_Error
          DemEventClass:
            DemAgingAllowed = true
            DemAgingCycleCounterThreshold = 3
            DemEventFailureCycleCounterThreshold = 1
            DemEventPriority = 2
            DemFFPrestorageSupported = false
            DemEventDestination = DEM_DTC_ORIGIN_PRIMARY_MEMORY
            DemEventSignificance = DEM_EVENT_SIGNIFICANCE_FAULT
            DemDebounceAlgorithmClass
          DemRbEventClass: DemRbEventBufferTime=0, DemRbEventRecoverableInSameOperationCycle=true, DemRbEventStatusBitStorageTestFailed=false
          DemDebounceAlgorithmClass
            DemDebounceCounterBased: DemDebounceCounterBasedClassRef=Generic_DemDebounceCounterBasedClass
        Event_CAN_CLM_Error: DemFFPrestorageSupported=false, DemOperationCycleRef=DEM_OPCYC_POWER, DemDTCRef=DemDTCClass_CAN_CLM_Error
          DemEventClass:
            DemAgingAllowed = true
            DemAgingCycleCounterThreshold = 3
            DemEventFailureCycleCounterThreshold = 1
            DemEventPriority = 2
            DemFFPrestorageSupported = false
            DemEventDestination = DEM_DTC_ORIGIN_PRIMARY_MEMORY
            DemEventSignificance = DEM_EVENT_SIGNIFICANCE_FAULT
            DemDebounceAlgorithmClass
          DemRbEventClass: DemRbEventBufferTime=0, DemRbEventRecoverableInSameOperationCycle=true, DemRbEventStatusBitStorageTestFailed=false
          DemDebounceAlgorithmClass
            DemDebounceCounterBased: DemDebounceCounterBasedClassRef=Generic_DemDebounceCounterBasedClass
        Event_CAN_ABM_Error: DemFFPrestorageSupported=false, DemOperationCycleRef=DEM_OPCYC_POWER, DemDTCRef=DemDTCClass_CAN_ABM_Error
          DemEventClass:
            DemAgingAllowed = true
            DemAgingCycleCounterThreshold = 3
            DemEventFailureCycleCounterThreshold = 1
            DemEventPriority = 2
            DemFFPrestorageSupported = false
            DemEventDestination = DEM_DTC_ORIGIN_PRIMARY_MEMORY
            DemEventSignificance = DEM_EVENT_SIGNIFICANCE_FAULT
            DemDebounceAlgorithmClass
          DemRbEventClass: DemRbEventBufferTime=0, DemRbEventRecoverableInSameOperationCycle=true, DemRbEventStatusBitStorageTestFailed=false
          DemDebounceAlgorithmClass
            DemDebounceCounterBased: DemDebounceCounterBasedClassRef=Generic_DemDebounceCounterBasedClass
        Event_CAN_ICM_Error: DemFFPrestorageSupported=false, DemOperationCycleRef=DEM_OPCYC_POWER, DemDTCRef=DemDTCClass_CAN_ICM_Error
          DemEventClass:
            DemAgingAllowed = true
            DemAgingCycleCounterThreshold = 3
            DemEventFailureCycleCounterThreshold = 1
            DemEventPriority = 2
            DemFFPrestorageSupported = false
            DemEventDestination = DEM_DTC_ORIGIN_PRIMARY_MEMORY
            DemEventSignificance = DEM_EVENT_SIGNIFICANCE_FAULT
            DemDebounceAlgorithmClass
          DemRbEventClass: DemRbEventBufferTime=0, DemRbEventRecoverableInSameOperationCycle=true, DemRbEventStatusBitStorageTestFailed=false
          DemDebounceAlgorithmClass
            DemDebounceCounterBased: DemDebounceCounterBasedClassRef=Generic_DemDebounceCounterBasedClass
        Event_CAN_TBOX_Error: DemFFPrestorageSupported=false, DemOperationCycleRef=DEM_OPCYC_POWER, DemDTCRef=DemDTCClass_CAN_TBOX_Error
          DemEventClass:
            DemAgingAllowed = true
            DemAgingCycleCounterThreshold = 3
            DemEventFailureCycleCounterThreshold = 1
            DemEventPriority = 2
            DemFFPrestorageSupported = false
            DemEventDestination = DEM_DTC_ORIGIN_PRIMARY_MEMORY
            DemEventSignificance = DEM_EVENT_SIGNIFICANCE_FAULT
            DemDebounceAlgorithmClass
          DemRbEventClass: DemRbEventBufferTime=0, DemRbEventRecoverableInSameOperationCycle=true, DemRbEventStatusBitStorageTestFailed=false
          DemDebounceAlgorithmClass
            DemDebounceCounterBased: DemDebounceCounterBasedClassRef=Generic_DemDebounceCounterBasedClass
        Event_CAN_BSM_Error: DemFFPrestorageSupported=false, DemOperationCycleRef=DEM_OPCYC_POWER, DemDTCRef=DemDTCClass_CAN_BSM_Error
          DemEventClass:
            DemAgingAllowed = true
            DemAgingCycleCounterThreshold = 3
            DemEventFailureCycleCounterThreshold = 1
            DemEventPriority = 2
            DemFFPrestorageSupported = false
            DemEventDestination = DEM_DTC_ORIGIN_PRIMARY_MEMORY
            DemEventSignificance = DEM_EVENT_SIGNIFICANCE_FAULT
            DemDebounceAlgorithmClass
          DemRbEventClass: DemRbEventBufferTime=0, DemRbEventRecoverableInSameOperationCycle=true, DemRbEventStatusBitStorageTestFailed=false
          DemDebounceAlgorithmClass
            DemDebounceCounterBased: DemDebounceCounterBasedClassRef=Generic_DemDebounceCounterBasedClass
        Event_CAN_EMS_Error: DemFFPrestorageSupported=false, DemOperationCycleRef=DEM_OPCYC_POWER, DemDTCRef=DemDTCClass_CAN_EMS_Error
          DemEventClass:
            DemAgingAllowed = true
            DemAgingCycleCounterThreshold = 3
            DemEventFailureCycleCounterThreshold = 1
            DemEventPriority = 2
            DemFFPrestorageSupported = false
            DemEventDestination = DEM_DTC_ORIGIN_PRIMARY_MEMORY
            DemEventSignificance = DEM_EVENT_SIGNIFICANCE_FAULT
            DemDebounceAlgorithmClass
          DemRbEventClass: DemRbEventBufferTime=0, DemRbEventRecoverableInSameOperationCycle=true, DemRbEventStatusBitStorageTestFailed=false
          DemDebounceAlgorithmClass
            DemDebounceCounterBased: DemDebounceCounterBasedClassRef=Generic_DemDebounceCounterBasedClass
        Event_PTCAN_BusOff: DemFFPrestorageSupported=false, DemOperationCycleRef=DEM_OPCYC_POWER, DemDTCRef=DemDTCClass_PTCAN_BusOff
          DemEventClass:
            DemAgingAllowed = true
            DemAgingCycleCounterThreshold = 3
            DemEventFailureCycleCounterThreshold = 1
            DemEventPriority = 2
            DemFFPrestorageSupported = false
            DemEventDestination = DEM_DTC_ORIGIN_PRIMARY_MEMORY
            DemEventSignificance = DEM_EVENT_SIGNIFICANCE_FAULT
            DemDebounceAlgorithmClass
          DemRbEventClass: DemRbEventBufferTime=0, DemRbEventRecoverableInSameOperationCycle=true, DemRbEventStatusBitStorageTestFailed=false
          DemDebounceAlgorithmClass
            DemDebounceCounterBased: DemDebounceCounterBasedClassRef=Generic_DemDebounceCounterBasedClass
        Event_LV_UnderVoltage: DemFFPrestorageSupported=false, DemOperationCycleRef=DEM_OPCYC_OBD_DCY, DemDTCRef=DemDTCClass_LV_UnderVoltage
          DemEventClass:
            DemAgingAllowed = true
            DemAgingCycleCounterThreshold = 3
            DemEventFailureCycleCounterThreshold = 1
            DemEventPriority = 2
            DemFFPrestorageSupported = false
            DemEventDestination = DEM_DTC_ORIGIN_PRIMARY_MEMORY
            DemEventSignificance = DEM_EVENT_SIGNIFICANCE_FAULT
            DemDebounceAlgorithmClass
          DemRbEventClass: DemRbEventBufferTime=0, DemRbEventRecoverableInSameOperationCycle=true, DemRbEventStatusBitStorageTestFailed=false
          DemDebounceAlgorithmClass
            DemDebounceCounterBased: DemDebounceCounterBasedClassRef=Generic_DemDebounceCounterBasedClass
        Event_LV_OverVoltage: DemFFPrestorageSupported=false, DemOperationCycleRef=DEM_OPCYC_OBD_DCY, DemDTCRef=DemDTCClass_LV_OverVoltage
          DemEventClass:
            DemAgingAllowed = true
            DemAgingCycleCounterThreshold = 3
            DemEventFailureCycleCounterThreshold = 1
            DemEventPriority = 2
            DemFFPrestorageSupported = false
            DemEventDestination = DEM_DTC_ORIGIN_PRIMARY_MEMORY
            DemEventSignificance = DEM_EVENT_SIGNIFICANCE_FAULT
            DemDebounceAlgorithmClass
          DemRbEventClass: DemRbEventBufferTime=0, DemRbEventRecoverableInSameOperationCycle=true, DemRbEventStatusBitStorageTestFailed=false
          DemDebounceAlgorithmClass
            DemDebounceCounterBased: DemDebounceCounterBasedClassRef=Generic_DemDebounceCounterBasedClass
      6 x DemPidClass:
        DemPid0CEngineRPM: DemPidIdentifier=12
          DemPidDataElement: DemPidDataElementClassRef=DemExternalCSDataElementClass_Pid0C_EngineRPM
        DemPid02BatteryTemperature: DemPidIdentifier=2
          DemPidDataElement: DemPidDataElementClassRef=DemExternalCSDataElementClass_Pid02_BatteryTemperature
        DemPid01SOC: DemPidIdentifier=1
          DemPidDataElement: DemPidDataElementClassRef=DemExternalCSDataElementClass_Pid01_SOC
        DemPid03HVContactorStatus: DemPidIdentifier=3
          DemPidDataElement: DemPidDataElementClassRef=DemExternalCSDataElementClass_Pid03_HVContactorStatus
        DemPid46AmbientAirTemperature: DemPidIdentifier=70
          DemPidDataElement: DemPidDataElementClassRef=DemExternalCSDataElementClass_Pid46_AmbientAirTemperature
        DemPid0DVehicleSpeed: DemPidIdentifier=13
          DemPidDataElement: DemPidDataElementClassRef=DemExternalCSDataElementClass_Pid0D_VehicleSpeed
      30 x DemObdDTC:
        DemObdDTC_ChargeOverCurrent: DemDtcValue=6919
        DemObdDTC_PreChargeFail: DemDtcValue=6920
        DemObdDTC_Cell_OverVoltage: DemDtcValue=6916
        DemObdDTC_Cell_UnderVoltage: DemDtcValue=6917
        DemObdDTC_ThermalRunaway: DemDtcValue=6915
        DemObdDTC_BMS_InternalFault: DemDtcValue=6914
        DemObdDTC_IsolationDectionFault: DemDtcValue=6913
        DemObdDTC_CrashState: DemDtcValue=6928
        DemObdDTC_MainFuse_Open1: DemDtcValue=6921
        DemObdDTC_CAN_BusOff: DemDtcValue=6945
        DemObdDTC_Contactor_PositiveStuckOpen: DemDtcValue=6930
        DemObdDTC_Contactor_PositiveStuckClose: DemDtcValue=6931
        DemObdDTC_Contactor_NegativeStuckOpen: DemDtcValue=6930
        DemObdDTC_Contactor_NegativeStuckClose: DemDtcValue=6931
        DemObdDTC_Contactor_PrechargeStuckOpen: DemDtcValue=6930
        DemObdDTC_Contactor_PrechargeStuckClose: DemDtcValue=6931
        DemObdDTC_Cell_CircuitFault: DemDtcValue=6932
        DemObdDTC_Packet_CurrentCircuitFault: DemDtcValue=6933
        DemObdDTC_CrashCircuitFault: DemDtcValue=6934
        DemObdDTC_Temp_ArrayFailure: DemDtcValue=6935
        DemObdDTC_Stack_CircuitFault: DemDtcValue=6936
        DemObdDTC_Battery_UnderTemp: DemDtcValue=6937
        DemObdDTC_MainHVIL: DemDtcValue=6944
        DemObdDTC_LV_UnderVoltage: DemDtcValue=6946
        DemObdDTC_LV_OverVoltage: DemDtcValue=6947
        DemObdDTC_CAN_VCU_error: DemDtcValue=6948
        DemObdDTC_CAN_OBC_error: DemDtcValue=6949
        DemObdDTC_CAN_CheckSum_error: DemDtcValue=6951
        DemObdDTC_CAN_RollingCounter_error: DemDtcValue=6951
        DemObdDTC_HV_ContactorFail: DemDtcValue=6929
      52 x DemDTC, all with DemDTCSeverity=DEM_SEVERITY_NO_SEVERITY:
        DemDTCClass_Cell_Overvoltage_1: DemDtcValue=1772823, DemDTCFunctionalUnit=0, DemDTCAttributesRef=DemDTCAttributes_Cell_Overvoltage_1
        DemDTCClass_Cell_Overvoltage_2: DemDtcValue=1773084, DemDTCFunctionalUnit=1, DemDTCAttributesRef=DemDTCAttributes_Cell_Overvoltage_2
        DemDTCClass_Cell_Overvoltage_3: DemDtcValue=911127, DemDTCFunctionalUnit=2, DemDTCAttributesRef=DemDTCAttributes_Cell_Overvoltage_3, DemObdDTCRef=DemObdDTC_Cell_OverVoltage
        DemDTCClass_Cell_Undervoltage_1: DemDtcValue=1772822, DemDTCFunctionalUnit=3, DemDTCAttributesRef=DemDTCAttributes_Cell_Undervoltage_1
        DemDTCClass_Cell_Undervoltage_2: DemDtcValue=1773340, DemDTCFunctionalUnit=4, DemDTCAttributesRef=DemDTCAttributes_Cell_Undervoltage_2
        DemDTCClass_Cell_Undervoltage_3: DemDtcValue=910870, DemDTCFunctionalUnit=5, DemDTCAttributesRef=DemDTCAttributes_Cell_Undervoltage_3, DemObdDTCRef=DemObdDTC_Cell_UnderVoltage
        DemDTCClass_Cell_Deltavoltage3: DemDtcValue=1773568, DemDTCFunctionalUnit=6, DemDTCAttributesRef=DemDTCAttributes_Cell_Deltavoltage3
        DemDTCClass_Batt_Overvoltage_2: DemDtcValue=730787, DemDTCFunctionalUnit=7, DemDTCAttributesRef=DemDTCAttributes_Batt_Overvoltage_2
        DemDTCClass_Batt_Undervoltage_2: DemDtcValue=730530, DemDTCFunctionalUnit=8, DemDTCAttributesRef=DemDTCAttributes_Batt_Undervoltage_2
        DemDTCClass_Batt_Overtemp_3: DemDtcValue=687691, DemDTCFunctionalUnit=9, DemDTCAttributesRef=DemDTCAttributes_Batt_Overtemp_3, DemObdDTCRef=DemObdDTC_Battery_OverTemperature
        DemDTCClass_Batt_Undertemp_3: DemDtcValue=720128, DemDTCFunctionalUnit=10, DemDTCAttributesRef=DemDTCAttributes_Batt_Undertemp_3, DemObdDTCRef=DemObdDTC_Battery_UnderTemp
        DemDTCClass_Batt_Deltatemp_3: DemDtcValue=895744, DemDTCFunctionalUnit=11, DemDTCAttributesRef=DemDTCAttributes_Batt_Deltatemp_3
        DemDTCClass_Pack_OverDchrgPower_3: DemDtcValue=1775873, DemDTCFunctionalUnit=12, DemDTCAttributesRef=DemDTCAttributes_Pack_OverDchrgPower_3
        DemDTCClass_Pack_OverRegenPower_3: DemDtcValue=1773849, DemDTCFunctionalUnit=13, DemDTCAttributesRef=DemDTCAttributes_Pack_OverRegenPower_3
        DemDTCClass_BMS_ACChrgOverCurrent: DemDtcValue=828928, DemDTCFunctionalUnit=14, DemDTCAttributesRef=DemDTCAttributes_BMS_ACChrgOverCurrent, DemObdDTCRef=DemObdDTC_ChargeOverCurrent
        DemDTCClass_SOC_low_3: DemDtcValue=687360, DemDTCFunctionalUnit=15, DemDTCAttributesRef=DemDTCAttributes_SOC_low_3
        DemDTCClass_IsoResistor_Error_1: DemDtcValue=698398, DemDTCFunctionalUnit=16, DemDTCAttributesRef=DemDTCAttributes_IsoResistor_Error_1
        DemDTCClass_IsoResistor_Error_2: DemDtcValue=698650, DemDTCFunctionalUnit=17, DemDTCAttributesRef=DemDTCAttributes_IsoResistor_Error_2, DemObdDTCRef=DemObdDTC_IsolationDectionFault
        DemDTCClass_Crash_states: DemDtcValue=1774336, DemDTCFunctionalUnit=18, DemDTCAttributesRef=DemDTCAttributes_Crash_states, DemObdDTCRef=DemObdDTC_CrashState
        DemDTCClass_ThermalRunaway_Error: DemDtcValue=1774592, DemDTCFunctionalUnit=19, DemDTCAttributesRef=DemDTCAttributes_ThermalRunaway_Error, DemObdDTCRef=DemObdDTC_ThermalRunaway
        DemDTCClass_BatteryHeatingFault: DemDtcValue=922137, DemDTCFunctionalUnit=20, DemDTCAttributesRef=DemDTCAttributes_BatteryHeatingFault
        DemDTCClass_BatteryCoolingFault: DemDtcValue=799232, DemDTCFunctionalUnit=21, DemDTCAttributesRef=DemDTCAttributes_BatteryCoolingFault
        DemDTCClass_BatteryCircuitOverCurrent: DemDtcValue=829184, DemDTCFunctionalUnit=22, DemDTCAttributesRef=DemDTCAttributes_BatteryCircuitOverCurrent
        DemDTCClass_PosCont_StuckClose: DemDtcValue=696691, DemDTCFunctionalUnit=23, DemDTCAttributesRef=DemDTCAttributes_PosCont_StuckClose, DemObdDTCRef=DemObdDTC_Contactor_PositiveStuckClose
        DemDTCClass_PosCont_StuckOpen: DemDtcValue=696946, DemDTCFunctionalUnit=24, DemDTCAttributesRef=DemDTCAttributes_PosCont_StuckOpen, DemObdDTCRef=DemObdDTC_Contactor_PositiveStuckOpen
        DemDTCClass_NegCont_StuckClose: DemDtcValue=697459, DemDTCFunctionalUnit=25, DemDTCAttributesRef=DemDTCAttributes_NegCont_StuckClose, DemObdDTCRef=DemObdDTC_Contactor_NegativeStuckClose
        DemDTCClass_NegCont_StuckOpen: DemDtcValue=697714, DemDTCFunctionalUnit=26, DemDTCAttributesRef=DemDTCAttributes_NegCont_StuckOpen, DemObdDTCRef=DemObdDTC_Contactor_NegativeStuckOpen
        DemDTCClass_PrechrgCont_StuckClose: DemDtcValue=713331, DemDTCFunctionalUnit=27, DemDTCAttributesRef=DemDTCAttributes_PrechrgCont_StuckClose, DemObdDTCRef=DemObdDTC_Contactor_PrechargeStuckClose
        DemDTCClass_MainFuse1_Open: DemDtcValue=693523, DemDTCFunctionalUnit=29, DemDTCAttributesRef=DemDTCAttributes_MainFuse1_Open, DemObdDTCRef=DemObdDTC_MainFuse_Open1
        DemDTCClass_MainFuse2_Open: DemDtcValue=929555, DemDTCFunctionalUnit=30, DemDTCAttributesRef=DemDTCAttributes_MainFuse2_Open
        DemDTCClass_VehicleHVInterlockError: DemDtcValue=1775361, DemDTCFunctionalUnit=31, DemDTCAttributesRef=DemDTCAttributes_VehicleHVInterlockError, DemObdDTCRef=DemObdDTC_MainHVIL
        DemDTCClass_BatteryHVInterlockError: DemDtcValue=657921, DemDTCFunctionalUnit=32, DemDTCAttributesRef=DemDTCAttributes_BatteryHVInterlockError, DemObdDTCRef=DemObdDTC_MainHVIL
        DemDTCClass_BatteryInsulationFault: DemDtcValue=947200, DemDTCFunctionalUnit=33, DemDTCAttributesRef=DemDTCAttributes_BatteryInsulationFault
        DemDTCClass_VehicleInsulationFault: DemDtcValue=697856, DemDTCFunctionalUnit=34, DemDTCAttributesRef=DemDTCAttributes_VehicleInsulationFault
        DemDTCClass_Precharge_Resistor_Open: DemDtcValue=1775635, DemDTCFunctionalUnit=35, DemDTCAttributesRef=DemDTCAttributes_Precharge_Resistor_Open
        DemDTCClass_Precharge_Error: DemDtcValue=817152, DemDTCFunctionalUnit=36, DemDTCAttributesRef=DemDTCAttributes_Precharge_Error, DemObdDTCRef=DemObdDTC_PreChargeFail
        DemDTCClass_PrechargeShortCircuit: DemDtcValue=712985, DemDTCFunctionalUnit=37, DemDTCAttributesRef=DemDTCAttributes_PrechargeShortCircuit
        DemDTCClass_CAN_VCU_error: DemDtcValue=12751751, DemDTCFunctionalUnit=38, DemDTCAttributesRef=DemDTCAttributes_CAN_VCU_error
        DemDTCClass_CAN_MCUF_Error: DemDtcValue=12751495, DemDTCFunctionalUnit=39, DemDTCAttributesRef=DemDTCAttributes_CAN_MCUF_Error
        DemDTCClass_CAN_MCUR_Error: DemDtcValue=13723527, DemDTCFunctionalUnit=40, DemDTCAttributesRef=DemDTCAttributes_CAN_MCUR_Error
        DemDTCClass_CAN_ISG_Error: DemDtcValue=13723271, DemDTCFunctionalUnit=41, DemDTCAttributesRef=DemDTCAttributes_CAN_ISG_Error
        DemDTCClass_CAN_CDU_Error: DemDtcValue=13723783, DemDTCFunctionalUnit=42, DemDTCAttributesRef=DemDTCAttributes_CAN_CDU_Error
        DemDTCClass_CAN_CLM_Error: DemDtcValue=12674183, DemDTCFunctionalUnit=43, DemDTCAttributesRef=DemDTCAttributes_CAN_CLM_Error
        DemDTCClass_CAN_ABM_Error: DemDtcValue=12669319, DemDTCFunctionalUnit=44, DemDTCAttributesRef=DemDTCAttributes_CAN_ABM_Error
        DemDTCClass_CAN_ICM_Error: DemDtcValue=12670343, DemDTCFunctionalUnit=45, DemDTCAttributesRef=DemDTCAttributes_CAN_ICM_Error
        DemDTCClass_CAN_TBOX_Error: DemDtcValue=12687495, DemDTCFunctionalUnit=46, DemDTCAttributesRef=DemDTCAttributes_CAN_TBOX_Error
        DemDTCClass_CAN_BSM_Error: DemDtcValue=12659079, DemDTCFunctionalUnit=47, DemDTCAttributesRef=DemDTCAttributes_CAN_BSM_Error
        DemDTCClass_CAN_EMS_Error: DemDtcValue=12648583, DemDTCFunctionalUnit=48, DemDTCAttributesRef=DemDTCAttributes_CAN_EMS_Error
        DemDTCClass_PTCAN_BusOff: DemDtcValue=12612488, DemDTCFunctionalUnit=49, DemDTCAttributesRef=DemDTCAttributes_PTCAN_BusOff
        DemDTCClass_LV_UnderVoltage: DemDtcValue=719522, DemDTCFunctionalUnit=50, DemDTCAttributesRef=DemDTCAttributes_LV_UnderVoltage, DemObdDTCRef=DemObdDTC_LV_UnderVoltage
        DemDTCClass_LV_OverVoltage: DemDtcValue=719779, DemDTCFunctionalUnit=51, DemDTCAttributesRef=DemDTCAttributes_LV_OverVoltage, DemObdDTCRef=DemObdDTC_LV_OverVoltage
        DemDTCClass_PrechrgCont_StuckOpen: DemDtcValue=713586, DemDTCFunctionalUnit=28, DemDTCAttributesRef=DemDTCAttributes_PrechrgCont_StuckOpen, DemObdDTCRef=DemObdDTC_Contactor_PrechargeStuckOpen
      52 x DemDTCAttributes, all with DemImmediateNvStorage=false, DemAgingAllowed=true, DemDTCSignificance=DEM_EVENT_SIGNIFICANCE_FAULT, DemMaxNumberFreezeFrameRecords=2, DemExtendedDataClassRef=Set1_Extd, DemMemoryDestinationRef=DemPrimaryMemory:
        DemDTCAttributes_Cell_Overvoltage_1: DemDTCPriority=2, DemAgingCycleCounterThreshold=3, DemAgingCycleRef=DEM_OPCYC_POWER, DemFreezeFrameClassRef=Set1_Freeze
        DemDTCAttributes_Cell_Overvoltage_2: DemDTCPriority=2, DemAgingCycleCounterThreshold=3, DemAgingCycleRef=DEM_OPCYC_POWER, DemFreezeFrameClassRef=Set1_Freeze
        DemDTCAttributes_Cell_Overvoltage_3: DemDTCPriority=1, DemAgingCycleCounterThreshold=40, DemAgingCycleRef=DEM_OPCYC_WARMUP, DemFreezeFrameClassRef=Set2_OBD_Freeze
        DemDTCAttributes_Cell_Undervoltage_1: DemDTCPriority=2, DemAgingCycleCounterThreshold=3, DemAgingCycleRef=DEM_OPCYC_POWER, DemFreezeFrameClassRef=Set1_Freeze
        DemDTCAttributes_Cell_Undervoltage_3: DemDTCPriority=1, DemAgingCycleCounterThreshold=40, DemAgingCycleRef=DEM_OPCYC_WARMUP, DemFreezeFrameClassRef=Set2_OBD_Freeze
        DemDTCAttributes_Cell_Deltavoltage3: DemDTCPriority=2, DemAgingCycleCounterThreshold=3, DemAgingCycleRef=DEM_OPCYC_POWER, DemFreezeFrameClassRef=Set1_Freeze
        DemDTCAttributes_Batt_Overvoltage_2: DemDTCPriority=2, DemAgingCycleCounterThreshold=3, DemAgingCycleRef=DEM_OPCYC_POWER, DemFreezeFrameClassRef=Set1_Freeze
        DemDTCAttributes_Batt_Undervoltage_2: DemDTCPriority=2, DemAgingCycleCounterThreshold=3, DemAgingCycleRef=DEM_OPCYC_POWER, DemFreezeFrameClassRef=Set1_Freeze
        DemDTCAttributes_Batt_Overtemp_3: DemDTCPriority=1, DemAgingCycleCounterThreshold=40, DemAgingCycleRef=DEM_OPCYC_WARMUP, DemFreezeFrameClassRef=Set2_OBD_Freeze
        DemDTCAttributes_Batt_Undertemp_3: DemDTCPriority=1, DemAgingCycleCounterThreshold=40, DemAgingCycleRef=DEM_OPCYC_WARMUP, DemFreezeFrameClassRef=Set2_OBD_Freeze
        DemDTCAttributes_Batt_Deltatemp_3: DemDTCPriority=2, DemAgingCycleCounterThreshold=3, DemAgingCycleRef=DEM_OPCYC_POWER, DemFreezeFrameClassRef=Set1_Freeze
        DemDTCAttributes_Pack_OverDchrgPower_3: DemDTCPriority=2, DemAgingCycleCounterThreshold=3, DemAgingCycleRef=DEM_OPCYC_POWER, DemFreezeFrameClassRef=Set1_Freeze
        DemDTCAttributes_Pack_OverRegenPower_3: DemDTCPriority=2, DemAgingCycleCounterThreshold=3, DemAgingCycleRef=DEM_OPCYC_POWER, DemFreezeFrameClassRef=Set1_Freeze
        DemDTCAttributes_BMS_ACChrgOverCurrent: DemDTCPriority=1, DemAgingCycleCounterThreshold=40, DemAgingCycleRef=DEM_OPCYC_WARMUP, DemFreezeFrameClassRef=Set2_OBD_Freeze
        DemDTCAttributes_SOC_low_3: DemDTCPriority=2, DemAgingCycleCounterThreshold=3, DemAgingCycleRef=DEM_OPCYC_POWER, DemFreezeFrameClassRef=Set1_Freeze
        DemDTCAttributes_IsoResistor_Error_1: DemDTCPriority=2, DemAgingCycleCounterThreshold=3, DemAgingCycleRef=DEM_OPCYC_POWER, DemFreezeFrameClassRef=Set1_Freeze
        DemDTCAttributes_IsoResistor_Error_2: DemDTCPriority=1, DemAgingCycleCounterThreshold=40, DemAgingCycleRef=DEM_OPCYC_WARMUP, DemFreezeFrameClassRef=Set2_OBD_Freeze
        DemDTCAttributes_Crash_states: DemDTCPriority=1, DemAgingCycleCounterThreshold=40, DemAgingCycleRef=DEM_OPCYC_WARMUP, DemFreezeFrameClassRef=Set2_OBD_Freeze
        DemDTCAttributes_ThermalRunaway_Error: DemDTCPriority=1, DemAgingCycleCounterThreshold=40, DemAgingCycleRef=DEM_OPCYC_WARMUP, DemFreezeFrameClassRef=Set2_OBD_Freeze
        DemDTCAttributes_BatteryHeatingFault: DemDTCPriority=2, DemAgingCycleCounterThreshold=3, DemAgingCycleRef=DEM_OPCYC_POWER, DemFreezeFrameClassRef=Set1_Freeze
        DemDTCAttributes_BatteryCoolingFault: DemDTCPriority=2, DemAgingCycleCounterThreshold=3, DemAgingCycleRef=DEM_OPCYC_POWER, DemFreezeFrameClassRef=Set1_Freeze
        DemDTCAttributes_BatteryCircuitOverCurrent: DemDTCPriority=2, DemAgingCycleCounterThreshold=3, DemAgingCycleRef=DEM_OPCYC_POWER, DemFreezeFrameClassRef=Set1_Freeze
        DemDTCAttributes_PosCont_StuckClose: DemDTCPriority=1, DemAgingCycleCounterThreshold=40, DemAgingCycleRef=DEM_OPCYC_WARMUP, DemFreezeFrameClassRef=Set2_OBD_Freeze
        DemDTCAttributes_PosCont_StuckOpen: DemDTCPriority=1, DemAgingCycleCounterThreshold=40, DemAgingCycleRef=DEM_OPCYC_WARMUP, DemFreezeFrameClassRef=Set2_OBD_Freeze
        DemDTCAttributes_NegCont_StuckClose: DemDTCPriority=1, DemAgingCycleCounterThreshold=40, DemAgingCycleRef=DEM_OPCYC_WARMUP, DemFreezeFrameClassRef=Set2_OBD_Freeze
        DemDTCAttributes_NegCont_StuckOpen: DemDTCPriority=1, DemAgingCycleCounterThreshold=40, DemAgingCycleRef=DEM_OPCYC_WARMUP, DemFreezeFrameClassRef=Set2_OBD_Freeze
        DemDTCAttributes_PrechrgCont_StuckClose: DemDTCPriority=1, DemAgingCycleCounterThreshold=40, DemAgingCycleRef=DEM_OPCYC_WARMUP, DemFreezeFrameClassRef=Set2_OBD_Freeze
        DemDTCAttributes_PrechrgCont_StuckOpen: DemDTCPriority=1, DemAgingCycleCounterThreshold=40, DemAgingCycleRef=DEM_OPCYC_WARMUP, DemFreezeFrameClassRef=Set2_OBD_Freeze
        DemDTCAttributes_MainFuse1_Open: DemDTCPriority=1, DemAgingCycleCounterThreshold=40, DemAgingCycleRef=DEM_OPCYC_WARMUP, DemFreezeFrameClassRef=Set2_OBD_Freeze
        DemDTCAttributes_MainFuse2_Open: DemDTCPriority=2, DemAgingCycleCounterThreshold=3, DemAgingCycleRef=DEM_OPCYC_POWER, DemFreezeFrameClassRef=Set1_Freeze
        DemDTCAttributes_VehicleHVInterlockError: DemDTCPriority=1, DemAgingCycleCounterThreshold=40, DemAgingCycleRef=DEM_OPCYC_WARMUP, DemFreezeFrameClassRef=Set2_OBD_Freeze
        DemDTCAttributes_BatteryHVInterlockError: DemDTCPriority=1, DemAgingCycleCounterThreshold=40, DemAgingCycleRef=DEM_OPCYC_WARMUP, DemFreezeFrameClassRef=Set2_OBD_Freeze
        DemDTCAttributes_BatteryInsulationFault: DemDTCPriority=2, DemAgingCycleCounterThreshold=3, DemAgingCycleRef=DEM_OPCYC_POWER, DemFreezeFrameClassRef=Set1_Freeze
        DemDTCAttributes_VehicleInsulationFault: DemDTCPriority=2, DemAgingCycleCounterThreshold=3, DemAgingCycleRef=DEM_OPCYC_POWER, DemFreezeFrameClassRef=Set1_Freeze
        DemDTCAttributes_Precharge_Resistor_Open: DemDTCPriority=2, DemAgingCycleCounterThreshold=3, DemAgingCycleRef=DEM_OPCYC_POWER, DemFreezeFrameClassRef=Set1_Freeze
        DemDTCAttributes_Precharge_Error: DemDTCPriority=1, DemAgingCycleCounterThreshold=40, DemAgingCycleRef=DEM_OPCYC_WARMUP, DemFreezeFrameClassRef=Set2_OBD_Freeze
        DemDTCAttributes_PrechargeShortCircuit: DemDTCPriority=2, DemAgingCycleCounterThreshold=3, DemAgingCycleRef=DEM_OPCYC_POWER, DemFreezeFrameClassRef=Set1_Freeze
        DemDTCAttributes_CAN_VCU_error: DemDTCPriority=2, DemAgingCycleCounterThreshold=3, DemAgingCycleRef=DEM_OPCYC_POWER, DemFreezeFrameClassRef=Set1_Freeze
        DemDTCAttributes_CAN_MCUF_Error: DemDTCPriority=2, DemAgingCycleCounterThreshold=3, DemAgingCycleRef=DEM_OPCYC_POWER, DemFreezeFrameClassRef=Set1_Freeze
        DemDTCAttributes_CAN_MCUR_Error: DemDTCPriority=2, DemAgingCycleCounterThreshold=3, DemAgingCycleRef=DEM_OPCYC_POWER, DemFreezeFrameClassRef=Set1_Freeze
        DemDTCAttributes_CAN_ISG_Error: DemDTCPriority=2, DemAgingCycleCounterThreshold=3, DemAgingCycleRef=DEM_OPCYC_POWER, DemFreezeFrameClassRef=Set1_Freeze
        DemDTCAttributes_CAN_CDU_Error: DemDTCPriority=2, DemAgingCycleCounterThreshold=3, DemAgingCycleRef=DEM_OPCYC_POWER, DemFreezeFrameClassRef=Set1_Freeze
        DemDTCAttributes_CAN_CLM_Error: DemDTCPriority=2, DemAgingCycleCounterThreshold=3, DemAgingCycleRef=DEM_OPCYC_POWER, DemFreezeFrameClassRef=Set1_Freeze
        DemDTCAttributes_CAN_ABM_Error: DemDTCPriority=2, DemAgingCycleCounterThreshold=3, DemAgingCycleRef=DEM_OPCYC_POWER, DemFreezeFrameClassRef=Set1_Freeze
        DemDTCAttributes_CAN_ICM_Error: DemDTCPriority=2, DemAgingCycleCounterThreshold=3, DemAgingCycleRef=DEM_OPCYC_POWER, DemFreezeFrameClassRef=Set1_Freeze
        DemDTCAttributes_CAN_TBOX_Error: DemDTCPriority=2, DemAgingCycleCounterThreshold=3, DemAgingCycleRef=DEM_OPCYC_POWER, DemFreezeFrameClassRef=Set1_Freeze
        DemDTCAttributes_CAN_BSM_Error: DemDTCPriority=2, DemAgingCycleCounterThreshold=3, DemAgingCycleRef=DEM_OPCYC_POWER, DemFreezeFrameClassRef=Set1_Freeze
        DemDTCAttributes_CAN_EMS_Error: DemDTCPriority=2, DemAgingCycleCounterThreshold=3, DemAgingCycleRef=DEM_OPCYC_POWER, DemFreezeFrameClassRef=Set1_Freeze
        DemDTCAttributes_PTCAN_BusOff: DemDTCPriority=2, DemAgingCycleCounterThreshold=3, DemAgingCycleRef=DEM_OPCYC_POWER, DemFreezeFrameClassRef=Set1_Freeze
        DemDTCAttributes_LV_UnderVoltage: DemDTCPriority=1, DemAgingCycleCounterThreshold=40, DemAgingCycleRef=DEM_OPCYC_WARMUP, DemFreezeFrameClassRef=Set2_OBD_Freeze
        DemDTCAttributes_LV_OverVoltage: DemDTCPriority=1, DemAgingCycleCounterThreshold=40, DemAgingCycleRef=DEM_OPCYC_WARMUP, DemFreezeFrameClassRef=Set2_OBD_Freeze
        DemDTCAttributes_Cell_Undervoltage_2: DemDTCPriority=2, DemAgingCycleCounterThreshold=3, DemAgingCycleRef=DEM_OPCYC_POWER, DemFreezeFrameClassRef=Set1_Freeze
      Generic_DemDebounceCounterBasedClass (DemDebounceCounterBasedClass):
        DemDebounceBehavior = DEM_DEBOUNCE_FREEZE
        DemDebounceCounterDecrementStepSize = 1
        DemDebounceCounterIncrementStepSize = 1
        DemDebounceCounterStorage = false
    DemGeneral:
      DemEventMemoryEntryStorageTrigger = DEM_TRIGGER_ON_TEST_FAILED
      DemRbValidationMode = Dem_ValidationMode_Standard
      DemResetConfirmedBitOnOverflow = true
      DemStatusBitHandlingTestFailedSinceLastClear = DEM_STATUS_BIT_NORMAL
      Set2_OBD_Freeze (DemFreezeFrameClass): DemDidClassRef=BatteryVoltage
      BatteryVoltage (DemDidClass): DemDidIdentifier=4175, DemDidDataElementClassRef=DemExternalCSDataElementClass_Pid9A_BatteryVoltageandCurrent
