AUTOSAR XML (schema 4-0-3)
package /CAN_System/Pkg_Ecu/SystemComposition
  composition sw component type TopLevelComposition
    connect CPT_Dem.EvtInfo_Event_Cell_Overvoltage_1 -> CPT_DTC_Component.RP_DiagInfo_Cell_Overvoltage_1
    connect CPT_Dem.Event_Event_Cell_Overvoltage_1 -> CPT_DTC_Component.RP_Monitor_Cell_Overvoltage_1
    connect CPT_CPLR_Code.VeCPLR_k_OverCV_L1_flt -> CPT_DTC_Component.RP_FaultStatus_Cell_Overvoltage_1
    connect CPT_Dem.EvtInfo_Event_Cell_Overvoltage_2 -> CPT_DTC_Component.RP_DiagInfo_Cell_Overvoltage_2
    connect CPT_Dem.Event_Event_Cell_Overvoltage_2 -> CPT_DTC_Component.RP_Monitor_Cell_Overvoltage_2
    connect CPT_CPLR_Code.VeCPLR_k_OverCV_L3_flt -> CPT_DTC_Component.RP_FaultStatus_Cell_Overvoltage_2
    connect CPT_Dem.EvtInfo_Event_Cell_Overvoltage_3 -> CPT_DTC_Component.RP_DiagInfo_Cell_Overvoltage_3
    connect CPT_Dem.Event_Event_Cell_Overvoltage_3 -> CPT_DTC_Component.RP_Monitor_Cell_Overvoltage_3
    connect CPT_CPLR_Code.VeCPLR_k_OverCV_L4_flt -> CPT_DTC_Component.RP_FaultStatus_Cell_Overvoltage_3
    connect CPT_Dem.EvtInfo_Event_Cell_Undervoltage_1 -> CPT_DTC_Component.RP_DiagInfo_Cell_Undervoltage_1
    connect CPT_Dem.Event_Event_Cell_Undervoltage_1 -> CPT_DTC_Component.RP_Monitor_Cell_Undervoltage_1
    connect CPT_CPLR_Code.VeCPLR_k_UnderCV_L2_flt -> CPT_DTC_Component.RP_FaultStatus_Cell_Undervoltage_1
    connect CPT_Dem.EvtInfo_Event_Cell_Undervoltage_2 -> CPT_DTC_Component.RP_DiagInfo_Cell_Undervoltage_2
    connect CPT_Dem.Event_Event_Cell_Undervoltage_2 -> CPT_DTC_Component.RP_Monitor_Cell_Undervoltage_2
    connect CPT_CPLR_Code.VeCPLR_k_UnderCV_L3_flt -> CPT_DTC_Component.RP_FaultStatus_Cell_Undervoltage_2
    connect CPT_Dem.EvtInfo_Event_Cell_Undervoltage_3 -> CPT_DTC_Component.RP_DiagInfo_Cell_Undervoltage_3
    connect CPT_Dem.Event_Event_Cell_Undervoltage_3 -> CPT_DTC_Component.RP_Monitor_Cell_Undervoltage_3
    connect CPT_CPLR_Code.VeCPLR_k_UnderCV_L4_flt -> CPT_DTC_Component.RP_FaultStatus_Cell_Undervoltage_3
    connect CPT_Dem.EvtInfo_Event_Cell_Deltavoltage3 -> CPT_DTC_Component.RP_DiagInfo_Cell_Deltavoltage3
    connect CPT_Dem.Event_Event_Cell_Deltavoltage3 -> CPT_DTC_Component.RP_Monitor_Cell_Deltavoltage3
    connect CPT_CPLR_Code.VeCPLR_k_DeltaCV_L3_flt -> CPT_DTC_Component.RP_FaultStatus_Cell_Deltavoltage3
    connect CPT_Dem.EvtInfo_Event_Batt_Overvoltage_2 -> CPT_DTC_Component.RP_DiagInfo_Batt_Overvoltage_2
    connect CPT_Dem.Event_Event_Batt_Overvoltage_2 -> CPT_DTC_Component.RP_Monitor_Batt_Overvoltage_2
    connect CPT_CPLR_Code.VeCPLR_k_PackOverVolt_L3_flt -> CPT_DTC_Component.RP_FaultStatus_Batt_Overvoltage_2
    connect CPT_Dem.EvtInfo_Event_Batt_Undervoltage_2 -> CPT_DTC_Component.RP_DiagInfo_Batt_Undervoltage_2
    connect CPT_Dem.Event_Event_Batt_Undervoltage_2 -> CPT_DTC_Component.RP_Monitor_Batt_Undervoltage_2
    connect CPT_CPLR_Code.VeCPLR_k_PackUnderVolt_L3_flt -> CPT_DTC_Component.RP_FaultStatus_Batt_Undervoltage_2
    connect CPT_Dem.EvtInfo_Event_Batt_Overtemp_3 -> CPT_DTC_Component.RP_DiagInfo_Batt_Overtemp_3
    connect CPT_Dem.Event_Event_Batt_Overtemp_3 -> CPT_DTC_Component.RP_Monitor_Batt_Overtemp_3
    connect CPT_CPLR_Code.VeCPLR_k_OverCT_L4_flt -> CPT_DTC_Component.RP_FaultStatus_Batt_Overtemp_3
    connect CPT_Dem.EvtInfo_Event_Batt_Undertemp_3 -> CPT_DTC_Component.RP_DiagInfo_Batt_Undertemp_3
    connect CPT_Dem.Event_Event_Batt_Undertemp_3 -> CPT_DTC_Component.RP_Monitor_Batt_Undertemp_3
    connect CPT_CPLR_Code.VeCPLR_k_UnderCT_L4_flt -> CPT_DTC_Component.RP_FaultStatus_Batt_Undertemp_3
    connect CPT_Dem.EvtInfo_Event_Batt_Deltatemp_3 -> CPT_DTC_Component.RP_DiagInfo_Batt_Deltatemp_3
    connect CPT_Dem.Event_Event_Batt_Deltatemp_3 -> CPT_DTC_Component.RP_Monitor_Batt_Deltatemp_3
    connect CPT_CPLR_Code.VeCPLR_k_DeltaCT_L3_flt -> CPT_DTC_Component.RP_FaultStatus_Batt_Deltatemp_3
    connect CPT_Dem.EvtInfo_Event_Pack_OverDchrgPower_3 -> CPT_DTC_Component.RP_DiagInfo_Pack_OverDchrgPower_3
    connect CPT_Dem.Event_Event_Pack_OverDchrgPower_3 -> CPT_DTC_Component.RP_Monitor_Pack_OverDchrgPower_3
    connect CPT_SOPR_Code.VeSOPR_k_PackOverDchrgPower3_flt -> CPT_DTC_Component.RP_FaultStatus_Pack_OverDchrgPower_3
    connect CPT_Dem.EvtInfo_Event_Pack_OverRegenPower_3 -> CPT_DTC_Component.RP_DiagInfo_Pack_OverRegenPower_3
    connect CPT_Dem.Event_Event_Pack_OverRegenPower_3 -> CPT_DTC_Component.RP_Monitor_Pack_OverRegenPower_3
    connect CPT_SOPR_Code.VeSOPR_k_PackOverChrgPower3_flt -> CPT_DTC_Component.RP_FaultStatus_Pack_OverRegenPower_3
    connect CPT_Dem.EvtInfo_Event_BMS_ACChrgOverCurrent -> CPT_DTC_Component.RP_DiagInfo_BMS_ACChrgOverCurrent
    connect CPT_Dem.Event_Event_BMS_ACChrgOverCurrent -> CPT_DTC_Component.RP_Monitor_BMS_ACChrgOverCurrent
    connect CPT_CHMR_Code.VeCHMR_k_ChrgOverCurr_level3_flt -> CPT_DTC_Component.RP_FaultStatus_BMS_ACChrgOverCurrent
    connect CPT_Dem.EvtInfo_Event_SOC_low_3 -> CPT_DTC_Component.RP_DiagInfo_SOC_low_3
    connect CPT_Dem.Event_Event_SOC_low_3 -> CPT_DTC_Component.RP_Monitor_SOC_low_3
    connect CPT_SOCR_Code.VeSOCR_k_SOC_low3_flt -> CPT_DTC_Component.RP_FaultStatus_SOC_low_3
    connect CPT_Dem.EvtInfo_Event_IsoResistor_Error_1 -> CPT_DTC_Component.RP_DiagInfo_IsoResistor_Error_1
    connect CPT_Dem.Event_Event_IsoResistor_Error_1 -> CPT_DTC_Component.RP_Monitor_IsoResistor_Error_1
    connect CPT_ISLR_Code.VeISLR_k_Isolation_L1_flt -> CPT_DTC_Component.RP_FaultStatus_IsoResistor_Error_1
    connect CPT_Dem.EvtInfo_Event_IsoResistor_Error_2 -> CPT_DTC_Component.RP_DiagInfo_IsoResistor_Error_2
    connect CPT_Dem.Event_Event_IsoResistor_Error_2 -> CPT_DTC_Component.RP_Monitor_IsoResistor_Error_2
    connect CPT_ISLR_Code.VeISLR_k_Isolation_L2_flt -> CPT_DTC_Component.RP_FaultStatus_IsoResistor_Error_2
    connect CPT_Dem.EvtInfo_Event_Crash_states -> CPT_DTC_Component.RP_DiagInfo_Crash_states
    connect CPT_Dem.Event_Event_Crash_states -> CPT_DTC_Component.RP_Monitor_Crash_states
    connect CPT_Dem.EvtInfo_Event_ThermalRunaway_Error -> CPT_DTC_Component.RP_DiagInfo_ThermalRunaway_Error
    connect CPT_Dem.Event_Event_ThermalRunaway_Error -> CPT_DTC_Component.RP_Monitor_ThermalRunaway_Error
    connect CPT_CPLR_Code.VeCPLR_k_ThermalRunaway_flt -> CPT_DTC_Component.RP_FaultStatus_ThermalRunaway_Error
    connect CPT_Dem.EvtInfo_Event_BatteryHeatingFault -> CPT_DTC_Component.RP_DiagInfo_BatteryHeatingFault
    connect CPT_Dem.Event_Event_BatteryHeatingFault -> CPT_DTC_Component.RP_Monitor_BatteryHeatingFault
    connect CPT_THMR_Code.VeTHMR_k_BatteryHeatingOverCurrt_flt -> CPT_DTC_Component.RP_FaultStatus_BatteryHeatingFault
    connect CPT_Dem.EvtInfo_Event_BatteryCoolingFault -> CPT_DTC_Component.RP_DiagInfo_BatteryCoolingFault
    connect CPT_Dem.Event_Event_BatteryCoolingFault -> CPT_DTC_Component.RP_Monitor_BatteryCoolingFault
    connect CPT_THMR_Code.VeTHMR_k_BatteryCooling_flt -> CPT_DTC_Component.RP_FaultStatus_BatteryCoolingFault
    connect CPT_Dem.EvtInfo_Event_BatteryCircuitOverCurrent -> CPT_DTC_Component.RP_DiagInfo_BatteryCircuitOverCurrent
    connect CPT_Dem.Event_Event_BatteryCircuitOverCurrent -> CPT_DTC_Component.RP_Monitor_BatteryCircuitOverCurrent
    connect CPT_VSDR_Code.VeVSDR_k_HVOverCurrent_flt -> CPT_DTC_Component.RP_FaultStatus_BatteryCircuitOverCurrent
    connect CPT_Dem.EvtInfo_Event_PosCont_StuckClose -> CPT_DTC_Component.RP_DiagInfo_PosCont_StuckClose
    connect CPT_Dem.Event_Event_PosCont_StuckClose -> CPT_DTC_Component.RP_Monitor_PosCont_StuckClose
    connect CPT_CFLR_Code.VeCFLR_k_PositiveStuckClose_flt -> CPT_DTC_Component.RP_FaultStatus_PosCont_StuckClose
    connect CPT_Dem.EvtInfo_Event_PosCont_StuckOpen -> CPT_DTC_Component.RP_DiagInfo_PosCont_StuckOpen
    connect CPT_Dem.Event_Event_PosCont_StuckOpen -> CPT_DTC_Component.RP_Monitor_PosCont_StuckOpen
    connect CPT_CFLR_Code.VeCFLR_k_PositiveStuckOpen_flt -> CPT_DTC_Component.RP_FaultStatus_PosCont_StuckOpen
    connect CPT_Dem.EvtInfo_Event_NegCont_StuckClose -> CPT_DTC_Component.RP_DiagInfo_NegCont_StuckClose
    connect CPT_Dem.Event_Event_NegCont_StuckClose -> CPT_DTC_Component.RP_Monitor_NegCont_StuckClose
    connect CPT_CFLR_Code.VeCFLR_k_NegativeStuckClose_flt -> CPT_DTC_Component.RP_FaultStatus_NegCont_StuckClose
    connect CPT_Dem.EvtInfo_Event_NegCont_StuckOpen -> CPT_DTC_Component.RP_DiagInfo_NegCont_StuckOpen
    connect CPT_Dem.Event_Event_NegCont_StuckOpen -> CPT_DTC_Component.RP_Monitor_NegCont_StuckOpen
    connect CPT_CFLR_Code.VeCFLR_k_NegativeStuckOpen_flt -> CPT_DTC_Component.RP_FaultStatus_NegCont_StuckOpen
    connect CPT_Dem.EvtInfo_Event_PrechrgCont_StuckClose -> CPT_DTC_Component.RP_DiagInfo_PrechrgCont_StuckClose
    connect CPT_Dem.Event_Event_PrechrgCont_StuckClose -> CPT_DTC_Component.RP_Monitor_PrechrgCont_StuckClose
    connect CPT_CFLR_Code.VeCFLR_k_PrechargeStuckClose_flt -> CPT_DTC_Component.RP_FaultStatus_PrechrgCont_StuckClose
    connect CPT_Dem.EvtInfo_Event_PrechrgCont_StuckOpen -> CPT_DTC_Component.RP_DiagInfo_PrechrgCont_StuckOpen
    connect CPT_Dem.Event_Event_PrechrgCont_StuckOpen -> CPT_DTC_Component.RP_Monitor_PrechrgCont_StuckOpen
    connect CPT_CFLR_Code.VeCFLR_k_PrechargeStuckOpen_flt -> CPT_DTC_Component.RP_FaultStatus_PrechrgCont_StuckOpen
    connect CPT_Dem.EvtInfo_Event_MainFuse1_Open -> CPT_DTC_Component.RP_DiagInfo_MainFuse1_Open
    connect CPT_Dem.Event_Event_MainFuse1_Open -> CPT_DTC_Component.RP_Monitor_MainFuse1_Open
    connect CPT_CFLR_Code.VeCFLR_k_MainFuse1Open_flt -> CPT_DTC_Component.RP_FaultStatus_MainFuse1_Open
    connect CPT_Dem.EvtInfo_Event_MainFuse2_Open -> CPT_DTC_Component.RP_DiagInfo_MainFuse2_Open
    connect CPT_Dem.Event_Event_MainFuse2_Open -> CPT_DTC_Component.RP_Monitor_MainFuse2_Open
    connect CPT_CFLR_Code.VeCFLR_k_MainFuse2Open_flt -> CPT_DTC_Component.RP_FaultStatus_MainFuse2_Open
    connect CPT_Dem.EvtInfo_Event_VehicleHVInterlockError -> CPT_DTC_Component.RP_DiagInfo_VehicleHVInterlockError
    connect CPT_Dem.Event_Event_VehicleHVInterlockError -> CPT_DTC_Component.RP_Monitor_VehicleHVInterlockError
    connect CPT_HVIR_Code.VeHVIR_k_MainHVIL2_flt -> CPT_DTC_Component.RP_FaultStatus_VehicleHVInterlockError
    connect CPT_Dem.EvtInfo_Event_BatteryHVInterlockError -> CPT_DTC_Component.RP_DiagInfo_BatteryHVInterlockError
    connect CPT_Dem.Event_Event_BatteryHVInterlockError -> CPT_DTC_Component.RP_Monitor_BatteryHVInterlockError
    connect CPT_HVIR_Code.VeHVIR_k_MainHVIL_flt -> CPT_DTC_Component.RP_FaultStatus_BatteryHVInterlockError
    connect CPT_Dem.EvtInfo_Event_BatteryInsulationFault -> CPT_DTC_Component.RP_DiagInfo_BatteryInsulationFault
    connect CPT_Dem.Event_Event_BatteryInsulationFault -> CPT_DTC_Component.RP_Monitor_BatteryInsulationFault
    connect CPT_ISLR_Code.VeISLR_InterIsolation_flt -> CPT_DTC_Component.RP_FaultStatus_BatteryInsulationFault
    connect CPT_Dem.EvtInfo_Event_VehicleInsulationFault -> CPT_DTC_Component.RP_DiagInfo_VehicleInsulationFault
    connect CPT_Dem.Event_Event_VehicleInsulationFault -> CPT_DTC_Component.RP_Monitor_VehicleInsulationFault
    connect CPT_ISLR_Code.VeISLR_ExterIsolation_flt -> CPT_DTC_Component.RP_FaultStatus_VehicleInsulationFault
    connect CPT_Dem.EvtInfo_Event_Precharge_Resistor_Open -> CPT_DTC_Component.RP_DiagInfo_Precharge_Resistor_Open
    connect CPT_Dem.Event_Event_Precharge_Resistor_Open -> CPT_DTC_Component.RP_Monitor_Precharge_Resistor_Open
    connect CPT_CFLR_Code.VeCFLR_k_PreResistorStuckOpen_flt -> CPT_DTC_Component.RP_FaultStatus_Precharge_Resistor_Open
    connect CPT_Dem.EvtInfo_Event_Precharge_Error -> CPT_DTC_Component.RP_DiagInfo_Precharge_Error
    connect CPT_Dem.Event_Event_Precharge_Error -> CPT_DTC_Component.RP_Monitor_Precharge_Error
    connect CPT_CFLR_Code.VeCFLR_k_PreChargeFail_flt -> CPT_DTC_Component.RP_FaultStatus_Precharge_Error
    connect CPT_Dem.EvtInfo_Event_PrechargeShortCircuit -> CPT_DTC_Component.RP_DiagInfo_PrechargeShortCircuit
    connect CPT_Dem.Event_Event_PrechargeShortCircuit -> CPT_DTC_Component.RP_Monitor_PrechargeShortCircuit
    connect CPT_CFLR_Code.VeCFLR_k_PreChargeOvCur_flt -> CPT_DTC_Component.RP_FaultStatus_PrechargeShortCircuit
    connect CPT_Dem.EvtInfo_Event_CAN_VCU_error -> CPT_DTC_Component.RP_DiagInfo_CAN_VCU_error
    connect CPT_Dem.Event_Event_CAN_VCU_error -> CPT_DTC_Component.RP_Monitor_CAN_VCU_error
    connect CPT_Dem.EvtInfo_Event_CAN_MCUF_Error -> CPT_DTC_Component.RP_DiagInfo_CAN_MCUF_Error
    connect CPT_Dem.Event_Event_CAN_MCUF_Error -> CPT_DTC_Component.RP_Monitor_CAN_MCUF_Error
    connect CPT_Dem.EvtInfo_Event_CAN_MCUR_Error -> CPT_DTC_Component.RP_DiagInfo_CAN_MCUR_Error
    connect CPT_Dem.Event_Event_CAN_MCUR_Error -> CPT_DTC_Component.RP_Monitor_CAN_MCUR_Error
    connect CPT_Dem.EvtInfo_Event_CAN_ISG_Error -> CPT_DTC_Component.RP_DiagInfo_CAN_ISG_Error
    connect CPT_Dem.Event_Event_CAN_ISG_Error -> CPT_DTC_Component.RP_Monitor_CAN_ISG_Error
    connect CPT_Dem.EvtInfo_Event_CAN_CDU_Error -> CPT_DTC_Component.RP_DiagInfo_CAN_CDU_Error
    connect CPT_Dem.Event_Event_CAN_CDU_Error -> CPT_DTC_Component.RP_Monitor_CAN_CDU_Error
    connect CPT_Dem.EvtInfo_Event_CAN_CLM_Error -> CPT_DTC_Component.RP_DiagInfo_CAN_CLM_Error
    connect CPT_Dem.Event_Event_CAN_CLM_Error -> CPT_DTC_Component.RP_Monitor_CAN_CLM_Error
    connect CPT_Dem.EvtInfo_Event_CAN_ABM_Error -> CPT_DTC_Component.RP_DiagInfo_CAN_ABM_Error
    connect CPT_Dem.Event_Event_CAN_ABM_Error -> CPT_DTC_Component.RP_Monitor_CAN_ABM_Error
    connect CPT_Dem.EvtInfo_Event_CAN_ICM_Error -> CPT_DTC_Component.RP_DiagInfo_CAN_ICM_Error
    connect CPT_Dem.Event_Event_CAN_ICM_Error -> CPT_DTC_Component.RP_Monitor_CAN_ICM_Error
    connect CPT_Dem.EvtInfo_Event_CAN_TBOX_Error -> CPT_DTC_Component.RP_DiagInfo_CAN_TBOX_Error
    connect CPT_Dem.Event_Event_CAN_TBOX_Error -> CPT_DTC_Component.RP_Monitor_CAN_TBOX_Error
    connect CPT_Dem.EvtInfo_Event_CAN_BSM_Error -> CPT_DTC_Component.RP_DiagInfo_CAN_BSM_Error
    connect CPT_Dem.Event_Event_CAN_BSM_Error -> CPT_DTC_Component.RP_Monitor_CAN_BSM_Error
    connect CPT_Dem.EvtInfo_Event_CAN_EMS_Error -> CPT_DTC_Component.RP_DiagInfo_CAN_EMS_Error
    connect CPT_Dem.Event_Event_CAN_EMS_Error -> CPT_DTC_Component.RP_Monitor_CAN_EMS_Error
    connect CPT_Dem.EvtInfo_Event_PTCAN_BusOff -> CPT_DTC_Component.RP_DiagInfo_PTCAN_BusOff
    connect CPT_Dem.Event_Event_PTCAN_BusOff -> CPT_DTC_Component.RP_Monitor_PTCAN_BusOff
    connect CPT_Dem.EvtInfo_Event_LV_UnderVoltage -> CPT_DTC_Component.RP_DiagInfo_LV_UnderVoltage
    connect CPT_Dem.Event_Event_LV_UnderVoltage -> CPT_DTC_Component.RP_Monitor_LV_UnderVoltage
    connect CPT_Dem.EvtInfo_Event_LV_OverVoltage -> CPT_DTC_Component.RP_DiagInfo_LV_OverVoltage
    connect CPT_Dem.Event_Event_LV_OverVoltage -> CPT_DTC_Component.RP_Monitor_LV_OverVoltage
