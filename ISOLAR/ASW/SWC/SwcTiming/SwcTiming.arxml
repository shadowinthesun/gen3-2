AUTOSAR XML (schema 4-2-2)
package /Timing_Components
  application sw component type SwcTiming
    behavior IB_SwcTiming
      timing event TimingEvent_100ms: start-on-event=RE_Timing_Analysis_100ms_Processing, period=0.1
      timing event TimingEvent_0: start-on-event=Re_SBC, period=0.025
      runnable RE_Timing_Analysis_100ms_Processing: symbol=RE_Timing_Analysis_100ms_Processing_func
      runnable Re_SBC: symbol=Safety_Device_Process
