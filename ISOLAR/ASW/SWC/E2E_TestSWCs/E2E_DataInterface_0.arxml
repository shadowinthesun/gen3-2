AUTOSAR XML (schema 4-1-1)
package /E2E_DataInterface_0
  sender receiver interface E2E_DataInterface_0
    data CKS: type=uint8
    data Alive_Cnt: type=uint8
    data Data: type=uint8
