AUTOSAR XML (schema 4-1-1)
package /E2EImplementationDataType_0
  impl type E2EImplementationDataType_0: category=STRUCTURE
    element Impl_CKS: implementation-data-type=uint8
    element Impl_Alive_Cnt: implementation-data-type=uint8
    element Impl_Data: implementation-data-type=uint8
